/* C5VRX-4: transport responsibilities. */
#include "video_internal.h"

static const void *c5vrx4_selected_program(void);
BITSCRAMBLER_PROGRAM(s_vlp56_program, "c5vrx4_vlp56");
BITSCRAMBLER_PROGRAM(s_ovp56_program, "c5vrx4_ovp56");
BITSCRAMBLER_PROGRAM(s_pll96_program, "c5vrx4_pll96");
BITSCRAMBLER_PROGRAM(s_range32_program, "c5vrx4_range32");
#if C5VRX4_RANGE_OPTION_COUNT >= 1
BITSCRAMBLER_PROGRAM(s_range_option0, "c5vrx4_range_option0");
#endif
#if C5VRX4_RANGE_OPTION_COUNT >= 2
BITSCRAMBLER_PROGRAM(s_range_option1, "c5vrx4_range_option1");
#endif
#if C5VRX4_RANGE_OPTION_COUNT >= 3
BITSCRAMBLER_PROGRAM(s_range_option2, "c5vrx4_range_option2");
#endif
#if C5VRX4_RANGE_OPTION_COUNT >= 4
BITSCRAMBLER_PROGRAM(s_range_option3, "c5vrx4_range_option3");
#endif
#if C5VRX4_RANGE_OPTION_COUNT >= 5
BITSCRAMBLER_PROGRAM(s_range_option4, "c5vrx4_range_option4");
#endif
#if C5VRX4_RANGE_OPTION_COUNT >= 6
BITSCRAMBLER_PROGRAM(s_range_option5, "c5vrx4_range_option5");
#endif
BITSCRAMBLER_PROGRAM(s_hc50_program, "c5vrx4_hc50");
static esp_err_t create_tx_unit(void);
BITSCRAMBLER_PROGRAM(s_reference_phase8_hr, "c5vrx4_reference_phase8_hr");
BITSCRAMBLER_PROGRAM(s_reference_golden, "c5vrx4_reference_golden");
/* Current three-bundle Phase8 programs, generated by generate_phase8.py. */
BITSCRAMBLER_PROGRAM(s_c5vrx4_legacy_static_program, "c5vrx4_phase8_static_legacy");

BITSCRAMBLER_PROGRAM(s_c5vrx4_legacy_history_program, "c5vrx4_phase8_history_legacy");

BITSCRAMBLER_PROGRAM(s_c5vrx4_static_program, "c5vrx4_phase8_static");

BITSCRAMBLER_PROGRAM(s_c5vrx4_history_program, "c5vrx4_phase8_history");

BITSCRAMBLER_PROGRAM(s_c5vrx4_cvbs150_static_program, "c5vrx4_phase8_static_cvbs150");

BITSCRAMBLER_PROGRAM(s_c5vrx4_cvbs150_history_program, "c5vrx4_phase8_history_cvbs150");

BITSCRAMBLER_PROGRAM(s_c5vrx4_mask_static_program, "c5vrx4_phase8_static_mask");

BITSCRAMBLER_PROGRAM(s_c5vrx4_mask_legacy_program, "c5vrx4_phase8_static_mask_legacy");

BITSCRAMBLER_PROGRAM(s_c5vrx4_mask_cvbs150_program, "c5vrx4_phase8_static_mask_cvbs150");

bitscrambler_handle_t s_flight_bs;

volatile rx_profile_t s_rx_profile = RX_PROFILE_DIRECT_GAIN;

/* TX GPIO mapping: 6-bit resistor DAC.
 * Order: DAC bit 0 (LSB) .. DAC bit 5 (MSB) on data_gpio_nums[0..5].
 * Bits 6..7 unused (set to -1).
 * Verified against C5VRX-2 realtime.c (standard 8-bit PARLIO TX, non-parlio4). */
static const int s_dac_gpio[8] = {23, 24, 11, 12, 8, 9, -1, -1};

/* DMA-aligned ring buffer in HP SRAM.
 * RX GDMA writes at 40 MB/s; TX GDMA reads at 40 MB/s.
 * TX starts half a ring behind RX; they share
 * PLL_F240M/6, so separation cannot drift during normal operation. */
DMA_ATTR __attribute__((aligned(64))) uint8_t s_raw_ring[RAW_RING_BYTES];

parlio_rx_unit_handle_t      s_rx;

static parlio_rx_delimiter_handle_t s_rx_delimiter;

parlio_tx_unit_handle_t      s_tx;

int s_rx_dma_ch = -1;

int s_tx_dma_ch = -1;

ring_dscr_node_t s_rx_dscr_nodes[MAX_RING_DESCRIPTORS];

int s_rx_dscr_count = 0;

ring_dscr_node_t s_tx_dscr_nodes[MAX_RING_DESCRIPTORS];

int s_tx_dscr_count = 0;

/* M-selected output transfer (generate_phase8.py): STD150 default,
 * LEGACY_FULL or CVBS150; STATIC/HISTORY decode is independent of it. */
static const void *range_option_program(unsigned index)
{
    switch (index) {
#if C5VRX4_RANGE_OPTION_COUNT >= 1
    case 0: return s_range_option0;
#endif
#if C5VRX4_RANGE_OPTION_COUNT >= 2
    case 1: return s_range_option1;
#endif
#if C5VRX4_RANGE_OPTION_COUNT >= 3
    case 2: return s_range_option2;
#endif
#if C5VRX4_RANGE_OPTION_COUNT >= 4
    case 3: return s_range_option3;
#endif
#if C5VRX4_RANGE_OPTION_COUNT >= 5
    case 4: return s_range_option4;
#endif
#if C5VRX4_RANGE_OPTION_COUNT >= 6
    case 5: return s_range_option5;
#endif
    default: return NULL;
    }
}

static const void *c5vrx4_selected_program(void)
{
    switch (c5vrx4_demodulator()) {
    case C5VRX4_DEMOD_HC50: return s_hc50_program;
    case C5VRX4_DEMOD_VLP56: return s_vlp56_program;
    case C5VRX4_DEMOD_OVP56: return s_ovp56_program;
    case C5VRX4_DEMOD_PLL96_IQ_FIXED: return s_pll96_program;
    case C5VRX4_DEMOD_RANGE32: return s_range32_program;
#if C5VRX4_RANGE_OPTION_COUNT >= 1
    case C5VRX4_DEMOD_RANGE_OPTION0: return s_range_option0;
#endif
#if C5VRX4_RANGE_OPTION_COUNT >= 2
    case C5VRX4_DEMOD_RANGE_OPTION1: return s_range_option1;
#endif
#if C5VRX4_RANGE_OPTION_COUNT >= 3
    case C5VRX4_DEMOD_RANGE_OPTION2: return s_range_option2;
#endif
#if C5VRX4_RANGE_OPTION_COUNT >= 4
    case C5VRX4_DEMOD_RANGE_OPTION3: return s_range_option3;
#endif
#if C5VRX4_RANGE_OPTION_COUNT >= 5
    case C5VRX4_DEMOD_RANGE_OPTION4: return s_range_option4;
#endif
#if C5VRX4_RANGE_OPTION_COUNT >= 6
    case C5VRX4_DEMOD_RANGE_OPTION5: return s_range_option5;
#endif
    case C5VRX4_DEMOD_PHASE8_HR: return s_reference_phase8_hr;
    case C5VRX4_DEMOD_GOLDEN: return s_reference_golden;
    default: break;
    }
    bool history = c5vrx4_history_enabled();
    if (c5vrx4_agc_mask_active()) {
        /* Native AGC acquisition mask: STATIC decode with the hold path. */
        switch (c5vrx4_cvbs_mode()) {
        case C5VRX4_CVBS_LEGACY: return s_c5vrx4_mask_legacy_program;
        case C5VRX4_CVBS_150: return s_c5vrx4_mask_cvbs150_program;
        default: return s_c5vrx4_mask_static_program;
        }
    }
    switch (c5vrx4_cvbs_mode()) {
    case C5VRX4_CVBS_LEGACY:
        return history ? s_c5vrx4_legacy_history_program : s_c5vrx4_legacy_static_program;
    case C5VRX4_CVBS_150:
        return history ? s_c5vrx4_cvbs150_history_program : s_c5vrx4_cvbs150_static_program;
    default:
        return history ? s_c5vrx4_history_program : s_c5vrx4_static_program;
    }
}

/* Cache synchronization helpers for DMA buffers and descriptors on ESP32-C5.
 * Aligns address down and size up to 64-byte cache line boundaries so esp_cache_msync
 * never fails with ESP_ERR_INVALID_ARG on unaligned descriptors or buffers. */
void sync_dma_c2m(const void *addr, size_t size)
{
    if (!addr || size == 0) return;
    uint32_t start = (uint32_t)addr & ~(64u - 1u);
    uint32_t end = ((uint32_t)addr + size + 63u) & ~(64u - 1u);
    (void)esp_cache_msync((void *)start, end - start,
                          ESP_CACHE_MSYNC_FLAG_DIR_C2M | ESP_CACHE_MSYNC_FLAG_UNALIGNED);
}

void sync_dma_m2c(const void *addr, size_t size)
{
    if (!addr || size == 0) return;
    uint32_t start = (uint32_t)addr & ~(64u - 1u);
    uint32_t end = ((uint32_t)addr + size + 63u) & ~(64u - 1u);
    (void)esp_cache_msync((void *)start, end - start,
                          ESP_CACHE_MSYNC_FLAG_DIR_M2C | ESP_CACHE_MSYNC_FLAG_UNALIGNED);
}

/* ----- PARLIO RX setup ----- */

esp_err_t prepare_rx(void)
{
    /* Proven PARLIO RX config with clean internal SPLL clock */
    const parlio_rx_unit_config_t cfg = {
        .trans_queue_depth = 1u,
        .max_recv_size     = sizeof(s_raw_ring),
        .dma_burst_size    = 32u,
        .data_width        = 8u,
        .clk_src           = PARLIO_CLK_SRC_DEFAULT,
        .ext_clk_freq_hz   = 0u,
        .exp_clk_freq_hz   = IQ_RATE_HZ,
        .clk_in_gpio_num   = -1,
        .clk_out_gpio_num  = -1,
        .valid_gpio_num    = -1,
        /* GPIO order must match s_iq_pins[] in rf.c:
         * Q[9:6] on GPIO 1,0,25,7 then I[9:6] on GPIO 10,5,3,4. */
        .data_gpio_nums    = {
            GPIO_NUM_1, GPIO_NUM_0, GPIO_NUM_25, GPIO_NUM_7,
            GPIO_NUM_10, GPIO_NUM_5, GPIO_NUM_3, GPIO_NUM_4,
        },
        .flags = {
            .free_clk    = true,   /* RX clock is derived from PHY, not gated */
            .clk_gate_en = false,
            .allow_pd    = false,
        },
    };
    esp_err_t err = parlio_new_rx_unit(&cfg, &s_rx);
    if (err != ESP_OK) return err;

    /* Soft delimiter in infinite (partial_rx_en) mode.
     * POS sample edge -- proven correct for internal clock. */
    const parlio_rx_soft_delimiter_config_t delim_cfg = {
        .sample_edge  = PARLIO_SAMPLE_EDGE_POS,
        .bit_pack_order = PARLIO_BIT_PACK_ORDER_LSB,
        .eof_data_len = sizeof(s_raw_ring),
        .timeout_ticks = 0u,
    };
    err = parlio_new_rx_soft_delimiter(&delim_cfg, &s_rx_delimiter);
    if (err != ESP_OK) return err;

    return parlio_rx_unit_enable(s_rx, false);
}

/* ----- PARLIO TX setup ----- */

static esp_err_t create_tx_unit(void)
{
    parlio_tx_unit_config_t cfg = {
        .clk_src               = PARLIO_CLK_SRC_DEFAULT,
        .clk_in_gpio_num       = -1,
        .input_clk_src_freq_hz = 0u,
        .output_clk_freq_hz    = DAC_RATE_HZ,
        .data_width            = 8u,
        .data_gpio_nums        = {-1, -1, -1, -1, -1, -1, -1, -1},
        .clk_out_gpio_num      = -1,
        .valid_gpio_num        = -1,
        .valid_start_delay     = 0,
        .valid_stop_delay      = 0,
        .trans_queue_depth     = 1u,
        .max_transfer_size     = sizeof(s_raw_ring),
        .dma_burst_size        = 32u,
        .shift_edge            = PARLIO_SHIFT_EDGE_NEG,
        .bit_pack_order        = PARLIO_BIT_PACK_ORDER_LSB,
    };

    for (unsigned i = 0; i < 8u; ++i) cfg.data_gpio_nums[i] = s_dac_gpio[i];

    esp_err_t err = parlio_new_tx_unit(&cfg, &s_tx);
    if (err != ESP_OK) return err;

    return ESP_OK;
}

esp_err_t prepare_tx(void)
{
    esp_err_t err = create_tx_unit();
    if (err != ESP_OK) return err;

    const bitscrambler_config_t bs_cfg = {
        .dir = BITSCRAMBLER_DIR_TX,
        .attach_to = SOC_BITSCRAMBLER_ATTACH_PARL_IO,
    };
    err = bitscrambler_new(&bs_cfg, &s_flight_bs);
    if (err != ESP_OK) return err;

    return parlio_tx_unit_enable(s_tx);
}

/* ----- Start RX cyclic ring ----- */

esp_err_t start_rx(void)
{
    esp_err_t err = parlio_rx_soft_delimiter_start_stop(s_rx, s_rx_delimiter, true);
    if (err != ESP_OK) return err;
    const parlio_receive_config_t cfg = {
        .delimiter = s_rx_delimiter,
        .flags = {
            .partial_rx_en   = true,
            .indirect_mount  = false,
        },
    };
    return parlio_rx_unit_receive(s_rx, s_raw_ring, sizeof(s_raw_ring), &cfg);
}

/* ----- Start TX loop ----- */

esp_err_t start_tx(void)
{
    /* Phase5 LUT is embedded in fm.bsasm -- no runtime bitscrambler_load_lut().
     * Hardware oracle v9 proved embedded LUT is byte-exact at 20 MS/s;
     * a separately preloaded LUT is NOT retained by the active PARLIO TX run. */
    const parlio_transmit_config_t cfg = {
        .idle_value          = DAC_IDLE_CODE,
        .bitscrambler_program = NULL, /* s_flight_bs is controlled explicitly */
        .flags.loop_transmission = true,  /* Infinite -- never generates downstream EOF */
    };
    /* TX reads sizeof(s_raw_ring) * 8 bits, then loops.
     * loop_transmission=true means PARLIO TX never stops; the BitScrambler
     * with eof_on=downstream therefore runs uninterrupted forever. */
    return parlio_tx_unit_transmit(s_tx, s_raw_ring,
                                   sizeof(s_raw_ring) * 8u, &cfg);
}

uint32_t get_rx_dma_offset(uint32_t *out_dscr_addr)
{
    if (s_rx_dma_ch < 0 || s_rx_dma_ch >= 3) return 0;
    uint32_t dscr_addr = AHB_DMA.channel[s_rx_dma_ch].in.in_dscr_bf0.val;
    if (out_dscr_addr) *out_dscr_addr = dscr_addr;
    if (dscr_addr >= 0x40800000u && dscr_addr < 0x40860000u) {
        dma_descriptor_t *dscr = (dma_descriptor_t *)(uintptr_t)dscr_addr;
        uint8_t *buf = (uint8_t *)dscr->buffer;
        if (buf >= s_raw_ring && buf < s_raw_ring + sizeof(s_raw_ring)) {
            return (uint32_t)(buf - s_raw_ring);
        }
    }
    return 0;
}

uint32_t get_tx_dma_offset(uint32_t *out_dscr_addr)
{
    if (s_tx_dma_ch < 0 || s_tx_dma_ch >= 3) return 0;
    uint32_t dscr_addr = AHB_DMA.channel[s_tx_dma_ch].out.out_dscr_bf0.val;
    if (out_dscr_addr) *out_dscr_addr = dscr_addr;
    if (dscr_addr >= 0x40800000u && dscr_addr < 0x40860000u) {
        dma_descriptor_t *dscr = (dma_descriptor_t *)(uintptr_t)dscr_addr;
        uint8_t *buf = (uint8_t *)dscr->buffer;
        if (buf >= s_raw_ring && buf < s_raw_ring + sizeof(s_raw_ring)) {
            return (uint32_t)(buf - s_raw_ring);
        }
    }
    return 0;
}

int find_dscr_index(const ring_dscr_node_t *nodes, int count, uint32_t addr)
{
    for (int i = 0; i < count; i++) {
        if ((uintptr_t)nodes[i].dscr == addr) return i;
    }
    return -1;
}

int patch_descriptors_clear_eof(int dma_ch, bool is_rx)
{
    if (dma_ch < 0 || dma_ch >= 3) return 0;
    uint32_t first_addr = is_rx ? AHB_DMA.channel[dma_ch].in.in_dscr_bf0.val
                                : AHB_DMA.channel[dma_ch].out.out_dscr_bf0.val;
    if (first_addr < 0x40800000u || first_addr >= 0x40860000u) return 0;

    dma_descriptor_t *curr = (dma_descriptor_t *)(uintptr_t)first_addr;
    int count = 0;
    if (is_rx) s_rx_dscr_count = 0;
    else s_tx_dscr_count = 0;

    while (curr && count < MAX_RING_DESCRIPTORS) {
        curr->dw0.suc_eof = 0;
        sync_dma_c2m(curr, sizeof(dma_descriptor_t));

        if (is_rx) {
            s_rx_dscr_nodes[count].dscr = curr;
            s_rx_dscr_nodes[count].buffer = (uint8_t *)curr->buffer;
            s_rx_dscr_nodes[count].length = curr->dw0.size ? curr->dw0.size : 4092u;
        } else {
            s_tx_dscr_nodes[count].dscr = curr;
            s_tx_dscr_nodes[count].buffer = (uint8_t *)curr->buffer;
            s_tx_dscr_nodes[count].length = curr->dw0.size ? curr->dw0.size : 4092u;
        }

        curr = curr->next;
        count++;
        if ((uintptr_t)curr == first_addr) break;
    }
    if (is_rx) s_rx_dscr_count = count;
    else s_tx_dscr_count = count;

    __asm__ __volatile__("fence rw, rw" ::: "memory");
    return count;
}

/* Capture validity, not merely a pointer to the previous DMA descriptor.
 * Never accept a copy that could have been lapped while this task was preempted. */
bool copy_completed_rx_window(uint8_t *dst, size_t bytes, size_t *ring_offset)
{
    if (s_rx_dma_ch < 0 || s_rx_dma_ch >= 3 || s_rx_dscr_count < 3) return false;
    int64_t start = esp_timer_get_time();
    uint32_t before = AHB_DMA.channel[s_rx_dma_ch].in.in_dscr_bf0.val;
    int active = find_dscr_index(s_rx_dscr_nodes, s_rx_dscr_count, before);
    if (active < 0) return false;
    int idx = (active - 1 + s_rx_dscr_count) % s_rx_dscr_count;
    uint8_t *src = s_rx_dscr_nodes[idx].buffer;
    if (!src || s_rx_dscr_nodes[idx].length < bytes || src < s_raw_ring ||
        src + bytes > s_raw_ring + sizeof(s_raw_ring)) return false;
    sync_dma_m2c(src, bytes);
    memcpy(dst, src, bytes);
    int after = find_dscr_index(s_rx_dscr_nodes, s_rx_dscr_count,
        AHB_DMA.channel[s_rx_dma_ch].in.in_dscr_bf0.val);
    /* Last descriptor can be shorter than 4092 bytes. Sum the actual nodes
     * DMA must cross before it can reuse this buffer, starting with zero
     * remaining time in the descriptor active at the first read. */
    uint64_t safe_bytes = 0;
    for (int k = 0; k < s_rx_dscr_count; ++k)
        if (k != active && k != idx) safe_bytes += s_rx_dscr_nodes[k].length;
    uint64_t safe_us = safe_bytes * 1000000ULL / IQ_RATE_HZ;
    int advance = after < 0 ? s_rx_dscr_count :
                  (after - active + s_rx_dscr_count) % s_rx_dscr_count;
    bool ok = after >= 0 && after != idx && advance < s_rx_dscr_count - 1 &&
              (uint64_t)(esp_timer_get_time() - start) < safe_us;
    if (ok && ring_offset) *ring_offset = (size_t)(src - s_raw_ring);
    return ok;
}

/* Pick a descriptor that RX has already completed, rather than sampling a
 * fixed address that GDMA may be overwriting at the same instant. The control
 * loop now consumes one complete 4092-byte descriptor per 50 ms evaluation. */
uint8_t *get_completed_rx_sample_window(size_t bytes)
{
    if (s_rx_dma_ch < 0 || s_rx_dma_ch >= 3 || s_rx_dscr_count < 2) {
        return s_raw_ring;
    }

    uint32_t current_addr = AHB_DMA.channel[s_rx_dma_ch].in.in_dscr_bf0.val;
    int current_idx = find_dscr_index(s_rx_dscr_nodes, s_rx_dscr_count, current_addr);
    if (current_idx < 0) {
        return s_raw_ring;
    }

    for (int back = 1; back < s_rx_dscr_count; ++back) {
        int idx = (current_idx - back + s_rx_dscr_count) % s_rx_dscr_count;
        uint8_t *buf = s_rx_dscr_nodes[idx].buffer;
        uint32_t len = s_rx_dscr_nodes[idx].length;
        if (buf && len >= bytes &&
            buf >= s_raw_ring && (buf + bytes) <= (s_raw_ring + sizeof(s_raw_ring))) {
            return buf;
        }
    }
    return s_raw_ring;
}

/* Copy four separated 64-byte regions of the latest completed RX descriptor.
 * Never touches a descriptor still owned by the RX DMA engine and never
 * participates in the 40 MS/s video clock. Returns false for a stale/slow copy. */

bool rx_probe_copy_completed_idx(uint8_t sample[RX_PROBE_REGIONS * RX_PROBE_REGION_BYTES],
                                        int *out_idx)
{
    static const size_t offset[RX_PROBE_REGIONS] = {512u, 1536u, 2560u, 4028u};
    if (s_rx_dma_ch < 0 || s_rx_dma_ch >= 3 || s_rx_dscr_count < 2)
        return false;
    int64_t copy_start_us = esp_timer_get_time();
    uint32_t active_addr = AHB_DMA.channel[s_rx_dma_ch].in.in_dscr_bf0.val;
    int active_idx = find_dscr_index(s_rx_dscr_nodes, s_rx_dscr_count,
                                     active_addr);
    if (active_idx < 0) return false;
    int sample_idx = (active_idx - 1 + s_rx_dscr_count) % s_rx_dscr_count;
    uint8_t *src = s_rx_dscr_nodes[sample_idx].buffer;
    if (!src || s_rx_dscr_nodes[sample_idx].length < 4092u ||
        src < s_raw_ring || src + 4092u > s_raw_ring + sizeof(s_raw_ring))
        return false;
    for (unsigned i = 0; i < RX_PROBE_REGIONS; ++i) {
        sync_dma_m2c(src + offset[i], RX_PROBE_REGION_BYTES);
        memcpy(sample + i * RX_PROBE_REGION_BYTES, src + offset[i],
               RX_PROBE_REGION_BYTES);
    }
    if (esp_timer_get_time() - copy_start_us > 300) return false;
    active_addr = AHB_DMA.channel[s_rx_dma_ch].in.in_dscr_bf0.val;
    if (out_idx) *out_idx = sample_idx;
    return find_dscr_index(s_rx_dscr_nodes, s_rx_dscr_count,
                           active_addr) != sample_idx;
}

bool rx_probe_copy_completed(uint8_t sample[RX_PROBE_REGIONS * RX_PROBE_REGION_BYTES])
{
    return rx_probe_copy_completed_idx(sample, NULL);
}

void quiet_tx_interrupts(void)
{
    AHB_DMA.out_intr[s_tx_dma_ch].ena.val = 0;
    AHB_DMA.out_intr[s_tx_dma_ch].clr.val = UINT32_MAX;
    PARL_IO.int_ena.val = 0;
}

static bool s_running_edge = true;    /* FusionDemod: which program runs */

static const void *pair_program(void)
{
#if C5VRX4_RANGE_OPTION_COUNT
    for (unsigned i = 0; i < C5VRX4_RANGE_OPTION_COUNT; ++i)
        if (!strcmp(c5vrx4_range_options[i].model_id, C5VRX4_PAIR_MODEL_ID) &&
            c5vrx4_range_options[i].selectable)
            return range_option_program(i);
#endif
    return NULL;
}

/* Load a program and apply AutoFit in the halted window (engine stopped
 * from load until the caller's reset/start). Caller holds the HW lock. */
static esp_err_t load_with_fit(const void *program, int kind)
{
    c5v4_fit_set_program(kind);
    esp_err_t err = bitscrambler_load_program(s_flight_bs, program);
    if (err != ESP_OK) return err;
    c5v4_level_hw_prepare();
    c5v4_fit_window(true);
    (void)autofit_apply_stopped();      /* failure leaves the pristine words */
    c5v4_fit_window(false);
    return ESP_OK;
}

static int selected_fit_kind(void)
{
    if (!c5vrx4_autofit_enabled()) return C5V4_FIT_NONE;
    if (c5vrx4_omega_demod()) return C5V4_FIT_OMEGA;
    if (c5vrx4_edge_autofit_demod()) return s_running_edge ? C5V4_FIT_EDGE : C5V4_FIT_PAIR;
    if (c5vrx4_pair_autofit_demod()) return C5V4_FIT_PAIR;
    return C5V4_FIT_NONE;
}

static const void *running_program(void)
{
    if (c5vrx4_edge_autofit_demod() && !s_running_edge && pair_program()) return pair_program();
    return c5vrx4_selected_program();
}

/* Live program change (FusionDemod swap or an AutoFit reload): load with
 * fit, reset, run. Any failure reloads the previous program; the running
 * state changes only on success. Continuity of a live load is a physical
 * gate (review 2026-10-09): count swaps/reloads against tx_empty. */
static bool live_load(bool edge)
{
    if (!c5vrx4_edge_autofit_demod() && !c5vrx4_pair_autofit_demod()) return false;
    if (c5vrx4_edge_autofit_demod() && !edge && !pair_program()) return false;
    bool previous = s_running_edge;
    int64_t t0 = esp_timer_get_time();
    c5v4_level_hw_lock();
    s_running_edge = edge;
    esp_err_t err = load_with_fit(running_program(), selected_fit_kind());
    if (err == ESP_OK) err = bitscrambler_reset(s_flight_bs);
    if (err == ESP_OK) err = bitscrambler_start(s_flight_bs);
    if (err != ESP_OK) {
        s_running_edge = previous;
        esp_err_t back = load_with_fit(running_program(), selected_fit_kind());
        if (back == ESP_OK) back = bitscrambler_reset(s_flight_bs);
        if (back == ESP_OK) back = bitscrambler_start(s_flight_bs);
        printf("FLIGHT_LOAD failed=%s rollback=%s\n", esp_err_to_name(err), esp_err_to_name(back));
    }
    c5v4_level_hw_unlock();
    s_load_us_last = (uint32_t)(esp_timer_get_time() - t0);
    if (s_load_us_last > s_load_us_max) s_load_us_max = s_load_us_last;
    return err == ESP_OK;
}

bool flight_swap_program(bool edge) { return c5vrx4_edge_autofit_demod() && live_load(edge); }
bool flight_reload_program(void) { return live_load(s_running_edge); }

void start_flight_demodulator(void)
{
    c5v4_level_hw_lock();
    ESP_ERROR_CHECK(bitscrambler_enable(s_flight_bs));
    ESP_ERROR_CHECK(load_with_fit(running_program(), selected_fit_kind()));
    if (!c5vrx4_reference_demod() && (!c5v4_level_hw_lut_verified() ||
        (c5vrx4_level_enabled() && !c5v4_level_hw_ready()))) {
        /* A failed addressing probe is repaired from the pristine binary. */
        ESP_ERROR_CHECK(bitscrambler_load_program(s_flight_bs, running_program()));
    }
    ESP_ERROR_CHECK(bitscrambler_reset(s_flight_bs));
    ESP_ERROR_CHECK(bitscrambler_start(s_flight_bs));
    c5v4_level_hw_unlock();
}

/* Restore the exact live topology used after leaving the standalone menu.
 * The self-noise probe intentionally destroys/recreates the TX unit so the
 * quiet state can disconnect PARLIO from every DAC GPIO instead of merely
 * freezing a clock with unknown FIFO/BitScrambler side effects. */
