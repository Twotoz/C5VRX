## main/Kconfig.projbuild
```kconfig
menu "C5VRX digital video tap"

choice C5VRX_OUTPUT_PINS
    prompt "Output pins: DAC width and sample clock"
    default C5VRX_OUT_DAC6
    help
        GPIO2 (MTMS) is one shared pin. The sync flywheel was removed, so it
        is either the clock pin, a DAC pin or a future button pin; for now
        its role is the 40 MHz clock. Choose one of: 6- or 7-bit DAC with
        the clock, or 8-bit DAC without it. Extra DAC bits extend the
        ladder below the existing LSB (D4/GPIO23): D10/GPIO10 is the bit
        just below it, GPIO2 the lowest. The live P64 program still emits
        6-bit codes, so the extra bits are reserved and held low (the 7/8-bit
        ladder then reproduces today's 6-bit waveform) until a wider demod
        program drives them. The 7- and 8-bit options need D10/GPIO10, which
        stays the IQ I-LSB loopback until PR #259 (IQ on GPIO27) is merged;
        the build stops with an error before that.

config C5VRX_OUT_DAC6
    bool "6-bit DAC, no clock (standard)"

config C5VRX_OUT_DAC6_CLOCK
    bool "6-bit DAC + 40 MHz sample clock on GPIO2"
    help
        Export the 40 MHz TX clock alongside the six DAC data pins for an
        external digital receiver. Data shifts on the falling edge; sample
        on rising. This is a 6-bit composite waveform, not decoded pixels.
        Added for the FPGA integration in issue #256, not required for analog
        reception. If unused in future, this optional feature may be removed;
        transport_clock.h documents its purpose and removal scope.

config C5VRX_OUT_DAC7_CLOCK
    bool "7-bit DAC (extra LSB on D10/GPIO10) + sample clock on GPIO2"

config C5VRX_OUT_DAC8
    bool "8-bit DAC (extra LSBs on D10/GPIO10 and GPIO2), no clock"

endchoice

config C5VRX_PARLIO_SAMPLE_CLOCK
    bool
    default y if C5VRX_OUT_DAC6_CLOCK || C5VRX_OUT_DAC7_CLOCK

config C5VRX_DAC_BITS
    int
    default 8 if C5VRX_OUT_DAC8
    default 7 if C5VRX_OUT_DAC7_CLOCK
    default 6

endmenu
```

## tools/cpu_phase_bench/sdkconfig.defaults
```kconfig
CONFIG_ESP_DEFAULT_CPU_FREQ_MHZ_240=y
CONFIG_ESP_CONSOLE_USB_SERIAL_JTAG=y
CONFIG_PARTITION_TABLE_SINGLE_APP=y
```
