/**
 * video.c - Realtime MODEM_DIAG -> PARLIO RX -> 16K ring -> Phase5 TX -> DAC.
 *
 * Implements the complete production datapath for C5VRX-3:
 *
 *   MODEM_DIAG full Q4/I4 @ 40 MS/s
 *     -> PARLIO RX POS edge @ 40 MHz
 *     -> 16 KiB cyclic raw DMA ring (HP SRAM)
 *     -> PARLIO TX @ 40 MHz + Phase5 TX BitScrambler (fm.bsasm)
 *     -> [D,D] 6-bit CVBS @ 20 MS/s unique / 40 MHz DAC clock
 *     -> 6-bit resistor DAC
 *
 * Reference: Seamless Golden 16K (build-golden-notel) -- proven best live build.
 *
 * Fixed production constants (NOT configurable at runtime):
 *   IQ rate:        40 MHz
 *   DAC rate:       40 MHz physical ([D,D] = 20 MS/s unique CVBS)
 *   Ring:           16384 bytes (HP SRAM, DMA-aligned)
 *   Pedestal:       20   (hardcoded in FM LUT)
 *   Gain:           2    (hardcoded in FM LUT)
 *   Polarity:       current-minus-previous (hardcoded in FM LUT)
 *   RX sample edge: POS
 *   TX shift edge:  NEG
 *   BS EOF:         downstream (PARLIO TX loop never generates downstream EOF)
 *   BS tail:        0 bytes
 *
 * DMA owns sample pacing; tasks handle AGC, buttons and console commands.
 */

#include "video.h"
#include "rf.h"
#include "menu_font.h"
#include "menu_raster.h"
#include "range_control.h"
#include "demod_quality.h"
#include "hal/parlio_ll.h"
#include "hal/usb_serial_jtag_ll.h"
#include "link.h"
#include "sdkconfig.h"

/* The link dumps hex blocks on the console; background status lines must
 * not land inside them. The final link build prints nothing while running. */
#if CONFIG_C5VRX_LINK_MODE && !CONFIG_C5VRX_LINK_DEBUG
#define AGC_PRINTF(...) do { } while (0)
#else
#define AGC_PRINTF(...) do { if (!link_dump_active()) printf(__VA_ARGS__); } while (0)
#endif

#include <stdint.h>
#include <string.h>
#include <fcntl.h>
#include <unistd.h>

#include "driver/usb_serial_jtag_vfs.h"
#include "driver/bitscrambler.h"
#include "driver/gpio.h"
#include "driver/parlio_rx.h"
#include "driver/parlio_tx.h"
#include "esp_attr.h"
#include "esp_cache.h"
#include "esp_log.h"
#include "nvs.h"
#include "esp_rom_sys.h"
#include "esp_timer.h"
#include "freertos/FreeRTOS.h"
#include "freertos/queue.h"
#include "freertos/task.h"
#include "soc/parl_io_struct.h"
#include "soc/bitscrambler_struct.h"
#include "soc/ahb_dma_struct.h"
#include "soc/pcr_struct.h"
#include "modem/modem_syscon_reg.h"
#include "hal/dma_types.h"
#include "esp_clock_output.h"

/* Hardware diagnostic counters in IRAM to measure transport hiccups without printf spam */
typedef struct {
    uint32_t parl_rx_wovf_count;
    uint32_t parl_tx_rempty_count;
    uint32_t parl_tx_eof_count;
    uint32_t gdma_in_fault_count;
    uint32_t gdma_out_fault_count;
    uint32_t bs_fifo_empty_count;
    uint32_t bs_eof_overload_count;
    uint32_t lag_event_count;
    uint32_t near_gain_event_count;
    uint32_t near_phy_event_count;
    uint32_t gain_quality_drop_count;
    uint32_t user_lag_mark_count;
    uint32_t checks;
} hw_transport_counters_t;

enum {
    LAG_EVT_PARLIO_TX_REMPTY = 1u << 0,
    LAG_EVT_PARLIO_RX_WOVF   = 1u << 1,
    LAG_EVT_PARLIO_TX_EOF    = 1u << 2,
    LAG_EVT_GDMA_IN_FAULT    = 1u << 3,
    LAG_EVT_GDMA_OUT_FAULT   = 1u << 4,
    LAG_EVT_BS_EOF_OVERLOAD  = 1u << 5,
};

enum {
    PHY_WRITE_NONE   = 0,
    PHY_WRITE_GAIN   = 1,
    PHY_WRITE_BW     = 2,
    PHY_WRITE_OFFSET = 3,
    PHY_WRITE_FFT    = 4,
    PHY_WRITE_HW_AGC = 5,
};

#define LAG_EVENT_LOG_SIZE 12u
#define GDMA_IN_FAULT_MASK  0xfcu /* ERR_EOF, DSCR_ERR/EMPTY, FIFO OVF/UDF, AHB response */
#define GDMA_OUT_FAULT_MASK 0x7cu /* DSCR_ERR, TOTAL_EOF, FIFO OVF/UDF, AHB response */

typedef struct {
    int64_t time_us;
    uint32_t seq;
    uint32_t flags;
    uint16_t rx_off;
    uint16_t tx_off;
    uint8_t gain;
    uint8_t agc_state;
} lag_event_t;

static volatile hw_transport_counters_t s_hw_counters;
static lag_event_t s_lag_events[LAG_EVENT_LOG_SIZE];
static volatile uint32_t s_lag_event_head;
static volatile int64_t s_last_gain_write_us;
static volatile int64_t s_last_phy_write_us;
static volatile uint8_t s_last_phy_write_kind;
static volatile int64_t s_last_transport_event_us;
static volatile uint32_t s_last_transport_flags;
static volatile uint32_t s_last_gain_drop_transition;
static volatile int64_t s_last_user_lag_mark_us;

/* fm.bsasm program symbol generated by target_bitscrambler_add_src(). */
BITSCRAMBLER_PROGRAM(s_fm_program, "fm");
BITSCRAMBLER_PROGRAM(s_fm4_program, "fm4");

/* ----- Fixed production constants ----- */
#define IQ_RATE_HZ       40000000u   /* MODEM_DIAG / PARLIO RX clock */
#define DAC_RATE_HZ      40000000u   /* default 6-bit PARLIO TX clock */
#define DAC4_RATE_HZ     80000000u   /* experimental 4-bit PARLIO TX clock */
#define RAW_RING_BYTES   16384u      /* 16384 byte cyclic ring (16 KiB Seamless Golden) */
#define DAC_IDLE_CODE    20u         /* Black/blanking pedestal; sync is 0 */
#define BOOT_BTN_GPIO    GPIO_NUM_28 /* Seeed Studio XIAO ESP32-C5 BOOT Button */
#define MENU_RUNTIME_ENABLED 1       /* Native CVBS menu enabled after geometry rework */
#define CONTROL_SAMPLE_BYTES 4092u  /* one complete, already-finished GDMA descriptor */
#define GAIN_SETTLE_TICKS 10        /* 500 ms decision hold after a physical gain write */
#define GAIN_SEARCH_PROBE_TICKS 20  /* 1.0 s between no-carrier sensitivity probes */
#define PERIODIC_TELEMETRY 0        /* keep live control path silent; diagnostics are on-demand */
#define LAB_GAIN_MIN       2u        /* production controller lower bound */
#define LAB_GAIN_MAX       62u       /* production controller upper bound */
#define LAB_GAIN_STEP      2u        /* characterize the states production actually uses */
#define LAB_GAIN_SETTLE_MS 700u      /* measure after the existing 500 ms gain hold */
#define LAB_GAIN_DWELL_MS  1000u     /* one second per state for scope/video correlation */
#define LAB_FFT_SETTLE_MS  550u      /* FFT probe: wait beyond one control/settle interval */
#define LAB_FFT_DWELL_MS   750u      /* short bounded dwell; lab-only, never production */
#define LAB_BW_SETTLE_MS   800u      /* allow analog filter change before measurement */

typedef enum {
    VIDEO_STD_MODE_AUTO = 0,
    VIDEO_STD_MODE_NTSC = 1,
    VIDEO_STD_MODE_PAL  = 2,
} video_standard_mode_t;

static volatile video_standard_mode_t s_video_std_mode = VIDEO_STD_MODE_AUTO;
static volatile video_standard_t s_video_std = VIDEO_STD_NTSC;
static volatile video_standard_t s_detected_video_std = VIDEO_STD_NTSC;
static volatile bool s_detected_video_std_valid;
static volatile uint8_t s_video_std_pal_score;
static volatile uint8_t s_video_std_ntsc_score;
static volatile uint16_t s_last_line_period_20m;
static volatile uint16_t s_last_sync_width_20m;
static volatile int s_last_sync_quality;
static QueueHandle_t s_menu_commands;
static bitscrambler_handle_t s_flight_bs;

/* Cache synchronization helpers for DMA buffers and descriptors on ESP32-C5.
 * Aligns address down and size up to 64-byte cache line boundaries so esp_cache_msync
 * never fails with ESP_ERR_INVALID_ARG on unaligned descriptors or buffers. */
static inline void sync_dma_c2m(const void *addr, size_t size)
{
    if (!addr || size == 0) return;
    uint32_t start = (uint32_t)addr & ~(64u - 1u);
    uint32_t end = ((uint32_t)addr + size + 63u) & ~(64u - 1u);
    (void)esp_cache_msync((void *)start, end - start,
                          ESP_CACHE_MSYNC_FLAG_DIR_C2M | ESP_CACHE_MSYNC_FLAG_UNALIGNED);
}

static inline void sync_dma_m2c(const void *addr, size_t size)
{
    if (!addr || size == 0) return;
    uint32_t start = (uint32_t)addr & ~(64u - 1u);
    uint32_t end = ((uint32_t)addr + size + 63u) & ~(64u - 1u);
    (void)esp_cache_msync((void *)start, end - start,
                          ESP_CACHE_MSYNC_FLAG_DIR_M2C | ESP_CACHE_MSYNC_FLAG_UNALIGNED);
}

/* Timing and descriptors are immutable while running; only text pixels change.
 * This raster is never linked to the RF ring. */
#if CONFIG_C5VRX_LINK_MODE
/* Link mode drives no PARLIO TX, so the menu never starts (video_set_menu_mode()
 * returns at once) and its raster plus descriptor chain would waste the 166 KiB
 * of DRAM the frame grabber needs. Only a stub is allocated: the menu code below
 * still compiles, with MENU_NODE_CAPACITY keeping its one bounds check honest. */
static DMA_ATTR __attribute__((aligned(64))) uint8_t s_menu_raster_stub[sizeof(menu_raster_t) < 64u ? sizeof(menu_raster_t) : 64u];
static DMA_ATTR __attribute__((aligned(64))) dma_descriptor_t s_menu_nodes[1];
#define s_menu_raster (*(menu_raster_t *)s_menu_raster_stub)
#define MENU_NODE_CAPACITY 1u
#else
static DMA_ATTR __attribute__((aligned(64))) menu_raster_t s_menu_raster;
static DMA_ATTR __attribute__((aligned(64))) dma_descriptor_t s_menu_nodes[MENU_MAX_NODES];
#define MENU_NODE_CAPACITY MENU_MAX_NODES
#endif
/* AGC sampling and channel scan are serialized in analog_agc_task, so they
 * share one descriptor-sized CPU snapshot instead of reserving 8 KiB. */
static uint8_t s_control_sample_buf[CONTROL_SAMPLE_BYTES];
static unsigned s_menu_node_count;
static volatile bool s_menu_active;
static volatile bool s_menu_boot_btn_enabled = true;
static volatile int s_menu_cursor;
static int s_menu_timeout_ticks;

typedef enum {
    RF_BW_MODE_BW40 = 0,
    RF_BW_MODE_BW20 = 1,
    RF_BW_MODE_AUTO = 2,
} rf_bw_mode_t;

typedef enum {
    VIDEO_OUTPUT_6BIT_40 = 0,
    VIDEO_OUTPUT_4BIT_80 = 1,
} video_output_mode_t;

typedef enum {
    RX_PROFILE_BALANCED = 0,
    RX_PROFILE_RANGE_EXP,
    RX_PROFILE_BLOCKER_EXP,
    RX_PROFILE_RECOVERY_EXP,
    RX_PROFILE_AUTO_EXP,
    RX_PROFILE_HW_AGC_EXP,
    RX_PROFILE_COUNT,
} rx_profile_t;

static volatile rf_bw_mode_t s_rf_bw_mode = RF_BW_MODE_BW40;
static volatile bool s_current_bw40 = true;
static volatile video_output_mode_t s_output_mode = VIDEO_OUTPUT_6BIT_40;
static video_output_mode_t s_tx_unit_mode = VIDEO_OUTPUT_6BIT_40;
static volatile rx_profile_t s_rx_profile = RX_PROFILE_RANGE_EXP;
static volatile uint32_t s_profile_generation;
static volatile bool s_profile_fft_forced;
static volatile bool s_fft_q4_effect_known;
static volatile bool s_fft_q4_effective;
static volatile int8_t s_fft_best_value;
static volatile int s_last_noise_floor_dbm = -127;
static volatile int s_last_phy_rssi_dbm = -127;
static volatile bool s_noise_floor_valid;
static volatile bool s_phy_rssi_valid;

/* TX GPIO mapping: 6-bit resistor DAC.
 * Order: DAC bit 0 (LSB) .. DAC bit 5 (MSB) on data_gpio_nums[0..5].
 * Bits 6..7 unused (set to -1).
 * Verified against C5VRX-2 realtime.c (standard 8-bit PARLIO TX, non-parlio4). */
static const int s_dac_gpio[8] = {23, 24, 11, 12, 8, 9, -1, -1};
/* 4-bit mode drives the four MSB resistor branches: weights 4/8/16/32. */
static const int s_dac4_gpio[4] = {11, 12, 8, 9};

_Static_assert(IQ_RATE_HZ == 40000000u, "IQ rate must be 40 MHz");
_Static_assert(DAC_RATE_HZ == 40000000u, "DAC rate must be 40 MHz");
_Static_assert(RAW_RING_BYTES == 16384u, "Ring must be exactly 16384 bytes");
_Static_assert(CONTROL_SAMPLE_BYTES <= 4092u, "Control window must fit one GDMA descriptor");

static const char *TAG = "c5vrx3_video";

/* DMA-aligned ring buffer in HP SRAM.
 * RX GDMA writes at 40 MB/s; TX GDMA reads at 40 MB/s.
 * TX starts one block (4096 bytes = 102.4 Âµs) behind RX; they share
 * PLL_F240M/6, so separation cannot drift during normal operation. */
static DMA_ATTR __attribute__((aligned(64))) uint8_t s_raw_ring[RAW_RING_BYTES];

static parlio_rx_unit_handle_t      s_rx;
static parlio_rx_delimiter_handle_t s_rx_delimiter;
static parlio_tx_unit_handle_t      s_tx;

/* ----- PARLIO RX setup ----- */

static esp_err_t prepare_rx(void)
{
    /* Proven PARLIO RX config with clean internal SPLL clock */
    const parlio_rx_unit_config_t cfg = {
        .trans_queue_depth = 1u,
        .max_recv_size     = sizeof(s_raw_ring),
        .dma_burst_size    = 32u,
        .data_width        = 8u,
        .clk_src           = PARLIO_CLK_SRC_DEFAULT,
        .ext_clk_freq_hz   = 0u,
        .exp_clk_freq_hz   = IQ_RATE_HZ,
        .clk_in_gpio_num   = -1,
        .clk_out_gpio_num  = -1,
        .valid_gpio_num    = -1,
        /* GPIO order must match s_iq_pins[] in rf.c:
         * Q[9:6] on GPIO 1,0,25,7 then I[9:6] on GPIO 10,5,3,4. */
        .data_gpio_nums    = {
            GPIO_NUM_1, GPIO_NUM_0, GPIO_NUM_25, GPIO_NUM_7,
            GPIO_NUM_10, GPIO_NUM_5, GPIO_NUM_3, GPIO_NUM_4,
        },
        .flags = {
            .free_clk    = true,   /* RX clock is derived from PHY, not gated */
            .clk_gate_en = false,
            .allow_pd    = false,
        },
    };
    esp_err_t err = parlio_new_rx_unit(&cfg, &s_rx);
    if (err != ESP_OK) return err;

    /* Soft delimiter in infinite (partial_rx_en) mode.
     * POS sample edge -- proven correct for internal clock. */
    const parlio_rx_soft_delimiter_config_t delim_cfg = {
        .sample_edge  = PARLIO_SAMPLE_EDGE_POS,
        .bit_pack_order = PARLIO_BIT_PACK_ORDER_LSB,
        .eof_data_len = sizeof(s_raw_ring),
        .timeout_ticks = 0u,
    };
    err = parlio_new_rx_soft_delimiter(&delim_cfg, &s_rx_delimiter);
    if (err != ESP_OK) return err;

    return parlio_rx_unit_enable(s_rx, false);
}

/* ----- PARLIO TX setup ----- */

static esp_err_t create_tx_unit(video_output_mode_t mode)
{
    const bool four_bit = mode == VIDEO_OUTPUT_4BIT_80;
    parlio_tx_unit_config_t cfg = {
        .clk_src               = PARLIO_CLK_SRC_DEFAULT,
        .clk_in_gpio_num       = -1,
        .input_clk_src_freq_hz = 0u,
        .output_clk_freq_hz    = four_bit ? DAC4_RATE_HZ : DAC_RATE_HZ,
        .data_width            = four_bit ? 4u : 8u,
        .data_gpio_nums        = {-1, -1, -1, -1, -1, -1, -1, -1},
        .clk_out_gpio_num      = -1,
        .valid_gpio_num        = -1,
        .valid_start_delay     = 0,
        .valid_stop_delay      = 0,
        .trans_queue_depth     = 1u,
        .max_transfer_size     = sizeof(s_raw_ring),
        .dma_burst_size        = 32u,
        .shift_edge            = PARLIO_SHIFT_EDGE_NEG,
        .bit_pack_order        = PARLIO_BIT_PACK_ORDER_LSB,
    };

    if (four_bit) {
        for (unsigned i = 0; i < 4u; ++i) cfg.data_gpio_nums[i] = s_dac4_gpio[i];
    } else {
        for (unsigned i = 0; i < 8u; ++i) cfg.data_gpio_nums[i] = s_dac_gpio[i];
    }

    esp_err_t err = parlio_new_tx_unit(&cfg, &s_tx);
    if (err != ESP_OK) return err;

    /* Keep the two unused LSB resistor branches low in 4-bit mode so the
     * existing six-resistor DAC can be used without rewiring. */
    if (four_bit) {
        gpio_set_direction((gpio_num_t)s_dac_gpio[0], GPIO_MODE_OUTPUT);
        gpio_set_direction((gpio_num_t)s_dac_gpio[1], GPIO_MODE_OUTPUT);
        gpio_set_level((gpio_num_t)s_dac_gpio[0], 0);
        gpio_set_level((gpio_num_t)s_dac_gpio[1], 0);
    }

    s_tx_unit_mode = mode;
    return ESP_OK;
}

static esp_err_t replace_tx_unit(video_output_mode_t mode)
{
    esp_err_t err = parlio_del_tx_unit(s_tx);
    if (err != ESP_OK) return err;
    s_tx = NULL;
    return create_tx_unit(mode);
}

static esp_err_t prepare_tx(void)
{
    esp_err_t err = create_tx_unit(s_output_mode);
    if (err != ESP_OK) return err;

    const bitscrambler_config_t bs_cfg = {
        .dir = BITSCRAMBLER_DIR_TX,
        .attach_to = SOC_BITSCRAMBLER_ATTACH_PARL_IO,
    };
    err = bitscrambler_new(&bs_cfg, &s_flight_bs);
    if (err != ESP_OK) return err;

    return parlio_tx_unit_enable(s_tx);
}

/* ----- Start RX cyclic ring ----- */

static esp_err_t start_rx(void)
{
    esp_err_t err = parlio_rx_soft_delimiter_start_stop(s_rx, s_rx_delimiter, true);
    if (err != ESP_OK) return err;
    const parlio_receive_config_t cfg = {
        .delimiter = s_rx_delimiter,
        .flags = {
            .partial_rx_en   = true,
            .indirect_mount  = false,
        },
    };
    return parlio_rx_unit_receive(s_rx, s_raw_ring, sizeof(s_raw_ring), &cfg);
}

/* ----- Start TX loop ----- */

static esp_err_t start_tx(void)
{
    /* Phase5 LUT is embedded in fm.bsasm -- no runtime bitscrambler_load_lut().
     * Hardware oracle v9 proved embedded LUT is byte-exact at 20 MS/s;
     * a separately preloaded LUT is NOT retained by the active PARLIO TX run. */
    const parlio_transmit_config_t cfg = {
        .idle_value          = s_output_mode == VIDEO_OUTPUT_4BIT_80 ? (DAC_IDLE_CODE >> 2) : DAC_IDLE_CODE,
        .bitscrambler_program = NULL, /* s_flight_bs is controlled explicitly */
        .flags.loop_transmission = true,  /* Infinite -- never generates downstream EOF */
    };
    /* TX reads sizeof(s_raw_ring) * 8 bits, then loops.
     * loop_transmission=true means PARLIO TX never stops; the BitScrambler
     * with eof_on=downstream therefore runs uninterrupted forever. */
    return parlio_tx_unit_transmit(s_tx, s_raw_ring,
                                   sizeof(s_raw_ring) * 8u, &cfg);
}

static int s_rx_dma_ch = -1;
static int s_tx_dma_ch = -1;

static inline uint32_t get_rx_dma_offset(uint32_t *out_dscr_addr)
{
    if (s_rx_dma_ch < 0 || s_rx_dma_ch >= 3) return 0;
    uint32_t dscr_addr = AHB_DMA.channel[s_rx_dma_ch].in.in_dscr_bf0.val;
    if (out_dscr_addr) *out_dscr_addr = dscr_addr;
    if (dscr_addr >= 0x40800000u && dscr_addr < 0x40860000u) {
        dma_descriptor_t *dscr = (dma_descriptor_t *)(uintptr_t)dscr_addr;
        uint8_t *buf = (uint8_t *)dscr->buffer;
        if (buf >= s_raw_ring && buf < s_raw_ring + sizeof(s_raw_ring)) {
            return (uint32_t)(buf - s_raw_ring);
        }
    }
    return 0;
}

static inline uint32_t get_tx_dma_offset(uint32_t *out_dscr_addr)
{
    if (s_tx_dma_ch < 0 || s_tx_dma_ch >= 3) return 0;
    uint32_t dscr_addr = AHB_DMA.channel[s_tx_dma_ch].out.out_dscr_bf0.val;
    if (out_dscr_addr) *out_dscr_addr = dscr_addr;
    if (dscr_addr >= 0x40800000u && dscr_addr < 0x40860000u) {
        dma_descriptor_t *dscr = (dma_descriptor_t *)(uintptr_t)dscr_addr;
        uint8_t *buf = (uint8_t *)dscr->buffer;
        if (buf >= s_raw_ring && buf < s_raw_ring + sizeof(s_raw_ring)) {
            return (uint32_t)(buf - s_raw_ring);
        }
    }
    return 0;
}

#define MAX_RING_DESCRIPTORS 16

typedef struct {
    dma_descriptor_t *dscr;
    uint8_t *buffer;
    uint32_t length;
} ring_dscr_node_t;

static ring_dscr_node_t s_rx_dscr_nodes[MAX_RING_DESCRIPTORS];
static int s_rx_dscr_count = 0;

static ring_dscr_node_t s_tx_dscr_nodes[MAX_RING_DESCRIPTORS];
static int s_tx_dscr_count = 0;

static inline int find_dscr_index(const ring_dscr_node_t *nodes, int count, uint32_t addr)
{
    for (int i = 0; i < count; i++) {
        if ((uintptr_t)nodes[i].dscr == addr) return i;
    }
    return -1;
}

static int patch_descriptors_clear_eof(int dma_ch, bool is_rx)
{
    if (dma_ch < 0 || dma_ch >= 3) return 0;
    uint32_t first_addr = is_rx ? AHB_DMA.channel[dma_ch].in.in_dscr_bf0.val
                                : AHB_DMA.channel[dma_ch].out.out_dscr_bf0.val;
    if (first_addr < 0x40800000u || first_addr >= 0x40860000u) return 0;

    dma_descriptor_t *curr = (dma_descriptor_t *)(uintptr_t)first_addr;
    int count = 0;
    if (is_rx) s_rx_dscr_count = 0;
    else s_tx_dscr_count = 0;

    while (curr && count < MAX_RING_DESCRIPTORS) {
        curr->dw0.suc_eof = 0;
        sync_dma_c2m(curr, sizeof(dma_descriptor_t));

        if (is_rx) {
            s_rx_dscr_nodes[count].dscr = curr;
            s_rx_dscr_nodes[count].buffer = (uint8_t *)curr->buffer;
            s_rx_dscr_nodes[count].length = curr->dw0.size ? curr->dw0.size : 4092u;
        } else {
            s_tx_dscr_nodes[count].dscr = curr;
            s_tx_dscr_nodes[count].buffer = (uint8_t *)curr->buffer;
            s_tx_dscr_nodes[count].length = curr->dw0.size ? curr->dw0.size : 4092u;
        }

        curr = curr->next;
        count++;
        if ((uintptr_t)curr == first_addr) break;
    }
    if (is_rx) s_rx_dscr_count = count;
    else s_tx_dscr_count = count;

    __asm__ __volatile__("fence rw, rw" ::: "memory");
    return count;
}

/* Pick a descriptor that RX has already completed, rather than sampling a
 * fixed address that GDMA may be overwriting at the same instant. The control
 * loop now consumes one complete 4092-byte descriptor per 50 ms evaluation. */
static uint8_t *get_completed_rx_sample_window(size_t bytes)
{
    if (s_rx_dma_ch < 0 || s_rx_dma_ch >= 3 || s_rx_dscr_count < 2) {
        return s_raw_ring;
    }

    uint32_t current_addr = AHB_DMA.channel[s_rx_dma_ch].in.in_dscr_bf0.val;
    int current_idx = find_dscr_index(s_rx_dscr_nodes, s_rx_dscr_count, current_addr);
    if (current_idx < 0) {
        return s_raw_ring;
    }

    for (int back = 1; back < s_rx_dscr_count; ++back) {
        int idx = (current_idx - back + s_rx_dscr_count) % s_rx_dscr_count;
        uint8_t *buf = s_rx_dscr_nodes[idx].buffer;
        uint32_t len = s_rx_dscr_nodes[idx].length;
        if (buf && len >= bytes &&
            buf >= s_raw_ring && (buf + bytes) <= (s_raw_ring + sizeof(s_raw_ring))) {
            return buf;
        }
    }
    return s_raw_ring;
}

const uint8_t *video_rx_ring(void)
{
    return s_raw_ring;
}

bool video_rx_write_offset(uint32_t *offset)
{
    if (s_rx_dma_ch < 0 || s_rx_dma_ch >= 3 || s_rx_dscr_count < 2) return false;
    uint32_t cur = AHB_DMA.channel[s_rx_dma_ch].in.in_dscr_bf0.val;
    int idx = find_dscr_index(s_rx_dscr_nodes, s_rx_dscr_count, cur);
    if (idx < 0 || !s_rx_dscr_nodes[idx].buffer) return false;
    *offset = (uint32_t)(s_rx_dscr_nodes[idx].buffer - s_raw_ring);
    return true;
}

uint32_t video_rx_max_descriptor(void)
{
    uint32_t m = 0u;
    for (int i = 0; i < s_rx_dscr_count; ++i)
        if (s_rx_dscr_nodes[i].length > m) m = s_rx_dscr_nodes[i].length;
    return m ? m : 4092u;
}

size_t video_copy_recent_rx(uint8_t *dst, size_t max_bytes)
{
    if (s_rx_dma_ch < 0 || s_rx_dma_ch >= 3 || s_rx_dscr_count < 2) return 0u;

    /* Wait for the GDMA to step onto a new (full-size) descriptor: everything
     * behind it is complete and the oldest block has ~102 us before the ring
     * wraps onto it, while one 4092-byte copy takes ~25 us. */
    uint32_t start_addr = AHB_DMA.channel[s_rx_dma_ch].in.in_dscr_bf0.val;
    int64_t t0 = esp_timer_get_time();
    int cur_idx = -1;
    for (;;) {
        uint32_t cur = AHB_DMA.channel[s_rx_dma_ch].in.in_dscr_bf0.val;
        if (cur != start_addr) {
            cur_idx = find_dscr_index(s_rx_dscr_nodes, s_rx_dscr_count, cur);
            if (cur_idx >= 0 && s_rx_dscr_nodes[cur_idx].length >= 1024u) break;
            start_addr = cur;   /* landed on the 16-byte tail: wait for the next one */
        }
        if (esp_timer_get_time() - t0 > 2000) return 0u;   /* ring stalled */
    }

    /* Completed descriptors in chain (= time) order, oldest first. */
    size_t copied = 0u;
    for (int back = s_rx_dscr_count - 1; back >= 1; --back) {
        int idx = (cur_idx - back + s_rx_dscr_count) % s_rx_dscr_count;
        const ring_dscr_node_t *n = &s_rx_dscr_nodes[idx];
        if (!n->buffer || n->length == 0u) continue;
        if (copied + n->length > max_bytes) break;
        sync_dma_m2c(n->buffer, n->length);
        memcpy(dst + copied, n->buffer, n->length);
        copied += n->length;
    }
    return copied;
}

/* Exact Phase5 state decode mirrored from the embedded fm.bsasm LUT.  The
 * detector is observation-only: the realtime BitScrambler remains the sole
 * live demodulator. */
static const uint8_t s_phase5_state_lut[256] = {
     4,  6,  7,  7,  7,  8,  8,  8, 24, 24, 24, 25, 25, 25, 26, 28,
     2,  4,  5,  6,  6,  7,  7,  7, 25, 25, 25, 26, 26, 27, 28, 30,
     1,  3,  4,  5,  5,  6,  6,  6, 26, 26, 26, 27, 27, 28, 29, 31,
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    12, 10,  9,  9,  9,  8,  8,  8, 24, 24, 24, 23, 23, 23, 22, 20,
};

/* Bit i is 1 when the production fm.bsasm delta LUT maps that
 * (previous_phase5,current_phase5) pair to DAC code <= 8.  This compact mask
 * lets the control task recognize real H-sync tips without duplicating the
 * 1024-entry output LUT or using floating point. */
static const uint8_t s_phase5_sync_mask[128] = {
    0x00, 0x00, 0x80, 0x3f, 0x00, 0x00, 0x00, 0xff, 0x00, 0x00, 0x00, 0xfe, 0x03, 0x00, 0x00, 0xfc,
    0x07, 0x00, 0x00, 0xf8, 0x0f, 0x00, 0x00, 0xf0, 0x1f, 0x00, 0x00, 0xe0, 0x3f, 0x00, 0x00, 0xc0,
    0x3f, 0x00, 0x00, 0x80, 0xff, 0x00, 0x00, 0x00, 0xfe, 0x00, 0x00, 0x00, 0xfc, 0x01, 0x00, 0x00,
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    0x00, 0x00, 0xf8, 0x07, 0x00, 0x00, 0xf0, 0x0f, 0x00, 0x00, 0xe0, 0x1f, 0x00, 0x00, 0xc0, 0x1f,
};

static inline bool phase5_pair_is_sync(uint8_t previous, uint8_t current)
{
    unsigned index = ((unsigned)previous << 5u) | current;
    return (s_phase5_sync_mask[index >> 3u] & (1u << (index & 7u))) != 0u;
}

static uint32_t s_receive_generation;

static void video_standard_detector_reset(void)
{
    ++s_receive_generation;
    s_video_std_pal_score = 0;
    s_video_std_ntsc_score = 0;
    s_detected_video_std_valid = false;
    s_last_line_period_20m = 0;
    s_last_sync_width_20m = 0;
    s_last_sync_quality = 0;
}

static void video_standard_vote(video_standard_t standard, uint16_t period)
{
    s_last_line_period_20m = period;
    if (standard == VIDEO_STD_PAL) {
        if (s_video_std_pal_score < 8u) ++s_video_std_pal_score;
        if (s_video_std_ntsc_score) --s_video_std_ntsc_score;
    } else {
        if (s_video_std_ntsc_score < 8u) ++s_video_std_ntsc_score;
        if (s_video_std_pal_score) --s_video_std_pal_score;
    }

    if (s_video_std_pal_score >= 3u &&
        s_video_std_pal_score >= s_video_std_ntsc_score + 2u) {
        s_detected_video_std = VIDEO_STD_PAL;
        s_detected_video_std_valid = true;
    } else if (s_video_std_ntsc_score >= 3u &&
               s_video_std_ntsc_score >= s_video_std_pal_score + 2u) {
        s_detected_video_std = VIDEO_STD_NTSC;
        s_detected_video_std_valid = true;
    }
}

/* Observe one complete, stable RX descriptor. Production Phase5 consumes the
 * odd byte of each 16-bit read, so this mirrors the same 20 MS/s sample
 * cadence. Valid H-sync low runs are about 94 samples wide. Their start-to-
 * start period is ~1271 samples for NTSC and exactly 1280 for PAL. */
static int video_semantic_observe(const uint8_t *raw, size_t bytes, size_t ring_offset)
{
    if (!raw || bytes < 3000u) return 0;

    const size_t first = (ring_offset & 1u) ? 0u : 1u;
    if (first + 2u >= bytes) return 0;

    uint8_t previous = s_phase5_state_lut[raw[first]];
    bool in_sync = false;
    unsigned run_start = 0;
    unsigned run_len = 0;
    unsigned starts[4];
    unsigned widths[4];
    unsigned start_count = 0;
    unsigned out_index = 1;

    for (size_t i = first + 2u; i < bytes; i += 2u, ++out_index) {
        uint8_t current = s_phase5_state_lut[raw[i]];
        bool low = phase5_pair_is_sync(previous, current);
        previous = current;

        if (low) {
            if (!in_sync) {
                in_sync = true;
                run_start = out_index;
                run_len = 1u;
            } else {
                ++run_len;
            }
        } else if (in_sync) {
            /* Real horizontal sync is ~94 samples at 20 MS/s.  Keep the broad
             * physical acceptance window for robustness, but score closeness
             * to the real pulse width instead of treating every accepted low
             * run as equally convincing. */
            if (run_len >= 70u && run_len <= 125u && start_count < 4u) {
                starts[start_count] = run_start;
                widths[start_count] = run_len;
                ++start_count;
            }
            in_sync = false;
            run_len = 0u;
        }
    }

    unsigned width_error_sum = 0;
    for (unsigned i = 0; i < start_count; ++i) {
        unsigned w = widths[i];
        width_error_sum += w > 94u ? w - 94u : 94u - w;
    }
    unsigned width_error = start_count ? width_error_sum / start_count : 100u;
    int width_score = start_count ? 40 - (int)width_error * 4 : 0;
    if (width_score < 0) width_score = 0;
    s_last_sync_width_20m = start_count ? (uint16_t)widths[0] : 0u;

    int best_period_score = 0;
    bool valid_period = false;
    for (unsigned i = 1; i < start_count; ++i) {
        unsigned period = starts[i] - starts[i - 1u];
        int score = 0;

        if (period >= 1266u && period <= 1275u) {
            unsigned error = period > 1271u ? period - 1271u : 1271u - period;
            score = 60 - (int)error * 8;
            valid_period = true;
            video_standard_vote(VIDEO_STD_NTSC, (uint16_t)period);
        } else if (period >= 1277u && period <= 1284u) {
            unsigned error = period > 1280u ? period - 1280u : 1280u - period;
            score = 60 - (int)error * 8;
            valid_period = true;
            video_standard_vote(VIDEO_STD_PAL, (uint16_t)period);
        }
        if (score > best_period_score) best_period_score = score;
    }

    /* A lone random low pulse can earn at most 40/100.  TRACK/acquisition
     * requires >=60, which means a physically plausible repeated line period
     * must also be present. */
    int quality = width_score + best_period_score;
    if (!valid_period) quality = width_score;
    if (quality > 100) quality = 100;
    s_last_sync_quality = quality;
    return quality;
}

typedef struct {
    int p_median;
    int q_phase;
    int n_clip;
    int n_origin;
    int clip_permille;
    int origin_permille;
    int n_coherent;
    int sum_cross;
    int sum_dot;
    int sum_i;
    int sum_q;
    int sum_i2;
    int sum_q2;
    int sum_iq;
    int dc_i_x100;
    int dc_q_x100;
    int iq_skew_permille;
    int iq_cross_permille;
    int winding_events;
    int winding_triplets;
    int winding_permille;
    int strong_winding_events;
    int strong_winding_triplets;
    int strong_winding_permille;
} control_metrics_t;

static control_metrics_t analyze_control_window(const uint8_t *sample, size_t bytes,
                                                size_t ring_offset)
{
    control_metrics_t m = {0};
    uint16_t hist[129] = {0};
    const size_t production_first = (ring_offset & 1u) ? 0u : 1u;
    int8_t prev_i = 0, prev_q = 0;
    uint8_t prev_phase = 0, prev2_phase = 0;
    int prev_power = 0, prev2_power = 0;

    for (size_t i = 0; i < bytes; ++i) {
        uint8_t byte = sample[i];
        int8_t q = (int8_t)((byte & 0x0fu) << 4) >> 4;
        int8_t in_val = (int8_t)(byte & 0xf0u) >> 4;

        if (in_val == -8 || in_val == 7 || q == -8 || q == 7) ++m.n_clip;
        int i2 = (int)in_val * in_val;
        int q2 = (int)q * q;
        m.sum_i += in_val;
        m.sum_q += q;
        m.sum_i2 += i2;
        m.sum_q2 += q2;
        m.sum_iq += (int)in_val * q;

        int p = i2 + q2;
        const int raw_power = p;
        const uint8_t phase = s_phase5_state_lut[byte];
        if (p <= 4) ++m.n_origin;
        if (p > 128) p = 128;
        ++hist[p];

        if (i > 0) {
            int dot = (int)in_val * (int)prev_i + (int)q * (int)prev_q;
            int cross = (int)q * (int)prev_i - (int)in_val * (int)prev_q;
            int abs_cross = cross < 0 ? -cross : cross;
            if (p >= 8 && dot > 0 && abs_cross <= dot) {
                ++m.n_coherent;
                m.sum_cross += cross;
                m.sum_dot += dot;
            }
        }

        /* fm.bsasm consumes one parity at 20 MS/s. Count exactly those
         * endpoint intervals, while using the skipped 40 MS/s middle sample
         * only as a shadow oracle. */
        bool production_endpoint =
            i >= production_first + 2u &&
            ((i - production_first) & 1u) == 0u;
        if (production_endpoint) {
            bool winding = demod_phase5_endpoint_loses_winding(prev2_phase,
                                                               prev_phase,
                                                               phase);
            ++m.winding_triplets;
            if (winding) ++m.winding_events;
            if (prev2_power >= DEMOD_STRONG_POWER_MIN &&
                prev_power >= DEMOD_STRONG_POWER_MIN &&
                raw_power >= DEMOD_STRONG_POWER_MIN) {
                ++m.strong_winding_triplets;
                if (winding) ++m.strong_winding_events;
            }
        }

        prev2_phase = prev_phase;
        prev_phase = phase;
        prev2_power = prev_power;
        prev_power = raw_power;
        prev_i = in_val;
        prev_q = q;
    }

    unsigned cumulative = 0;
    for (unsigned p = 0; p <= 128u; ++p) {
        cumulative += hist[p];
        if (cumulative >= (bytes + 1u) / 2u) {
            m.p_median = (int)p;
            break;
        }
    }
    m.q_phase = bytes > 1u ? (m.n_coherent * 100) / (int)(bytes - 1u) : 0;
    m.clip_permille = bytes ? (m.n_clip * 1000) / (int)bytes : 0;
    m.origin_permille = bytes ? (m.n_origin * 1000) / (int)bytes : 1000;
    m.winding_permille = m.winding_triplets ?
        (m.winding_events * 1000) / m.winding_triplets : 0;
    m.strong_winding_permille = m.strong_winding_triplets ?
        (m.strong_winding_events * 1000) / m.strong_winding_triplets : 0;
    m.dc_i_x100 = bytes ? (m.sum_i * 100) / (int)bytes : 0;
    m.dc_q_x100 = bytes ? (m.sum_q * 100) / (int)bytes : 0;

    /* These two dimensionless metrics are intentionally cheap. A perfect
     * centered/circular I/Q cloud tends toward zero skew and zero I/Q cross
     * correlation. They let us quantify DC/IQ calibration quality without
     * putting any new calibration routine in the realtime path. */
    int iq_power = m.sum_i2 + m.sum_q2;
    if (iq_power > 0) {
        int skew = m.sum_i2 - m.sum_q2;
        if (skew < 0) skew = -skew;
        int cross = m.sum_iq;
        if (cross < 0) cross = -cross;
        m.iq_skew_permille = (skew * 1000) / iq_power;
        m.iq_cross_permille = (cross * 2000) / iq_power;
    }
    return m;
}

/* =========================================================================
 * Receiver Modes, Slow-Transition AGC, Fixed BW40, and AFC State
 *
 * Control metrics come from one complete 4092-byte finished RX descriptor
 * (~102.3 us of Q4/I4) every 50 ms.  TRACK performs zero gain writes.
 *
 * SEARCH requires phase coherence; power alone is not accepted as a carrier.
 * With no lock it slowly probes G52/G62 instead of parking at maximum gain.
 * LEARN uses +2/-2 normal steps with persistence.  Only severe clipping may
 * issue a bounded -4 emergency cut.  Every physical gain write is followed by
 * a 500 ms decision hold and deliberately emits no serial output.
 *
 * The same settled descriptor can vote PAL/NTSC line period for AUTO menu
 * matching; this observation never replaces or stalls the live Phase5 path.
 *
 * Modes:
 *   - ANALOG_AGC_SHADOW: realtime state machine, physical gain frozen.
 *   - ANALOG_AGC_ACTIVE: default production controller.
 *   - ANALOG_AGC_MANUAL: fixed gain controlled by user (+ / - keys).
 * ========================================================================= */

typedef enum {
    ANALOG_AGC_SHADOW = 0,
    ANALOG_AGC_ACTIVE = 1,
    ANALOG_AGC_MANUAL = 2,
} analog_agc_mode_t;

typedef enum {
    AGC_STATE_SEARCH = 0,
    AGC_STATE_LEARN  = 1,
    AGC_STATE_TRACK  = 2,
} agc_state_t;

typedef enum {
    AFC_MODE_AUTO = 0, /* Auto Carrier Centering: centers within safe +/-1.5 MHz bound when locked */
    AFC_MODE_HOLD = 1, /* AFC Hold: freeze current offset */
    AFC_MODE_OFF  = 2, /* AFC Off: reset to 0 kHz offset */
} afc_mode_t;

static const char *rx_profile_name(void)
{
    switch (s_rx_profile) {
    case RX_PROFILE_RANGE_EXP:    return "RANGE EXP";
    case RX_PROFILE_BLOCKER_EXP:  return "BLOCKER EXP";
    case RX_PROFILE_RECOVERY_EXP: return "RECOVERY";
    case RX_PROFILE_AUTO_EXP:     return "AUTO EXP";
    case RX_PROFILE_HW_AGC_EXP:   return "HW AGC EXP";
    default:                      return "BALANCED";
    }
}

static uint8_t profile_gain_min(void)
{
    switch (s_rx_profile) {
    case RX_PROFILE_RANGE_EXP:   return 2u; /* Allow recovery from a nearby strong VTX. */
    case RX_PROFILE_BLOCKER_EXP: return 8u;
    case RX_PROFILE_RECOVERY_EXP:return 20u;
    default:                     return 2u;
    }
}

static uint8_t profile_gain_max(void)
{
    switch (s_rx_profile) {
    case RX_PROFILE_BLOCKER_EXP: return 48u;
    default:                     return 62u;
    }
}

static uint8_t profile_gain_clamp(int gain)
{
    int lo = profile_gain_min();
    int hi = profile_gain_max();
    if (gain < lo) gain = lo;
    if (gain > hi) gain = hi;
    return (uint8_t)gain;
}

static unsigned profile_search_probe_ticks(void)
{
    switch (s_rx_profile) {
    case RX_PROFILE_RANGE_EXP:    return 12u; /* 600 ms */
    case RX_PROFILE_RECOVERY_EXP: return 6u;  /* 300 ms */
    case RX_PROFILE_AUTO_EXP:     return 8u;  /* 400 ms */
    case RX_PROFILE_BLOCKER_EXP:  return 12u;
    default:                      return GAIN_SEARCH_PROBE_TICKS;
    }
}

static unsigned profile_weak_persistence(void)
{
    switch (s_rx_profile) {
    case RX_PROFILE_RANGE_EXP:    return 3u;
    case RX_PROFILE_RECOVERY_EXP: return 2u;
    case RX_PROFILE_AUTO_EXP:     return 3u;
    default:                      return 5u;
    }
}

static const char *rf_bw_mode_name(void)
{
    return s_rf_bw_mode == RF_BW_MODE_BW40 ? "BW40" :
           s_rf_bw_mode == RF_BW_MODE_BW20 ? "BW20" : "AUTO EXP";
}

static const char *output_mode_name(void)
{
    return s_output_mode == VIDEO_OUTPUT_4BIT_80 ? "4BIT@80" : "6BIT@40";
}

static void apply_rf_bandwidth(bool bw40)
{
    s_last_phy_write_us = esp_timer_get_time();
    s_last_phy_write_kind = PHY_WRITE_BW;
    s_current_bw40 = bw40;
    rf_set_analog_bandwidth(bw40);
}

static void cycle_rf_bandwidth_mode(void)
{
    if (s_rf_bw_mode == RF_BW_MODE_BW40) {
        s_rf_bw_mode = RF_BW_MODE_BW20;
        apply_rf_bandwidth(false);
    } else if (s_rf_bw_mode == RF_BW_MODE_BW20) {
        s_rf_bw_mode = RF_BW_MODE_AUTO;
        apply_rf_bandwidth(true); /* AUTO always enters in high gear. */
    } else {
        s_rf_bw_mode = RF_BW_MODE_BW40;
        apply_rf_bandwidth(true);
    }
}

static volatile analog_agc_mode_t s_agc_mode = ANALOG_AGC_ACTIVE;
static volatile agc_state_t s_agc_state = AGC_STATE_SEARCH;
/* WBFM instantaneous phase slope contains the video modulation itself.
 * The short-window CFO estimator is useful diagnostics, but it is not yet a
 * calibrated LO-error estimator. Never retune automatically at boot. */
static volatile afc_mode_t s_afc_mode = AFC_MODE_OFF;
static volatile uint8_t s_current_gain = 62u;   /* Physical RF gain applied */
static volatile uint8_t s_shadow_gain = 62u;    /* Controller recommended gain */
static volatile int s_last_p_median = 25;
static volatile int s_last_q_phase = 0;
static volatile int s_signal_strength = 0;
static volatile int s_last_n_clip = 0;
static volatile int s_last_n_origin = 0;
static volatile int s_last_clip_permille = 0;
static volatile int s_last_origin_permille = 0;
static volatile int s_last_dc_i_x100 = 0;
static volatile int s_last_dc_q_x100 = 0;
static volatile int s_last_iq_skew_permille = 0;
static volatile int s_last_iq_cross_permille = 0;
static volatile int s_last_winding_permille = 0;
static volatile int s_last_strong_winding_permille = 0;
static volatile uint32_t s_gain_transition_count = 0;
static volatile int s_cfo_khz = 0;              /* Carrier Frequency Offset in kHz */
static volatile bool s_channel_scan_active;
static volatile unsigned s_channel_scan_progress;

/* Issue #27/#28 lab characterization is deliberately console-driven and
 * opt-in. It never paces the realtime IQ/CVBS path and adds no periodic task. */
typedef struct {
    bool active;
    bool sampled;
    uint8_t gain;
    uint8_t saved_gain;
    uint8_t saved_shadow_gain;
    analog_agc_mode_t saved_agc_mode;
    agc_state_t saved_agc_state;
    rf_bw_mode_t saved_bw_mode;
    bool saved_bw40;
    afc_mode_t saved_afc_mode;
    int saved_offset_khz;
    bool saved_quiet;
    int64_t applied_us;
    hw_transport_counters_t step_base;
} lab_gain_sweep_t;

static lab_gain_sweep_t s_gain_sweep;
static volatile bool s_lab_quiet;
static volatile bool s_lab_fft_forced;
static volatile int8_t s_lab_fft_value;

static const int8_t s_lab_fft_values[] = {16, 24, 32, 40};

#define SETTINGS_VERSION 2u
#define SETTINGS_NAMESPACE "c5vrx"
#define SETTINGS_KEY "settings"

typedef struct {
    uint8_t version;
    uint8_t channel_index;
    uint8_t rf_bw_mode;
    uint8_t afc_mode;
    uint8_t output_mode;
    uint8_t video_std_mode;
    uint8_t agc_mode;
    uint8_t manual_gain;
    int16_t frequency_offset_khz;
    uint8_t menu_boot_btn_enabled;
    uint8_t rx_profile;
    uint8_t reserved[2];
} persisted_settings_t;

/* Frequency-offset writes in rf.c re-assert the current forced RX gain after
 * touching the PHY channel offset. Track that hidden gain write so issue #28
 * correlation does not incorrectly call an AFC/fine-tune transient unrelated. */
static void apply_frequency_offset_khz_tracked(int offset_khz)
{
    int64_t now = esp_timer_get_time();
    s_last_gain_write_us = now; /* rf.c re-asserts the forced RX gain */
    s_last_phy_write_us = now;
    s_last_phy_write_kind = PHY_WRITE_OFFSET;
    rf_set_frequency_offset_khz(offset_khz);
    ++s_gain_transition_count;
}

static void step_frequency_offset_khz_tracked(int delta_khz)
{
    apply_frequency_offset_khz_tracked(rf_get_frequency_offset_khz() + delta_khz);
}

static void apply_rx_gain_tracked(uint8_t gain)
{
    gain = profile_gain_clamp(gain);
    s_current_gain = gain;
    s_shadow_gain = gain;
    s_last_gain_write_us = esp_timer_get_time();
    s_last_phy_write_us = s_last_gain_write_us;
    s_last_phy_write_kind = PHY_WRITE_GAIN;
    rf_set_rx_gain(true, gain);
    ++s_gain_transition_count;
}

uint8_t video_rx_gain(void)
{
    return s_current_gain;
}

void video_set_rx_gain(uint8_t gain)
{
    s_agc_mode = ANALOG_AGC_MANUAL;
    apply_rx_gain_tracked(gain);
}

static int signal_strength_score(const control_metrics_t *m, uint8_t gain)
{
    if (m->q_phase < 18 || m->origin_permille > 850) return 0;
    int coherence = (m->q_phase - 18) * 100 / 62;
    int power = (m->p_median - 6) * 100 / 28;
    int gain_headroom = rf_get_experimental_hw_agc() ? 50 :
                        (62 - (int)gain) * 100 / 50;
    if (coherence < 0) coherence = 0; else if (coherence > 100) coherence = 100;
    if (power < 0) power = 0; else if (power > 100) power = 100;
    if (gain_headroom < 0) gain_headroom = 0; else if (gain_headroom > 100) gain_headroom = 100;
    return (coherence * 2 + power + gain_headroom) / 4;
}

static void settings_save(void)
{
    persisted_settings_t settings = {
        .version = SETTINGS_VERSION,
        .channel_index = (uint8_t)rf_get_channel_index(),
        .rf_bw_mode = (uint8_t)s_rf_bw_mode,
        .afc_mode = (uint8_t)s_afc_mode,
        .output_mode = (uint8_t)s_output_mode,
        .video_std_mode = (uint8_t)s_video_std_mode,
        .agc_mode = (uint8_t)s_agc_mode,
        .manual_gain = s_current_gain,
        .frequency_offset_khz = (int16_t)rf_get_frequency_offset_khz(),
        .menu_boot_btn_enabled = s_menu_boot_btn_enabled ? 1u : 0u,
        /* HW AGC is deliberately per-boot opt-in. Never resurrect vendor
         * gain ownership silently after reset/power-cycle. */
        .rx_profile = (uint8_t)(s_rx_profile == RX_PROFILE_HW_AGC_EXP ?
                                RX_PROFILE_RANGE_EXP : s_rx_profile),
    };
    nvs_handle_t handle;
    esp_err_t err = nvs_open(SETTINGS_NAMESPACE, NVS_READWRITE, &handle);
    if (err == ESP_OK) {
        err = nvs_set_blob(handle, SETTINGS_KEY, &settings, sizeof(settings));
        if (err == ESP_OK) err = nvs_commit(handle);
        nvs_close(handle);
    }
    if (err != ESP_OK) ESP_LOGW(TAG, "Could not save settings: %s", esp_err_to_name(err));
}

static void settings_load(void)
{
    persisted_settings_t settings = {0};
    size_t length = sizeof(settings);
    nvs_handle_t handle;
    esp_err_t err = nvs_open(SETTINGS_NAMESPACE, NVS_READONLY, &handle);
    if (err == ESP_OK) {
        err = nvs_get_blob(handle, SETTINGS_KEY, &settings, &length);
        nvs_close(handle);
    }
    if (err != ESP_OK || length != sizeof(settings) || settings.version != SETTINGS_VERSION) {
        s_rx_profile = RX_PROFILE_RANGE_EXP;
        s_rf_bw_mode = RF_BW_MODE_BW40;
        s_afc_mode = AFC_MODE_OFF;
        s_agc_mode = ANALOG_AGC_ACTIVE;
        s_current_gain = 62u;
        s_shadow_gain = 62u;
        apply_rf_bandwidth(true);
        rf_set_rx_gain(true, 62u);
        return;
    }

    if (settings.channel_index < rf_get_channel_count()) (void)rf_set_channel(settings.channel_index);
    if (settings.rf_bw_mode <= RF_BW_MODE_AUTO) s_rf_bw_mode = (rf_bw_mode_t)settings.rf_bw_mode;
    apply_rf_bandwidth(s_rf_bw_mode != RF_BW_MODE_BW20);
    if (settings.afc_mode <= AFC_MODE_OFF) s_afc_mode = (afc_mode_t)settings.afc_mode;
    if (settings.output_mode <= VIDEO_OUTPUT_4BIT_80) s_output_mode = (video_output_mode_t)settings.output_mode;
    if (settings.video_std_mode <= VIDEO_STD_MODE_PAL) s_video_std_mode = (video_standard_mode_t)settings.video_std_mode;
    if (settings.rx_profile < RX_PROFILE_COUNT &&
        settings.rx_profile != RX_PROFILE_HW_AGC_EXP) {
        s_rx_profile = (rx_profile_t)settings.rx_profile;
    } else {
        s_rx_profile = RX_PROFILE_RANGE_EXP;
    }
    if (s_rx_profile == RX_PROFILE_RANGE_EXP) {
        /* RANGE has one deterministic RF shape across reboot: the proven
         * full-video filter, with no acquisition-time filter or AFC writes. */
        s_rf_bw_mode = RF_BW_MODE_BW40;
        s_afc_mode = AFC_MODE_OFF;
        apply_rf_bandwidth(true);
    }
    if (s_video_std_mode == VIDEO_STD_MODE_PAL) s_video_std = VIDEO_STD_PAL;
    else if (s_video_std_mode == VIDEO_STD_MODE_NTSC) s_video_std = VIDEO_STD_NTSC;
    if (settings.agc_mode <= ANALOG_AGC_MANUAL) s_agc_mode = (analog_agc_mode_t)settings.agc_mode;
    if (s_agc_mode == ANALOG_AGC_MANUAL && settings.manual_gain >= 2u && settings.manual_gain <= 62u) {
        s_current_gain = profile_gain_clamp(settings.manual_gain);
    } else {
        switch (s_rx_profile) {
        case RX_PROFILE_RANGE_EXP:    s_current_gain = 62u; break;
        case RX_PROFILE_BLOCKER_EXP:  s_current_gain = 36u; break;
        case RX_PROFILE_RECOVERY_EXP: s_current_gain = 52u; break;
        case RX_PROFILE_AUTO_EXP:     s_current_gain = 52u; break;
        default:                      s_current_gain = 52u; break;
        }
        s_current_gain = profile_gain_clamp(s_current_gain);
    }
    s_shadow_gain = s_current_gain;
    rf_set_rx_gain(true, s_current_gain);
    (void)rf_set_experimental_hw_agc(false, 62u);
    s_menu_boot_btn_enabled = settings.menu_boot_btn_enabled != 0;
    if (s_afc_mode == AFC_MODE_HOLD) apply_frequency_offset_khz_tracked(settings.frequency_offset_khz);
    else if (s_afc_mode == AFC_MODE_OFF) apply_frequency_offset_khz_tracked(0);
    ESP_LOGI(TAG, "Restored settings: channel=%u profile=%s BW=%s output=%s",
             settings.channel_index, rx_profile_name(), rf_bw_mode_name(), output_mode_name());
}

static void record_transport_event(uint32_t flags)
{
    if (!flags) return;
    int64_t now = esp_timer_get_time();
    uint32_t seq = s_lag_event_head + 1u;
    unsigned index = (seq - 1u) % LAG_EVENT_LOG_SIZE;
    uint32_t rx_off = get_rx_dma_offset(NULL);
    uint32_t tx_off = get_tx_dma_offset(NULL);

    s_lag_events[index] = (lag_event_t) {
        .time_us = now,
        .seq = seq,
        .flags = flags,
        .rx_off = (uint16_t)rx_off,
        .tx_off = (uint16_t)tx_off,
        .gain = s_current_gain,
        .agc_state = (uint8_t)s_agc_state,
    };
    s_lag_event_head = seq;
    s_last_transport_event_us = now;
    s_last_transport_flags = flags;
    ++s_hw_counters.lag_event_count;

    if (s_last_gain_write_us > 0) {
        int64_t dt = now - s_last_gain_write_us;
        if (dt >= 0 && dt <= 200000) ++s_hw_counters.near_gain_event_count;
    }
    if (s_last_phy_write_us > 0) {
        int64_t dt = now - s_last_phy_write_us;
        if (dt >= 0 && dt <= 200000) ++s_hw_counters.near_phy_event_count;
    }
}

static void poll_transport_faults(void)
{
    uint32_t flags = 0;
    bool tx_rempty = PARL_IO.int_raw.tx_fifo_rempty_int_raw != 0;

    if (tx_rempty) {
        ++s_hw_counters.parl_tx_rempty_count;
        PARL_IO.int_clr.tx_fifo_rempty_int_clr = 1;
        flags |= LAG_EVT_PARLIO_TX_REMPTY;
    }
    if (PARL_IO.int_raw.rx_fifo_wovf_int_raw) {
        ++s_hw_counters.parl_rx_wovf_count;
        PARL_IO.int_clr.rx_fifo_wovf_int_clr = 1;
        flags |= LAG_EVT_PARLIO_RX_WOVF;
    }
    if (PARL_IO.int_raw.tx_eof_int_raw) {
        ++s_hw_counters.parl_tx_eof_count;
        PARL_IO.int_clr.tx_eof_int_clr = 1;
        flags |= LAG_EVT_PARLIO_TX_EOF;
    }

    if (s_rx_dma_ch >= 0 && s_rx_dma_ch < 3) {
        uint32_t raw = AHB_DMA.in_intr[s_rx_dma_ch].raw.val & GDMA_IN_FAULT_MASK;
        if (raw) {
            ++s_hw_counters.gdma_in_fault_count;
            AHB_DMA.in_intr[s_rx_dma_ch].clr.val = raw;
            flags |= LAG_EVT_GDMA_IN_FAULT;
        }
    }
    if (s_tx_dma_ch >= 0 && s_tx_dma_ch < 3) {
        uint32_t raw = AHB_DMA.out_intr[s_tx_dma_ch].raw.val & GDMA_OUT_FAULT_MASK;
        if (raw) {
            ++s_hw_counters.gdma_out_fault_count;
            AHB_DMA.out_intr[s_tx_dma_ch].clr.val = raw;
            flags |= LAG_EVT_GDMA_OUT_FAULT;
        }
    }

    if (tx_rempty && BITSCRAMBLER.state[BITSCRAMBLER_DIR_TX].fifo_empty) {
        ++s_hw_counters.bs_fifo_empty_count;
    }
    if (BITSCRAMBLER.state[BITSCRAMBLER_DIR_TX].eof_overload) {
        ++s_hw_counters.bs_eof_overload_count;
        BITSCRAMBLER.state[BITSCRAMBLER_DIR_TX].val = 1u << 31;
        flags |= LAG_EVT_BS_EOF_OVERLOAD;
    }

    ++s_hw_counters.checks;
    record_transport_event(flags);
}

static hw_transport_counters_t lab_counter_snapshot(void)
{
    hw_transport_counters_t snapshot;
    memcpy(&snapshot, (const void *)&s_hw_counters, sizeof(snapshot));
    return snapshot;
}

static void lab_clear_transport_sticky(void)
{
    PARL_IO.int_clr.val = UINT32_MAX;
    if (s_rx_dma_ch >= 0) AHB_DMA.in_intr[s_rx_dma_ch].clr.val = UINT32_MAX;
    if (s_tx_dma_ch >= 0) AHB_DMA.out_intr[s_tx_dma_ch].clr.val = UINT32_MAX;
    BITSCRAMBLER.state[BITSCRAMBLER_DIR_TX].val = 1u << 31;
}

static void lab_reset_correlation(void)
{
    memset((void *)&s_hw_counters, 0, sizeof(s_hw_counters));
    memset(s_lag_events, 0, sizeof(s_lag_events));
    s_lag_event_head = 0;
    s_last_transport_event_us = 0;
    s_last_transport_flags = 0;
    s_last_user_lag_mark_us = 0;
    s_last_gain_write_us = 0;
    s_last_phy_write_us = 0;
    s_last_phy_write_kind = PHY_WRITE_NONE;
    s_last_gain_drop_transition = s_gain_transition_count;
    lab_clear_transport_sticky();
}

static uint32_t lab_delta(uint32_t current, uint32_t base)
{
    return current - base;
}

static void lab_print_row(const char *kind, const hw_transport_counters_t *base)
{
    const hw_transport_counters_t current = lab_counter_snapshot();
    const hw_transport_counters_t zero = {0};
    if (!base) base = &zero;

    int64_t now = esp_timer_get_time();
    long long gain_age_ms = s_last_gain_write_us > 0 ?
        (long long)((now - s_last_gain_write_us) / 1000) : -1;
    long long transport_age_ms = s_last_transport_event_us > 0 ?
        (long long)((now - s_last_transport_event_us) / 1000) : -1;
    long long phy_age_ms = s_last_phy_write_us > 0 ?
        (long long)((now - s_last_phy_write_us) / 1000) : -1;

    rf_phy_snapshot_t phy = {0};
    rf_get_phy_snapshot(&phy);

    printf("C5VRX_LAB_ROW kind=%s gain=%u gain_reg=0x%08lx bw=%u afc=%u offset_khz=%d "
           "agc=%u state=%u profile=%u p=%d q=%d clip_pm=%d origin_pm=%d strength=%d "
           "nf_valid=%u nf_dbm=%d rssi_valid=%u rssi_dbm=%d "
           "dc_i_x100=%d dc_q_x100=%d iq_skew_pm=%d iq_cross_pm=%d "
           "winding_pm=%d strong_winding_pm=%d sync_q=%d sync_width=%u "
           "fft_forced=%u fft=%d filter_mode=%u adc_sel=%u filter_reg=0x%08lx "
           "adc_reg=0x%08lx source_mux=0x%08lx "
           "tx_empty=%lu rx_ovf=%lu tx_eof=%lu gdma_in=%lu gdma_out=%lu "
           "bs_empty=%lu bs_eof=%lu lag=%lu near_gain=%lu near_phy=%lu qdrop=%lu "
           "gain_age_ms=%lld phy_age_ms=%lld phy_kind=%u transport_age_ms=%lld last_flags=0x%02lx\n",
           kind, s_current_gain, (unsigned long)phy.gain_reg,
           s_current_bw40 ? 40u : 20u, (unsigned)s_afc_mode,
           rf_get_frequency_offset_khz(), (unsigned)s_agc_mode, (unsigned)s_agc_state,
           (unsigned)s_rx_profile,
           s_last_p_median, s_last_q_phase, s_last_clip_permille,
           s_last_origin_permille, s_signal_strength,
           s_noise_floor_valid ? 1u : 0u, s_last_noise_floor_dbm,
           s_phy_rssi_valid ? 1u : 0u, s_last_phy_rssi_dbm,
           s_last_dc_i_x100, s_last_dc_q_x100,
           s_last_iq_skew_permille, s_last_iq_cross_permille,
           s_last_winding_permille, s_last_strong_winding_permille,
           s_last_sync_quality, (unsigned)s_last_sync_width_20m,
           s_lab_fft_forced ? 1u : 0u, (int)s_lab_fft_value,
           (unsigned)phy.rx_filter_mode, (unsigned)phy.adc_rate_sel,
           (unsigned long)phy.rx_filter_reg, (unsigned long)phy.adc_rate_reg,
           (unsigned long)phy.source_mux_reg,
           (unsigned long)lab_delta(current.parl_tx_rempty_count, base->parl_tx_rempty_count),
           (unsigned long)lab_delta(current.parl_rx_wovf_count, base->parl_rx_wovf_count),
           (unsigned long)lab_delta(current.parl_tx_eof_count, base->parl_tx_eof_count),
           (unsigned long)lab_delta(current.gdma_in_fault_count, base->gdma_in_fault_count),
           (unsigned long)lab_delta(current.gdma_out_fault_count, base->gdma_out_fault_count),
           (unsigned long)lab_delta(current.bs_fifo_empty_count, base->bs_fifo_empty_count),
           (unsigned long)lab_delta(current.bs_eof_overload_count, base->bs_eof_overload_count),
           (unsigned long)lab_delta(current.lag_event_count, base->lag_event_count),
           (unsigned long)lab_delta(current.near_gain_event_count, base->near_gain_event_count),
           (unsigned long)lab_delta(current.near_phy_event_count, base->near_phy_event_count),
           (unsigned long)lab_delta(current.gain_quality_drop_count, base->gain_quality_drop_count),
           gain_age_ms, phy_age_ms, (unsigned)s_last_phy_write_kind,
           transport_age_ms, (unsigned long)s_last_transport_flags);
}

static void lab_apply_fixed_gain(uint8_t gain)
{
    if (gain < LAB_GAIN_MIN) gain = LAB_GAIN_MIN;
    if (gain > LAB_GAIN_MAX) gain = LAB_GAIN_MAX;
    s_current_gain = gain;
    s_shadow_gain = gain;
    s_last_gain_write_us = esp_timer_get_time();
    s_last_phy_write_us = s_last_gain_write_us;
    s_last_phy_write_kind = PHY_WRITE_GAIN;
    rf_set_rx_gain(true, gain);
    ++s_gain_transition_count;
}

static void lab_finish_gain_sweep(bool aborted)
{
    if (!s_gain_sweep.active) return;

    const uint8_t saved_gain = s_gain_sweep.saved_gain;
    const uint8_t saved_shadow_gain = s_gain_sweep.saved_shadow_gain;
    const analog_agc_mode_t saved_agc_mode = s_gain_sweep.saved_agc_mode;
    const agc_state_t saved_agc_state = s_gain_sweep.saved_agc_state;
    const rf_bw_mode_t saved_bw_mode = s_gain_sweep.saved_bw_mode;
    const bool saved_bw40 = s_gain_sweep.saved_bw40;
    const afc_mode_t saved_afc_mode = s_gain_sweep.saved_afc_mode;
    const int saved_offset_khz = s_gain_sweep.saved_offset_khz;
    const bool saved_quiet = s_gain_sweep.saved_quiet;

    s_gain_sweep.active = false;

    /* Keep MANUAL long enough for analog_agc_task's private target_gain to
     * follow the restored physical gain before restoring ACTIVE/SHADOW. */
    s_agc_mode = ANALOG_AGC_MANUAL;
    if (s_current_gain != saved_gain) lab_apply_fixed_gain(saved_gain);
    s_shadow_gain = saved_gain;
    vTaskDelay(pdMS_TO_TICKS(120));

    s_rf_bw_mode = saved_bw_mode;
    if (s_current_bw40 != saved_bw40) apply_rf_bandwidth(saved_bw40);
    s_afc_mode = saved_afc_mode;
    apply_frequency_offset_khz_tracked(saved_offset_khz);
    s_agc_state = saved_agc_state;
    s_shadow_gain = saved_shadow_gain;
    s_agc_mode = saved_agc_mode;
    s_lab_quiet = saved_quiet;

    printf("C5VRX_GAIN_SWEEP_END status=%s restored_gain=%u restored_agc=%u restored_bw=%u\n",
           aborted ? "ABORTED" : "COMPLETE", saved_gain, (unsigned)saved_agc_mode,
           saved_bw40 ? 40u : 20u);
}

static void lab_start_gain_sweep(void)
{
    if (rf_get_experimental_hw_agc()) {
        printf("C5VRX_GAIN_SWEEP_REFUSED reason=hw_agc_profile\n");
        return;
    }
    if (s_gain_sweep.active) {
        lab_finish_gain_sweep(true);
        return;
    }
    if (s_menu_active) {
        printf("C5VRX_GAIN_SWEEP_REFUSED reason=menu_active\n");
        return;
    }

    s_gain_sweep = (lab_gain_sweep_t) {
        .active = true,
        .sampled = false,
        .gain = LAB_GAIN_MIN,
        .saved_gain = s_current_gain,
        .saved_shadow_gain = s_shadow_gain,
        .saved_agc_mode = s_agc_mode,
        .saved_agc_state = s_agc_state,
        .saved_bw_mode = s_rf_bw_mode,
        .saved_bw40 = s_current_bw40,
        .saved_afc_mode = s_afc_mode,
        .saved_offset_khz = rf_get_frequency_offset_khz(),
        .saved_quiet = s_lab_quiet,
    };

    s_agc_mode = ANALOG_AGC_MANUAL;
    s_rf_bw_mode = RF_BW_MODE_BW40;
    if (!s_current_bw40) apply_rf_bandwidth(true);
    s_afc_mode = AFC_MODE_OFF;
    if (rf_get_frequency_offset_khz() != 0) apply_frequency_offset_khz_tracked(0);
    s_lab_quiet = true;

    /* Let a possible BW/AFC transition finish before the first measured gain
     * state. No sample traffic is CPU-paced during this delay. */
    vTaskDelay(pdMS_TO_TICKS(300));
    lab_reset_correlation();

    printf("C5VRX_GAIN_SWEEP_BEGIN min=%u max=%u step=%u settle_ms=%u dwell_ms=%u "
           "bw=40 afc=off output=%s\n",
           LAB_GAIN_MIN, LAB_GAIN_MAX, LAB_GAIN_STEP,
           LAB_GAIN_SETTLE_MS, LAB_GAIN_DWELL_MS, output_mode_name());

    s_gain_sweep.step_base = lab_counter_snapshot();
    lab_apply_fixed_gain(s_gain_sweep.gain);
    s_gain_sweep.applied_us = esp_timer_get_time();
}

static void lab_gain_sweep_tick(void)
{
    if (!s_gain_sweep.active) return;

    int64_t elapsed_us = esp_timer_get_time() - s_gain_sweep.applied_us;
    if (!s_gain_sweep.sampled &&
        elapsed_us >= (int64_t)LAB_GAIN_SETTLE_MS * 1000LL) {
        lab_print_row("GAIN_SWEEP", &s_gain_sweep.step_base);
        s_gain_sweep.sampled = true;
    }

    if (elapsed_us < (int64_t)LAB_GAIN_DWELL_MS * 1000LL) return;

    if (s_gain_sweep.gain + LAB_GAIN_STEP <= LAB_GAIN_MAX) {
        s_gain_sweep.gain = (uint8_t)(s_gain_sweep.gain + LAB_GAIN_STEP);
        s_gain_sweep.step_base = lab_counter_snapshot();
        s_gain_sweep.sampled = false;
        lab_apply_fixed_gain(s_gain_sweep.gain);
        s_gain_sweep.applied_us = esp_timer_get_time();
    } else {
        lab_finish_gain_sweep(false);
    }
}

static void lab_enter_quiet_baseline(void)
{
    if (s_gain_sweep.active) {
        printf("C5VRX_LAB_BASELINE_REFUSED reason=gain_sweep_active\n");
        return;
    }
    if (s_menu_active) {
        printf("C5VRX_LAB_BASELINE_REFUSED reason=menu_active\n");
        return;
    }

    s_agc_mode = ANALOG_AGC_MANUAL;
    s_rf_bw_mode = RF_BW_MODE_BW40;
    if (!s_current_bw40) apply_rf_bandwidth(true);
    s_afc_mode = AFC_MODE_OFF;
    if (rf_get_frequency_offset_khz() != 0) apply_frequency_offset_khz_tracked(0);
    s_lab_quiet = true;

    /* Baseline starts only after control-path setup transients are outside the
     * run. Then all counters/timestamps are cleared in one explicit action. */
    vTaskDelay(pdMS_TO_TICKS(600));
    lab_reset_correlation();

    printf("C5VRX_LAB_BASELINE_READY gain=%u bw=40 afc=off quiet=1 "
           "instruction=do_not_touch_console_until_event\n", s_current_gain);
}


/* Deterministic FFT A/B. Espressif exposes FFT gain separately from AGC gain;
 * this probe answers the only question that matters to C5VRX: does forcing it
 * change the raw MODEM_DIAG Q4/I4 statistics? Production never forces FFT. */
static void lab_run_fft_probe(void)
{
    if (rf_get_experimental_hw_agc()) {
        printf("C5VRX_FFT_PROBE_REFUSED reason=hw_agc_profile\n");
        return;
    }
    if (s_gain_sweep.active || s_menu_active) {
        printf("C5VRX_FFT_PROBE_REFUSED reason=%s\n",
               s_gain_sweep.active ? "gain_sweep_active" : "menu_active");
        return;
    }

    const analog_agc_mode_t saved_agc_mode = s_agc_mode;
    const agc_state_t saved_agc_state = s_agc_state;
    const rf_bw_mode_t saved_bw_mode = s_rf_bw_mode;
    const bool saved_bw40 = s_current_bw40;
    const afc_mode_t saved_afc_mode = s_afc_mode;
    const int saved_offset = rf_get_frequency_offset_khz();
    const bool saved_quiet = s_lab_quiet;
    const uint8_t saved_gain = s_current_gain;
    const uint8_t saved_shadow = s_shadow_gain;

    s_agc_mode = ANALOG_AGC_MANUAL;
    s_rf_bw_mode = RF_BW_MODE_BW40;
    if (!s_current_bw40) apply_rf_bandwidth(true);
    s_afc_mode = AFC_MODE_OFF;
    if (saved_offset != 0) apply_frequency_offset_khz_tracked(0);
    s_lab_quiet = true;
    vTaskDelay(pdMS_TO_TICKS(300));
    lab_reset_correlation();

    /* Establish an automatic-scaling baseline before the forced values. */
    rf_set_fft_scale_force(false, 0);
    s_lab_fft_forced = false;
    s_lab_fft_value = 0;
    s_profile_fft_forced = false;
    vTaskDelay(pdMS_TO_TICKS(250));
    int baseline_score = s_last_q_phase * 4 + s_last_p_median
                       - s_last_clip_permille / 5
                       - s_last_origin_permille / 20
                       - s_last_iq_skew_permille / 25
                       - s_last_iq_cross_permille / 25;
    int best_score = baseline_score;
    int8_t best_value = 0;
    lab_print_row("FFT_BASELINE", NULL);

    printf("C5VRX_FFT_PROBE_BEGIN gain=%u bw=40 values=16,24,32,40 settle_ms=%u baseline=%d\n",
           s_current_gain, LAB_FFT_SETTLE_MS, baseline_score);

    for (unsigned i = 0; i < sizeof(s_lab_fft_values) / sizeof(s_lab_fft_values[0]); ++i) {
        const hw_transport_counters_t base = lab_counter_snapshot();
        s_lab_fft_value = s_lab_fft_values[i];
        s_lab_fft_forced = true;
        s_last_phy_write_us = esp_timer_get_time();
        s_last_phy_write_kind = PHY_WRITE_FFT;
        rf_set_fft_scale_force(true, s_lab_fft_value);
        vTaskDelay(pdMS_TO_TICKS(LAB_FFT_SETTLE_MS));
        lab_print_row("FFT_SWEEP", &base);
        int score = s_last_q_phase * 4 + s_last_p_median
                  - s_last_clip_permille / 5
                  - s_last_origin_permille / 20
                  - s_last_iq_skew_permille / 25
                  - s_last_iq_cross_permille / 25;
        if (score > best_score) {
            best_score = score;
            best_value = s_lab_fft_value;
        }
        if (LAB_FFT_DWELL_MS > LAB_FFT_SETTLE_MS) {
            vTaskDelay(pdMS_TO_TICKS(LAB_FFT_DWELL_MS - LAB_FFT_SETTLE_MS));
        }
    }

    s_last_phy_write_us = esp_timer_get_time();
    s_last_phy_write_kind = PHY_WRITE_FFT;
    rf_set_fft_scale_force(false, 0);
    s_lab_fft_forced = false;
    s_lab_fft_value = 0;
    s_fft_q4_effect_known = true;
    /* Require a clear improvement so AUTO never promotes FFT gain because of
     * ordinary 50 ms control-window jitter. */
    s_fft_q4_effective = best_value != 0 && best_score >= baseline_score + 12;
    s_fft_best_value = s_fft_q4_effective ? best_value : 0;
    vTaskDelay(pdMS_TO_TICKS(120));

    s_rf_bw_mode = saved_bw_mode;
    if (s_current_bw40 != saved_bw40) apply_rf_bandwidth(saved_bw40);
    s_afc_mode = saved_afc_mode;
    if (rf_get_frequency_offset_khz() != saved_offset) {
        apply_frequency_offset_khz_tracked(saved_offset);
    }
    if (s_current_gain != saved_gain) lab_apply_fixed_gain(saved_gain);
    s_shadow_gain = saved_shadow;
    s_agc_state = saved_agc_state;
    s_agc_mode = saved_agc_mode;
    s_lab_quiet = saved_quiet;

    if (s_rx_profile == RX_PROFILE_AUTO_EXP && s_fft_q4_effective) {
        s_last_phy_write_us = esp_timer_get_time();
        s_last_phy_write_kind = PHY_WRITE_FFT;
        rf_set_fft_scale_force(true, s_fft_best_value);
        s_profile_fft_forced = true;
    }

    printf("C5VRX_FFT_PROBE_END restored_gain=%u restored_agc=%u restored_bw=%u "
           "q4_effect=%s best_fft=%d delta=%d\n",
           saved_gain, (unsigned)saved_agc_mode, saved_bw40 ? 40u : 20u,
           s_fft_q4_effective ? "YES" : "NO", (int)s_fft_best_value,
           best_score - baseline_score);
}

/* Safe first filter experiment: only exercise the already-used
 * phy_wifi_fbw_sel() BW40/BW20 path. Unknown channel-filter ROM calls remain
 * read-only research candidates until their C5 ABI and register effects are
 * proven. */
static void lab_run_bandwidth_probe(void)
{
    if (rf_get_experimental_hw_agc()) {
        printf("C5VRX_BW_PROBE_REFUSED reason=hw_agc_profile\n");
        return;
    }
    if (s_gain_sweep.active || s_menu_active) {
        printf("C5VRX_BW_PROBE_REFUSED reason=%s\n",
               s_gain_sweep.active ? "gain_sweep_active" : "menu_active");
        return;
    }

    const analog_agc_mode_t saved_agc_mode = s_agc_mode;
    const agc_state_t saved_agc_state = s_agc_state;
    const rf_bw_mode_t saved_bw_mode = s_rf_bw_mode;
    const bool saved_bw40 = s_current_bw40;
    const afc_mode_t saved_afc_mode = s_afc_mode;
    const int saved_offset = rf_get_frequency_offset_khz();
    const bool saved_quiet = s_lab_quiet;
    const bool saved_profile_fft = s_profile_fft_forced;
    const int8_t saved_profile_fft_value = s_fft_best_value;

    s_agc_mode = ANALOG_AGC_MANUAL;
    s_afc_mode = AFC_MODE_OFF;
    if (saved_offset != 0) apply_frequency_offset_khz_tracked(0);
    s_lab_quiet = true;
    rf_set_fft_scale_force(false, 0);
    s_lab_fft_forced = false;
    s_lab_fft_value = 0;
    s_profile_fft_forced = false;
    vTaskDelay(pdMS_TO_TICKS(250));
    lab_reset_correlation();

    printf("C5VRX_BW_PROBE_BEGIN gain=%u settle_ms=%u order=40,20\n",
           s_current_gain, LAB_BW_SETTLE_MS);

    const bool states[2] = {true, false};
    for (unsigned i = 0; i < 2; ++i) {
        const hw_transport_counters_t base = lab_counter_snapshot();
        apply_rf_bandwidth(states[i]);
        vTaskDelay(pdMS_TO_TICKS(LAB_BW_SETTLE_MS));
        lab_print_row("BW_SWEEP", &base);
    }

    s_rf_bw_mode = saved_bw_mode;
    if (s_current_bw40 != saved_bw40) apply_rf_bandwidth(saved_bw40);
    s_afc_mode = saved_afc_mode;
    if (rf_get_frequency_offset_khz() != saved_offset) {
        apply_frequency_offset_khz_tracked(saved_offset);
    }
    s_agc_state = saved_agc_state;
    s_agc_mode = saved_agc_mode;
    s_lab_quiet = saved_quiet;
    if (saved_profile_fft && saved_profile_fft_value != 0) {
        s_last_phy_write_us = esp_timer_get_time();
        s_last_phy_write_kind = PHY_WRITE_FFT;
        rf_set_fft_scale_force(true, saved_profile_fft_value);
        s_profile_fft_forced = true;
    }

    printf("C5VRX_BW_PROBE_END restored_agc=%u restored_bw=%u\n",
           (unsigned)saved_agc_mode, saved_bw40 ? 40u : 20u);
}


static void apply_rx_profile(rx_profile_t profile)
{
    if (profile >= RX_PROFILE_COUNT) profile = RX_PROFILE_BALANCED;

    /* Leave any previous experimental state first. */
    if (rf_get_experimental_hw_agc()) {
        s_last_phy_write_us = esp_timer_get_time();
        s_last_phy_write_kind = PHY_WRITE_HW_AGC;
        (void)rf_set_experimental_hw_agc(false, 62u);
    }
    if (s_profile_fft_forced) {
        s_last_phy_write_us = esp_timer_get_time();
        s_last_phy_write_kind = PHY_WRITE_FFT;
        rf_set_fft_scale_force(false, 0);
        s_profile_fft_forced = false;
    }

    s_rx_profile = profile;
    ++s_profile_generation;
    s_agc_state = AGC_STATE_SEARCH;

    switch (profile) {
    case RX_PROFILE_RANGE_EXP:
        s_agc_mode = ANALOG_AGC_ACTIVE;
        s_rf_bw_mode = RF_BW_MODE_BW40;
        apply_rf_bandwidth(true);
        s_afc_mode = AFC_MODE_OFF;
        if (rf_get_frequency_offset_khz() != 0) apply_frequency_offset_khz_tracked(0);
        apply_rx_gain_tracked(62u);
        break;

    case RX_PROFILE_BLOCKER_EXP:
        s_agc_mode = ANALOG_AGC_ACTIVE;
        s_rf_bw_mode = RF_BW_MODE_BW40;
        apply_rf_bandwidth(true);
        s_afc_mode = AFC_MODE_OFF;
        if (rf_get_frequency_offset_khz() != 0) apply_frequency_offset_khz_tracked(0);
        apply_rx_gain_tracked(36u);
        break;

    case RX_PROFILE_RECOVERY_EXP:
        s_agc_mode = ANALOG_AGC_ACTIVE;
        s_rf_bw_mode = RF_BW_MODE_BW40;
        apply_rf_bandwidth(true);
        s_afc_mode = AFC_MODE_AUTO;
        apply_rx_gain_tracked(52u);
        break;

    case RX_PROFILE_AUTO_EXP:
        s_agc_mode = ANALOG_AGC_ACTIVE;
        s_rf_bw_mode = RF_BW_MODE_AUTO;
        apply_rf_bandwidth(true);
        s_afc_mode = AFC_MODE_AUTO;
        apply_rx_gain_tracked(52u);
        /* FFT is only promoted after this exact boot has measured a material
         * raw-Q4 benefit with the bounded F probe. */
        if (s_fft_q4_effect_known && s_fft_q4_effective) {
            s_last_phy_write_us = esp_timer_get_time();
            s_last_phy_write_kind = PHY_WRITE_FFT;
            rf_set_fft_scale_force(true, s_fft_best_value);
            s_profile_fft_forced = true;
        }
        break;

    case RX_PROFILE_HW_AGC_EXP:
        s_agc_mode = ANALOG_AGC_MANUAL; /* software must not fight vendor AGC */
        s_rf_bw_mode = RF_BW_MODE_BW40;
        apply_rf_bandwidth(true);
        s_afc_mode = AFC_MODE_OFF;
        if (rf_get_frequency_offset_khz() != 0) apply_frequency_offset_khz_tracked(0);
        s_last_phy_write_us = esp_timer_get_time();
        s_last_phy_write_kind = PHY_WRITE_HW_AGC;
        if (!rf_set_experimental_hw_agc(true, 62u)) {
            s_rx_profile = RX_PROFILE_BALANCED;
            s_agc_mode = ANALOG_AGC_ACTIVE;
            apply_rx_gain_tracked(52u);
        }
        break;

    case RX_PROFILE_BALANCED:
    default:
        s_noise_floor_valid = false;
        s_phy_rssi_valid = false;
        s_agc_mode = ANALOG_AGC_ACTIVE;
        s_rf_bw_mode = RF_BW_MODE_BW40;
        apply_rf_bandwidth(true);
        s_afc_mode = AFC_MODE_OFF;
        if (rf_get_frequency_offset_khz() != 0) apply_frequency_offset_khz_tracked(0);
        apply_rx_gain_tracked(52u);
        break;
    }

    video_standard_detector_reset();
}

static void cycle_rx_profile(void)
{
    rx_profile_t next = (rx_profile_t)(((unsigned)s_rx_profile + 1u) % RX_PROFILE_COUNT);
    apply_rx_profile(next);
    settings_save();
    printf("[RX PROFILE] -> %s (BW=%s AFC=%s HW_AGC=%u FFT=%s)\n",
           rx_profile_name(), rf_bw_mode_name(),
           s_afc_mode == AFC_MODE_AUTO ? "AUTO" :
           s_afc_mode == AFC_MODE_HOLD ? "HOLD" : "OFF",
           rf_get_experimental_hw_agc() ? 1u : 0u,
           s_profile_fft_forced ? "FORCED" : "AUTO");
}

static void leave_experimental_profile(void)
{
    if (rf_get_experimental_hw_agc()) {
        s_last_phy_write_us = esp_timer_get_time();
        s_last_phy_write_kind = PHY_WRITE_HW_AGC;
        (void)rf_set_experimental_hw_agc(false, 62u);
    }
    if (s_profile_fft_forced) {
        s_last_phy_write_us = esp_timer_get_time();
        s_last_phy_write_kind = PHY_WRITE_FFT;
        rf_set_fft_scale_force(false, 0);
        s_profile_fft_forced = false;
    }
    s_rx_profile = RX_PROFILE_RANGE_EXP;
    ++s_profile_generation;
}

/* Modern standalone menu renderer.
 *
 * SRAM-safe production raster: 384x56 logical pixels. Horizontal coordinates
 * use a sharp fractional 189/50 DAC-sample scale, and every logical Y row is
 * emitted on three scanlines. This makes the on-screen controls 50% taller without the
 * oversized 400x72x4 backing store that exceeded ESP32-C5 DRAM.
 */
enum {
    UI_ROOT = 22,
    UI_HEADER = 24,
    UI_PANEL = 26,
    UI_PANEL_2 = 29,
    UI_DIVIDER = 33,
    UI_MUTED = 39,
    UI_SELECTED = 43,
    UI_SELECTED_EDGE = 48,
    UI_STRONG = 54,
    UI_WHITE = 60,
};

static const uint8_t s_menu_icons[6][8] = {
    {0x10,0x38,0x54,0x10,0x10,0x38,0x7c,0x00}, /* band / antenna */
    {0x7e,0x42,0x5a,0x5a,0x5a,0x42,0x7e,0x00}, /* channel */
    {0x00,0x40,0x50,0x54,0x55,0x55,0x55,0x00}, /* RF bars */
    {0x10,0x10,0x54,0x38,0x54,0x10,0x10,0x00}, /* AFC crosshair */
    {0x7e,0x42,0x42,0x42,0x7e,0x18,0x3c,0x00}, /* video */
    {0x7c,0x44,0x04,0x1f,0x04,0x44,0x7c,0x00}, /* exit */
};
static const char *const s_menu_nav[6] = {
    "BAND", "CHANNEL", "RF", "AFC", "VIDEO", "EXIT"
};

static inline void menu_ui_pixel(int x, int y, uint8_t code)
{
    if ((unsigned)x >= MENU_UI_WIDTH || (unsigned)y >= MENU_UI_LINES) return;
    unsigned x0 = (unsigned)x * MENU_UI_X_SCALE_NUM / MENU_UI_X_SCALE_DEN;
    unsigned x1 = (unsigned)(x + 1) * MENU_UI_X_SCALE_NUM / MENU_UI_X_SCALE_DEN;
    memset(&s_menu_raster.ui[y][x0], code, x1 - x0);
}

static void menu_ui_rect(int x, int y, int w, int h, uint8_t code)
{
    if (w <= 0 || h <= 0) return;
    int x0 = x < 0 ? 0 : x;
    int y0 = y < 0 ? 0 : y;
    int x1 = x + w > (int)MENU_UI_WIDTH ? (int)MENU_UI_WIDTH : x + w;
    int y1 = y + h > (int)MENU_UI_LINES ? (int)MENU_UI_LINES : y + h;
    if (x1 <= x0 || y1 <= y0) return;
    for (int yy = y0; yy < y1; ++yy) {
        unsigned sx0 = (unsigned)x0 * MENU_UI_X_SCALE_NUM / MENU_UI_X_SCALE_DEN;
        unsigned sx1 = (unsigned)x1 * MENU_UI_X_SCALE_NUM / MENU_UI_X_SCALE_DEN;
        memset(&s_menu_raster.ui[yy][sx0], code, sx1 - sx0);
    }
}

static void menu_ui_hline(int x, int y, int w, uint8_t code)
{
    menu_ui_rect(x, y, w, 1, code);
}

static void menu_ui_vline(int x, int y, int h, uint8_t code)
{
    menu_ui_rect(x, y, 1, h, code);
}

static void menu_ui_glyph(char ch, int x, int y, uint8_t code, unsigned scale)
{
    unsigned index = (ch >= 32 && ch <= 126) ? (unsigned)ch - 32u : 0u;
    if (scale == 0u) scale = 1u;
    for (unsigned gy = 0; gy < 8u; ++gy) {
        uint8_t bits = s_font8x8[index][gy];
        for (unsigned gx = 0; gx < 8u; ++gx) {
            if (bits & (0x80u >> gx)) {
                menu_ui_rect(x + (int)(gx * scale), y + (int)(gy * scale),
                             (int)scale, (int)scale, code);
            }
        }
    }
}

static void menu_ui_text(const char *str, int x, int y, uint8_t code)
{
    if (!str) return;
    for (; *str && x < (int)MENU_UI_WIDTH; ++str, x += 8) {
        menu_ui_glyph(*str, x, y, code, 1u);
    }
}

static void menu_ui_text_scaled(const char *str, int x, int y, uint8_t code, unsigned scale)
{
    if (!str || scale == 0u) return;
    int advance = (int)(8u * scale);
    for (; *str && x < (int)MENU_UI_WIDTH; ++str, x += advance) {
        menu_ui_glyph(*str, x, y, code, scale);
    }
}

static void menu_ui_text_right(const char *str, int right, int y, uint8_t code)
{
    size_t n = str ? strlen(str) : 0u;
    menu_ui_text(str, right - (int)(n * 8u), y, code);
}

static void menu_ui_icon(unsigned icon, int x, int y, uint8_t code)
{
    if (icon >= 6u) return;
    for (unsigned gy = 0; gy < 8u; ++gy) {
        uint8_t bits = s_menu_icons[icon][gy];
        for (unsigned gx = 0; gx < 8u; ++gx) {
            if (bits & (0x80u >> gx)) menu_ui_pixel(x + (int)gx, y + (int)gy, code);
        }
    }
}

static void menu_ui_value_box(int x, int y, int w, const char *label, const char *value)
{
    menu_ui_rect(x, y, w, 10, UI_PANEL_2);
    menu_ui_hline(x, y, w, UI_DIVIDER);
    menu_ui_text(label, x + 3, y + 1, UI_MUTED);
    menu_ui_text_right(value, x + w - 3, y + 1, UI_WHITE);
}

static void menu_ui_meter(int x, int y, int w, int value, int maximum)
{
    if (maximum <= 0) maximum = 1;
    if (value < 0) value = 0;
    if (value > maximum) value = maximum;
    menu_ui_rect(x, y, w, 5, UI_ROOT);
    menu_ui_rect(x + 1, y + 1, w - 2, 3, UI_PANEL_2);
    int fill = (w - 2) * value / maximum;
    if (fill > 0) menu_ui_rect(x + 1, y + 1, fill, 3, UI_STRONG);
}

static void menu_ui_signal_bars(int x, int y, int quality)
{
    int bars = quality <= 0 ? 0 : (quality >= 100 ? 5 : (quality + 19) / 20);
    for (int i = 0; i < 5; ++i) {
        int h = 2 + i;
        menu_ui_rect(x + i * 3, y + 7 - h, 2, h,
                     i < bars ? UI_WHITE : UI_DIVIDER);
    }
}

static bool menu_append_segment(void *ctx, const uint8_t *data, unsigned length)
{
    (void)ctx;
    if (s_menu_node_count >= MENU_NODE_CAPACITY || length > 4092 ||
        ((uintptr_t)data & 3) || (length & 3)) return false;
    dma_descriptor_t *node = &s_menu_nodes[s_menu_node_count++];
    memset(node, 0, sizeof(*node));
    node->dw0.size = length;
    node->dw0.length = length;
    node->dw0.owner = 1;
    node->buffer = (void *)data;
    node->next = &s_menu_nodes[s_menu_node_count];
    return true;
}

static void menu_render_menu(void);

static void menu_init_buffers(void)
{
    menu_raster_init(&s_menu_raster, s_video_std);
    s_menu_node_count = 0;
    ESP_ERROR_CHECK(menu_raster_emit(&s_menu_raster, s_video_std,
                                   menu_append_segment, NULL) ? ESP_OK : ESP_ERR_INVALID_SIZE);
    s_menu_nodes[s_menu_node_count - 1].next = s_menu_nodes;
    menu_render_menu();
    sync_dma_c2m(&s_menu_raster, sizeof(s_menu_raster));
    sync_dma_c2m(s_menu_nodes, s_menu_node_count * sizeof(*s_menu_nodes));
}

static const char *video_standard_name(video_standard_t standard)
{
    return standard == VIDEO_STD_PAL ? "PAL 625i" : "NTSC 525i";
}

static video_standard_t resolved_menu_standard(void)
{
    if (s_video_std_mode == VIDEO_STD_MODE_PAL) return VIDEO_STD_PAL;
    if (s_video_std_mode == VIDEO_STD_MODE_NTSC) return VIDEO_STD_NTSC;
    return s_detected_video_std_valid ? s_detected_video_std : s_video_std;
}

static const char *agc_state_name(void)
{
    return s_agc_state == AGC_STATE_TRACK ? "TRACK" :
           s_agc_state == AGC_STATE_LEARN ? "LEARN" : "SEARCH";
}

static const char *agc_mode_name(void)
{
    if (s_rx_profile == RX_PROFILE_HW_AGC_EXP && rf_get_experimental_hw_agc()) {
        return "HW EXP";
    }
    return s_agc_mode == ANALOG_AGC_ACTIVE ? "AUTO" :
           s_agc_mode == ANALOG_AGC_SHADOW ? "SHADOW" : "MANUAL";
}

static const char *afc_mode_name(void)
{
    return s_afc_mode == AFC_MODE_AUTO ? "AUTO" :
           s_afc_mode == AFC_MODE_HOLD ? "HOLD" : "OFF";
}

static void menu_draw_shell(void)
{
    menu_ui_rect(0, 0, MENU_UI_WIDTH, MENU_UI_LINES, UI_PANEL);

    menu_ui_rect(0, 0, MENU_UI_WIDTH, 8, UI_HEADER);
    menu_ui_rect(4, 1, 6, 6, UI_WHITE);
    menu_ui_rect(6, 3, 2, 2, UI_HEADER);
    menu_ui_text("C5VRX", 14, 0, UI_WHITE);

    const fpv_channel_t *ch = rf_get_current_channel();
    char buf[24];
    menu_ui_text(ch->name, 96, 0, UI_WHITE);
    snprintf(buf, sizeof(buf), "%uM", ch->freq_mhz);
    menu_ui_text(buf, 128, 0, UI_MUTED);
    if (rf_get_experimental_hw_agc()) {
        snprintf(buf, sizeof(buf), "H%u", rf_get_experimental_agc_max_gain());
    } else {
        snprintf(buf, sizeof(buf), "G%u", s_current_gain);
    }
    menu_ui_text(buf, 208, 0, UI_WHITE);
    menu_ui_text(agc_state_name(), 244, 0, UI_MUTED);
    menu_ui_signal_bars(320, 0, s_signal_strength);
    menu_ui_text(s_video_std == VIDEO_STD_PAL ? "PAL" : "NTSC", 344, 0, UI_WHITE);

    menu_ui_rect(0, 8, 92, MENU_UI_LINES - 8, UI_ROOT);
    menu_ui_vline(91, 8, MENU_UI_LINES - 8, UI_DIVIDER);
    for (unsigned i = 0; i < 6u; ++i) {
        int y = 8 + (int)i * 8;
        bool selected = (int)i == s_menu_cursor;
        if (selected) {
            menu_ui_rect(0, y, 91, 8, UI_SELECTED);
            menu_ui_rect(0, y, 3, 8, UI_WHITE);
            menu_ui_hline(3, y, 88, UI_SELECTED_EDGE);
        }
        uint8_t ink = selected ? UI_WHITE : UI_MUTED;
        menu_ui_icon(i, 5, y, ink);
        menu_ui_text(s_menu_nav[i], 18, y, ink);
    }
}

static void menu_draw_page_title(const char *title, const char *tag)
{
    menu_ui_text(title, 100, 10, UI_WHITE);
    if (tag && *tag) menu_ui_text_right(tag, 376, 10, UI_MUTED);
    menu_ui_hline(100, 19, 276, UI_DIVIDER);
}

static void menu_draw_band_page(void)
{
    char value[24];
    menu_draw_page_title("RF BAND", "48 CHANNELS");

    /* Band names are long enough to collide with the label when both are
     * right/left aligned inside the old 130 px value box. Give the active band
     * its own full-width row so every built-in band name remains readable. */
    snprintf(value, sizeof(value), "%s", rf_get_band_name(rf_get_current_band()));
    menu_ui_value_box(100, 22, 276, "ACTIVE BAND", value);

    snprintf(value, sizeof(value), "%s", rf_get_current_channel()->name);
    menu_ui_value_box(100, 34, 130, "CHANNEL", value);
    menu_ui_text("LONG: NEXT BAND", 238, 35, UI_WHITE);
    menu_ui_text("SHORT PRESS MOVES CURSOR", 100, 47, UI_MUTED);
}

static void menu_draw_channel_page(void)
{
    const fpv_channel_t *ch = rf_get_current_channel();
    char buf[24];
    menu_draw_page_title("CHANNEL", s_channel_scan_active ? "SCANNING" : "LONG: NEXT / HOLD: SCAN");

    menu_ui_rect(100, 22, 108, 23, UI_PANEL_2);
    menu_ui_vline(100, 22, 23, UI_WHITE);
    menu_ui_text("ACTIVE", 108, 23, UI_MUTED);
    menu_ui_text_scaled(ch->name, 108, 29, UI_WHITE, 2u);

    menu_ui_rect(216, 22, 160, 23, UI_ROOT);
    menu_ui_text("CENTER", 224, 23, UI_MUTED);
    snprintf(buf, sizeof(buf), "%u", ch->freq_mhz);
    menu_ui_text_scaled(buf, 224, 29, UI_WHITE, 2u);
    menu_ui_text("MHZ", 304, 36, UI_MUTED);

    menu_ui_text("SIGNAL", 100, 47, UI_MUTED);
    menu_ui_meter(156, 48, 100,
                  s_channel_scan_active ? (int)s_channel_scan_progress : s_signal_strength, 100);
    snprintf(buf, sizeof(buf), s_channel_scan_active ? "%u%%" : "S%u",
             s_channel_scan_active ? s_channel_scan_progress : (unsigned)s_signal_strength);
    menu_ui_text(buf, 264, 47, UI_WHITE);
    snprintf(buf, sizeof(buf), "G%u", s_current_gain);
    menu_ui_text_right(buf, 376, 47, UI_WHITE);
}

static void menu_draw_rf_page(void)
{
    char buf[32];
    menu_draw_page_title("RF FRONTEND",
                         s_rx_profile == RX_PROFILE_RANGE_EXP ? "DEFAULT" : "EXPERIMENTAL");
    menu_ui_value_box(100, 22, 276, "RX PROFILE", rx_profile_name());
    menu_ui_value_box(100, 34, 130, "BANDWIDTH", rf_bw_mode_name());
    menu_ui_value_box(238, 34, 138, "AGC", agc_mode_name());

    if (s_noise_floor_valid) {
        snprintf(buf, sizeof(buf), "Q%d NF%d", s_last_q_phase, s_last_noise_floor_dbm);
    } else {
        snprintf(buf, sizeof(buf), "P%d Q%d%%", s_last_p_median, s_last_q_phase);
    }
    menu_ui_text(buf, 100, 47, UI_MUTED);
    menu_ui_text_right("LONG:BW  2S:PROFILE", 376, 47, UI_WHITE);
}

static void menu_draw_afc_page(void)
{
    char buf[24];
    menu_draw_page_title("AFC", "EXPERIMENTAL");
    menu_ui_value_box(100, 22, 130, "MODE", afc_mode_name());
    snprintf(buf, sizeof(buf), "%+dK", rf_get_frequency_offset_khz());
    menu_ui_value_box(238, 22, 138, "OFFSET", buf);
    snprintf(buf, sizeof(buf), "%+dK", s_cfo_khz);
    menu_ui_value_box(100, 34, 276, "EST CFO", buf);
    menu_ui_text("DEFAULT OFF FOR FLIGHT", 100, 47, UI_MUTED);
}

static void menu_draw_video_page(void)
{
    char detected[24];
    menu_draw_page_title("VIDEO OUTPUT",
                         s_output_mode == VIDEO_OUTPUT_4BIT_80 ? "EXPERIMENTAL" : "DEFAULT");
    menu_ui_value_box(100, 22, 130, "DAC", output_mode_name());
    menu_ui_value_box(238, 22, 138, "STANDARD",
                      s_video_std == VIDEO_STD_PAL ? "PAL" : "NTSC");
    if (s_detected_video_std_valid) {
        snprintf(detected, sizeof(detected), "%s %u",
                 s_detected_video_std == VIDEO_STD_PAL ? "PAL" : "NTSC",
                 s_last_line_period_20m);
    } else {
        snprintf(detected, sizeof(detected), "SEARCHING");
    }
    menu_ui_value_box(100, 34, 276, "DETECTED", detected);
    menu_ui_text("LONG: TOGGLE OUTPUT - APPLIES ON EXIT", 100, 47, UI_MUTED);
}

static void menu_draw_exit_page(void)
{
    menu_draw_page_title("SAVE AND EXIT", "");
    menu_ui_rect(100, 23, 276, 20, UI_PANEL_2);
    menu_ui_vline(100, 23, 20, UI_WHITE);
    menu_ui_text("RETURN TO LIVE VIDEO", 116, 25, UI_WHITE);
    menu_ui_text("LONG PRESS TO EXIT", 116, 34, UI_MUTED);
    menu_ui_text("12S AUTO EXIT ENABLED", 100, 47, UI_MUTED);
}

static void menu_render_menu(void)
{
    memset(s_menu_raster.ui, UI_ROOT, sizeof(s_menu_raster.ui));
    menu_draw_shell();

    switch (s_menu_cursor) {
    case 0: menu_draw_band_page(); break;
    case 1: menu_draw_channel_page(); break;
    case 2: menu_draw_rf_page(); break;
    case 3: menu_draw_afc_page(); break;
    case 4: menu_draw_video_page(); break;
    default: menu_draw_exit_page(); break;
    }

    sync_dma_c2m(s_menu_raster.ui, sizeof(s_menu_raster.ui));
}

static void quiet_tx_interrupts(void)
{
    AHB_DMA.out_intr[s_tx_dma_ch].ena.val = 0;
    AHB_DMA.out_intr[s_tx_dma_ch].clr.val = UINT32_MAX;
    PARL_IO.int_ena.val = 0;
}

static void start_flight_demodulator(void)
{
    ESP_ERROR_CHECK(bitscrambler_enable(s_flight_bs));
    if (s_output_mode == VIDEO_OUTPUT_4BIT_80) {
        ESP_ERROR_CHECK(bitscrambler_load_program(s_flight_bs, s_fm4_program));
    } else {
        ESP_ERROR_CHECK(bitscrambler_load_program(s_flight_bs, s_fm_program));
    }
    ESP_ERROR_CHECK(bitscrambler_reset(s_flight_bs));
    ESP_ERROR_CHECK(bitscrambler_start(s_flight_bs));
}

static void start_menu_tx(void)
{
    /* IDF owns the channel allocation and stop/reset lifecycle. While its TX
     * transaction queue is empty, start our SRAM scatter chain directly.
     * No driver-private structure access and no active descriptor rewiring. */
    ESP_ERROR_CHECK(parlio_tx_unit_enable(s_tx));

    /* A 4-bit->menu reconfiguration can allocate a different GDMA channel. */
    s_tx_dma_ch = -1;
    for (int i = 0; i < 3; ++i) {
        if (AHB_DMA.channel[i].out.out_peri_sel.peri_out_sel_chn == 9) {
            s_tx_dma_ch = i;
            break;
        }
    }
    ESP_ERROR_CHECK(s_tx_dma_ch >= 0 ? ESP_OK : ESP_ERR_NOT_FOUND);

    quiet_tx_interrupts();
    parlio_ll_tx_enable_clock(&PARL_IO, false);
    parlio_ll_tx_reset_clock(&PARL_IO);
    parlio_ll_tx_reset_fifo(&PARL_IO);
    parlio_ll_tx_set_idle_data_value(&PARL_IO, DAC_IDLE_CODE);
    parlio_ll_tx_set_eof_condition(&PARL_IO, PARLIO_LL_TX_EOF_COND_DATA_LEN);
    parlio_ll_tx_set_trans_bit_len(&PARL_IO, 1);
    __asm__ __volatile__("fence rw, rw" ::: "memory");
    AHB_DMA.out_link_addr[s_tx_dma_ch].val = (uint32_t)s_menu_nodes;
    AHB_DMA.channel[s_tx_dma_ch].out.out_link.outlink_start_chn = 1;
    int64_t deadline = esp_timer_get_time() + 1000;
    while (!parlio_ll_tx_is_ready(&PARL_IO)) {
        ESP_ERROR_CHECK(esp_timer_get_time() < deadline ? ESP_OK : ESP_ERR_TIMEOUT);
    }
    parlio_ll_tx_start(&PARL_IO, true);
    parlio_ll_tx_enable_clock(&PARL_IO, true);
}

static void video_set_menu_mode(bool active)
{
#if CONFIG_C5VRX_LINK_MODE
    if (active) printf("[MENU] unavailable in link mode (no PARLIO TX)\n");
    return;
#endif
    if (active && !MENU_RUNTIME_ENABLED) return;
    if (s_menu_active == active) return;

    ESP_ERROR_CHECK(parlio_tx_unit_disable(s_tx));

    if (active) {
        /* Live -> menu: stop the live producer once. */
        ESP_ERROR_CHECK(bitscrambler_disable(s_flight_bs));

        /* Menu raster is byte-oriented 6-bit@40 even if live output was 4-bit@80. */
        if (s_tx_unit_mode != VIDEO_OUTPUT_6BIT_40) {
            ESP_ERROR_CHECK(replace_tx_unit(VIDEO_OUTPUT_6BIT_40));
        }
        s_video_std = resolved_menu_standard();
        menu_init_buffers();
        start_menu_tx();
    } else {
        /* Menu -> live: the BitScrambler is already disabled; do not disable twice. */
        if (s_tx_unit_mode != s_output_mode) {
            ESP_ERROR_CHECK(replace_tx_unit(s_output_mode));
        }
        start_flight_demodulator();
        ESP_ERROR_CHECK(parlio_rx_unit_disable(s_rx));
        ESP_ERROR_CHECK(parlio_rx_unit_enable(s_rx, false));
        ESP_ERROR_CHECK(parlio_tx_unit_enable(s_tx));

        s_tx_dma_ch = -1;
        for (int i = 0; i < 3; ++i) {
            if (AHB_DMA.channel[i].out.out_peri_sel.peri_out_sel_chn == 9) {
                s_tx_dma_ch = i;
                break;
            }
        }
        ESP_ERROR_CHECK(s_tx_dma_ch >= 0 ? ESP_OK : ESP_ERR_NOT_FOUND);

        quiet_tx_interrupts();
        ESP_ERROR_CHECK(start_rx());
        AHB_DMA.in_intr[s_rx_dma_ch].ena.val = 0;
        PARL_IO.rx_genrl_cfg.rx_eof_gen_sel = 1;
        esp_rom_delay_us(8192ULL * 1000000ULL / IQ_RATE_HZ);
        ESP_ERROR_CHECK(start_tx());
        quiet_tx_interrupts();
        patch_descriptors_clear_eof(s_rx_dma_ch, true);
        patch_descriptors_clear_eof(s_tx_dma_ch, false);
    }
    s_menu_timeout_ticks = 0;
    s_menu_active = active;
}

static void menu_cycle_standard_mode(void)
{
    if (s_menu_active) ESP_ERROR_CHECK(parlio_tx_unit_disable(s_tx));
    if (s_video_std_mode == VIDEO_STD_MODE_AUTO) {
        s_video_std_mode = VIDEO_STD_MODE_NTSC;
        s_video_std = VIDEO_STD_NTSC;
    } else if (s_video_std_mode == VIDEO_STD_MODE_NTSC) {
        s_video_std_mode = VIDEO_STD_MODE_PAL;
        s_video_std = VIDEO_STD_PAL;
    } else {
        s_video_std_mode = VIDEO_STD_MODE_AUTO;
        s_video_std = resolved_menu_standard();
    }
    if (s_menu_active) {
        menu_init_buffers();
        start_menu_tx();
    }
    settings_save();
}

static void init_boot_button(void)
{
    const gpio_config_t cfg = {
        .pin_bit_mask = 1ULL << BOOT_BTN_GPIO,
        .mode = GPIO_MODE_INPUT,
        .pull_up_en = GPIO_PULLUP_ENABLE,
        .pull_down_en = GPIO_PULLDOWN_DISABLE,
        .intr_type = GPIO_INTR_DISABLE,
    };
    gpio_config(&cfg);
}

static void channel_auto_search(void)
{
    const size_t original_channel = rf_get_channel_index();
    const uint8_t original_gain = s_current_gain;
    const size_t channel_count = rf_get_channel_count();
    size_t best_channel = original_channel;
    int best_rank = -1;
    int best_quality = 0;

    s_channel_scan_active = true;
    s_channel_scan_progress = 0;
    rf_set_rx_gain(true, 52u); /* Compare every channel at the same RF gain. */

    for (size_t channel = 0; channel < channel_count; ++channel) {
        if (rf_set_channel(channel) != ESP_OK) continue;
        vTaskDelay(pdMS_TO_TICKS(90));
        uint8_t *src = get_completed_rx_sample_window(CONTROL_SAMPLE_BYTES);
        size_t scan_ring_offset =
            (src >= s_raw_ring && src < s_raw_ring + sizeof(s_raw_ring)) ?
            (size_t)(src - s_raw_ring) : 0u;
        sync_dma_m2c(src, CONTROL_SAMPLE_BYTES);
        memcpy(s_control_sample_buf, src, sizeof(s_control_sample_buf));
        control_metrics_t metrics =
            analyze_control_window(s_control_sample_buf,
                                   sizeof(s_control_sample_buf),
                                   scan_ring_offset);
        int quality = signal_strength_score(&metrics, 52u);
        int rank = metrics.q_phase * 4 + metrics.p_median + quality -
                   demod_winding_penalty(metrics.winding_permille);
        if (metrics.q_phase >= 22 && rank > best_rank) {
            best_rank = rank;
            best_channel = channel;
            best_quality = quality;
        }
        s_channel_scan_progress = (unsigned)((channel + 1u) * 100u / channel_count);
        menu_render_menu();
    }

    if (best_rank < 0) best_channel = original_channel;
    (void)rf_set_channel(best_channel);
    rf_set_rx_gain(true, original_gain);
    s_signal_strength = best_rank < 0 ? 0 : best_quality;
    s_channel_scan_active = false;
    s_channel_scan_progress = 0;
    s_cfo_khz = 0;
    s_agc_state = AGC_STATE_SEARCH;
    video_standard_detector_reset();
    settings_save();
    menu_render_menu();
    printf("[AUTO SEARCH] %s -> %s (%u MHz), signal=%d\n",
           best_rank < 0 ? "No carrier; restored" : "Selected",
           rf_get_current_channel()->name, rf_get_current_channel()->freq_mhz,
           s_signal_strength);
}

static void handle_button_short_click(void)
{
    if (s_menu_active) {
        s_menu_cursor = (s_menu_cursor + 1) % 6;
        menu_render_menu();
        s_menu_timeout_ticks = 0;
        printf("[BTN: SHORT] Menu cursor -> %d\n", s_menu_cursor);
    } else {
        rf_cycle_channel_in_band();
        s_cfo_khz = 0;
        s_agc_state = AGC_STATE_SEARCH;
        video_standard_detector_reset();
        settings_save();
        const fpv_channel_t *ch = rf_get_current_channel();
        printf("[BTN: SHORT] Channel switched to %s (%u MHz) in %s\n",
               ch->name, ch->freq_mhz, rf_get_band_name(rf_get_current_band()));
    }
}

static void handle_button_long_click(void)
{
    if (!s_menu_active) {
        if (!MENU_RUNTIME_ENABLED) {
            printf("[BTN: LONG] Menu temporarily disabled; live video unchanged\n");
            return;
        }
        if (!s_menu_boot_btn_enabled) {
            printf("[BTN: LONG] Menu via BOOT button is DISABLED (Safe Flight Mode)\n");
            return;
        }
        s_menu_cursor = 0;
        s_menu_timeout_ticks = 0;
        video_set_menu_mode(true);
        printf("[BTN: LONG] Menu Opened!\n");
    } else {
        switch (s_menu_cursor) {
        case 0: /* BAND */
            rf_cycle_band();
            s_cfo_khz = 0;
            s_agc_state = AGC_STATE_SEARCH;
            video_standard_detector_reset();
            settings_save();
            printf("[MENU: BAND] Switched to %s\n", rf_get_band_name(rf_get_current_band()));
            break;
        case 1: /* CHANNEL */
            rf_cycle_channel_in_band();
            s_cfo_khz = 0;
            s_agc_state = AGC_STATE_SEARCH;
            video_standard_detector_reset();
            settings_save();
            printf("[MENU: CHANNEL] Switched to %s (%u MHz)\n",
                   rf_get_current_channel()->name, rf_get_current_channel()->freq_mhz);
            break;
        case 2: /* RF BANDWIDTH (2s hold cycles whole RX profile) */
            cycle_rf_bandwidth_mode();
            settings_save();
            printf("[MENU: RF BW] Mode -> %s (active %s)\n",
                   rf_bw_mode_name(), s_current_bw40 ? "BW40" : "BW20");
            break;
        case 3: /* AFC MODE */
            if (s_afc_mode == AFC_MODE_AUTO) {
                s_afc_mode = AFC_MODE_HOLD;
            } else if (s_afc_mode == AFC_MODE_HOLD) {
                s_afc_mode = AFC_MODE_OFF;
                apply_frequency_offset_khz_tracked(0);
            } else {
                s_afc_mode = AFC_MODE_AUTO;
            }
            printf("[MENU: AFC] Mode -> %d\n", s_afc_mode);
            settings_save();
            break;
        case 4: /* VIDEO OUTPUT */
            s_output_mode = s_output_mode == VIDEO_OUTPUT_6BIT_40 ?
                            VIDEO_OUTPUT_4BIT_80 : VIDEO_OUTPUT_6BIT_40;
            printf("[MENU: OUTPUT] -> %s%s\n", output_mode_name(),
                   s_output_mode == VIDEO_OUTPUT_4BIT_80 ? " (EXPERIMENTAL)" : "");
            settings_save();
            break;
        case 5: /* SAVE & EXIT */
            settings_save();
            video_set_menu_mode(false);
            printf("[BTN: LONG] Menu Closed -> Live Video!\n");
            return;
        default:
            break;
        }
        menu_render_menu();
        s_menu_timeout_ticks = 0;
    }
}


static void analog_agc_task(void *arg)
{
    (void)arg;
    int settle_ticks = 0;
    int drift_counter = 0;
    int lost_counter = 0;
    int afc_ticks = 0;
    int bw_deep_fade_ticks = 0;
    int bw_recovery_ticks = 0;
    int overload_counter = 0;
    int learn_adjust_counter = 0;
    int search_probe_ticks = 0;
    int search_carrier_ticks = 0;
    int telemetry_ticks = 0;
    int menu_refresh_ticks = 0;
    int phy_metric_ticks = 0;
    uint32_t seen_profile_generation = s_profile_generation;
    uint8_t target_gain = s_current_gain;
    int sync_age_ticks = 40;
    int learn_timeout_ticks = 0;
    unsigned range_probe_index = 0;
    int btn_ticks = 0;
    bool btn_long_fired = false;
    bool btn_scan_fired = false;
    bool btn_profile_fired = false;
    bool was_locked = false;
    range_control_t range_controller;
    range_control_reset(&range_controller, s_current_gain);
    uint32_t receive_generation = s_receive_generation;
    int boot_grace_ticks = 20;

    for (;;) {
        vTaskDelay(pdMS_TO_TICKS(50));

        int command;
        for (unsigned commands = 0; commands < 16 &&
             xQueueReceive(s_menu_commands, &command, 0) == pdTRUE; ++commands) {
            if (command == 'o') {
                if (MENU_RUNTIME_ENABLED) video_set_menu_mode(!s_menu_active);
                else printf("[MENU] Temporarily disabled; live video unchanged\n");
            } else if (command == 'v' || command == 'V') {
                if (MENU_RUNTIME_ENABLED) menu_cycle_standard_mode();
                else printf("[MENU] Video-standard control unavailable while menu is disabled\n");
            } else if (command == 'O') {
                if (MENU_RUNTIME_ENABLED) {
                    s_menu_boot_btn_enabled = !s_menu_boot_btn_enabled;
                    settings_save();
                }
                else printf("[MENU] BOOT menu trigger is temporarily disabled\n");
            } else if (s_menu_active && (command == ' ' || command == 'n' || command == '\t'))
                handle_button_short_click();
            else if (s_menu_active) handle_button_long_click();
        }

        if (boot_grace_ticks > 0) {
            boot_grace_ticks--;
            btn_ticks = 0;
            btn_long_fired = false;
            btn_scan_fired = false;
            btn_profile_fired = false;
        } else {
            int btn_level = gpio_get_level(BOOT_BTN_GPIO);
            if (btn_level == 0) {
                btn_ticks++;

                /* RF page gets two independent controls without adding menu
                 * geometry: 0.6-2.0 s changes BW on release; >=2.0 s changes
                 * the complete RX profile once. */
                if (s_menu_active && s_menu_cursor == 2) {
                    if (btn_ticks >= 40 && !btn_profile_fired) {
                        btn_profile_fired = true;
                        btn_long_fired = true;
                        cycle_rx_profile();
                        menu_render_menu();
                        s_menu_timeout_ticks = 0;
                    }
                } else if (btn_ticks >= 12 && !btn_long_fired) {
                    btn_long_fired = true;
                    handle_button_long_click();
                }

                if (btn_ticks >= 40 && s_menu_active && s_menu_cursor == 1 && !btn_scan_fired) {
                    btn_scan_fired = true;
                    channel_auto_search();
                    s_menu_timeout_ticks = 0;
                }
            } else if (btn_ticks > 0) {
                if (s_menu_active && s_menu_cursor == 2) {
                    if (!btn_profile_fired && btn_ticks >= 12) {
                        handle_button_long_click(); /* normal RF bandwidth action */
                    } else if (!btn_profile_fired && btn_ticks >= 2) {
                        handle_button_short_click();
                    }
                } else if (!btn_long_fired && btn_ticks >= 2) {
                    handle_button_short_click();
                }
                btn_ticks = 0;
                btn_long_fired = false;
                btn_scan_fired = false;
                btn_profile_fired = false;
            }
        }

        bool menu_was_active = s_menu_active;
        if (seen_profile_generation != s_profile_generation) {
            seen_profile_generation = s_profile_generation;
            target_gain = s_current_gain;
            settle_ticks = GAIN_SETTLE_TICKS;
            drift_counter = lost_counter = overload_counter = 0;
            learn_adjust_counter = search_probe_ticks = search_carrier_ticks = 0;
            range_probe_index = 0;
            sync_age_ticks = 40;
            learn_timeout_ticks = 0;
        }

        if (menu_was_active) {
            s_menu_timeout_ticks++;
            if (s_menu_timeout_ticks >= 240) {
                settings_save();
                video_set_menu_mode(false);
                AGC_PRINTF("[MENU] Inactivity timeout (12s) -> Live Video\n");
            }
        }

        poll_transport_faults();

        /* A complete finished descriptor gives 102.3 us of Q4/I4 rather than
         * the old 6.4 us peek, while averaging only ~82 kB/s of CPU reads. */
        uint8_t *sample_src = get_completed_rx_sample_window(CONTROL_SAMPLE_BYTES);
        size_t ring_offset = (sample_src >= s_raw_ring && sample_src < s_raw_ring + sizeof(s_raw_ring))
                           ? (size_t)(sample_src - s_raw_ring) : 0u;
        sync_dma_m2c((void *)sample_src, CONTROL_SAMPLE_BYTES);
        memcpy(s_control_sample_buf, sample_src, sizeof(s_control_sample_buf));
        control_metrics_t metrics =
            analyze_control_window(s_control_sample_buf,
                                   sizeof(s_control_sample_buf),
                                   ring_offset);

        int p_median = metrics.p_median;
        int q_phase = metrics.q_phase;
        int n_clip = metrics.n_clip;
        int n_origin = metrics.n_origin;
        int clip_permille = metrics.clip_permille;
        int origin_permille = metrics.origin_permille;
        int winding_permille = metrics.winding_permille;

        s_last_p_median = p_median;
        s_last_q_phase = q_phase;
        s_last_n_clip = n_clip;
        s_last_n_origin = n_origin;
        s_last_clip_permille = clip_permille;
        s_last_origin_permille = origin_permille;
        s_last_dc_i_x100 = metrics.dc_i_x100;
        s_last_dc_q_x100 = metrics.dc_q_x100;
        s_last_iq_skew_permille = metrics.iq_skew_permille;
        s_last_iq_cross_permille = metrics.iq_cross_permille;
        s_last_winding_permille = metrics.winding_permille;
        s_last_strong_winding_permille = metrics.strong_winding_permille;

        /* The undocumented reads are observation-only and rate-limited. AUTO
         * uses them only when they return physically plausible values. */
        if (s_rx_profile == RX_PROFILE_AUTO_EXP && ++phy_metric_ticks >= 5) {
            phy_metric_ticks = 0;
            int value;
            s_noise_floor_valid = rf_try_get_noise_floor_dbm(&value);
            if (s_noise_floor_valid) s_last_noise_floor_dbm = value;
            s_phy_rssi_valid = rf_try_get_wideband_rssi_dbm(&value);
            if (s_phy_rssi_valid) s_last_phy_rssi_dbm = value;
        } else if (s_rx_profile != RX_PROFILE_AUTO_EXP) {
            phy_metric_ticks = 0;
            s_noise_floor_valid = false;
            s_phy_rssi_valid = false;
        }

        int instant_strength = signal_strength_score(&metrics, s_current_gain);
        s_signal_strength = (s_signal_strength * 3 + instant_strength + 2) / 4;

        if (menu_was_active) {
            if (++menu_refresh_ticks >= 5) {
                menu_refresh_ticks = 0;
                menu_render_menu();
            }
            /* The menu raster has its own TX DMA chain, while PARLIO RX keeps
             * filling the raw IQ ring.  Keep the receive controller running
             * so Gxx and the signal indication reflect the selected channel
             * instead of freezing at the value from when the menu opened. */
        } else {
            menu_refresh_ticks = 0;
        }

        /* Issue #28 classifier: if raw carrier coherence collapses within
         * 200 ms of a new gain state while no transport fault is required to
         * explain it, count the transition once. This is evidence for an
         * RF/PHY transient, not proof of a DMA stall. */
        if (s_gain_transition_count != s_last_gain_drop_transition &&
            s_last_gain_write_us > 0) {
            int64_t gain_age = esp_timer_get_time() - s_last_gain_write_us;
            if (gain_age >= 0 && gain_age <= 200000 &&
                q_phase < 25 && p_median < 12) {
                ++s_hw_counters.gain_quality_drop_count;
                s_last_gain_drop_transition = s_gain_transition_count;
            }
        }

        if (metrics.n_coherent >= (int)(CONTROL_SAMPLE_BYTES / 8u) && metrics.sum_dot > 0) {
            int instant_cfo = (int)(((int64_t)metrics.sum_cross * 6366LL) / metrics.sum_dot);
            if (instant_cfo > 2000) instant_cfo = 2000;
            if (instant_cfo < -2000) instant_cfo = -2000;
            s_cfo_khz = (s_cfo_khz * 7 + instant_cfo) / 8;
        }

        int sync_quality = 0;
        bool fresh_sync = false;
        if (settle_ticks == 0) {
            sync_quality = video_semantic_observe(s_control_sample_buf,
                                                  sizeof(s_control_sample_buf),
                                                  ring_offset);
            fresh_sync = sync_quality >= 70;
        }
        if (fresh_sync) sync_age_ticks = 0;
        else if (sync_age_ticks < 100) ++sync_age_ticks;
        bool recent_sync = sync_age_ticks < 20;


        if (s_rx_profile == RX_PROFILE_HW_AGC_EXP && rf_get_experimental_hw_agc()) {
            /* Vendor AGC owns gain only in this explicitly experimental mode.
             * C5VRX still classifies lock and transport but never writes gain. */
            if (fresh_sync && q_phase >= 65 && p_median >= 10 &&
                clip_permille < 40 && !demod_static_heavy(winding_permille)) {
                s_agc_state = AGC_STATE_TRACK;
            } else if (q_phase >= 25) {
                s_agc_state = AGC_STATE_LEARN;
            } else {
                s_agc_state = AGC_STATE_SEARCH;
            }
            s_shadow_gain = rf_get_experimental_agc_max_gain();
            goto profile_post_gain;
        }

        if (s_agc_mode == ANALOG_AGC_MANUAL) {
            target_gain = s_current_gain;
            s_shadow_gain = s_current_gain;
            goto apply_target;
        }

        if (s_rx_profile == RX_PROFILE_RANGE_EXP) {
            if (receive_generation != s_receive_generation ||
                range_controller.gain != s_current_gain) {
                receive_generation = s_receive_generation;
                range_control_reset(&range_controller, s_current_gain);
            }
            if (s_agc_mode == ANALOG_AGC_ACTIVE) {
                target_gain = range_control_tick(&range_controller, fresh_sync,
                    sync_quality, p_median, q_phase, clip_permille,
                    origin_permille, winding_permille);
                s_agc_state = range_controller.locked ? AGC_STATE_TRACK :
                              AGC_STATE_LEARN;
                s_shadow_gain = target_gain;
                if (target_gain != s_current_gain) apply_rx_gain_tracked(target_gain);
                /* The controller owns settling. Observe sync throughout;
                 * its hold excludes post-write observations from decisions. */
                settle_ticks = 0;
                goto control_tail;
            }
        }

        /* Allow severe clipping protection after two observation ticks even
         * while ordinary gain decisions are held for settling. */
        if (settle_ticks > 0) {
            --settle_ticks;
            if (!(clip_permille >= 80 &&
                  settle_ticks <= GAIN_SETTLE_TICKS - 2)) goto control_tail;
        }

        if (clip_permille >= 80) {
            target_gain = profile_gain_clamp((int)target_gain - 4);
            s_agc_state = AGC_STATE_LEARN;
            overload_counter = 0;
            learn_adjust_counter = 0;
            drift_counter = 0;
            lost_counter = 0;
            goto apply_target;
        }
        if (clip_permille >= 20) {
            ++overload_counter;
            if (overload_counter >= 2) {
                target_gain = profile_gain_clamp((int)target_gain - 2);
                s_agc_state = AGC_STATE_LEARN;
                overload_counter = 0;
                learn_adjust_counter = 0;
                drift_counter = 0;
                lost_counter = 0;
                goto apply_target;
            }
        } else {
            overload_counter = 0;
        }

        switch (s_agc_state) {
        case AGC_STATE_SEARCH: {
            /* One noisy 50 ms window must not stop the gain probe. RANGE in
             * particular sees plausible amplitude at G62 even with only
             * static. Require repeated phase-coherent windows before LEARN. */
            bool search_candidate = s_rx_profile == RX_PROFILE_RANGE_EXP ?
                (recent_sync && q_phase >= 30 && p_median >= 8 &&
                 origin_permille < 700 && clip_permille < 40 &&
                 winding_permille < 260) :
                (q_phase >= 30 ||
                 (q_phase >= 20 && p_median >= 8 && origin_permille < 700));
            int required_carrier_ticks =
                s_rx_profile == RX_PROFILE_RANGE_EXP ? 3 : 1;
            if (search_candidate) {
                if (++search_carrier_ticks >= required_carrier_ticks) {
                    s_agc_state = AGC_STATE_LEARN;
                    search_carrier_ticks = 0;
                    search_probe_ticks = 0;
                    learn_adjust_counter = 0;
                    drift_counter = 0;
                    lost_counter = 0;
                }
            } else {
                search_carrier_ticks = 0;
            }

            if (s_agc_state == AGC_STATE_SEARCH &&
                ++search_probe_ticks >= (int)profile_search_probe_ticks()) {
                search_probe_ticks = 0;
                search_carrier_ticks = 0;

                if (s_rx_profile == RX_PROFILE_RANGE_EXP) {
                    /* With no confirmed video, search both weak-signal and
                     * overload states. Stop probing once video is acquired. */
                    static const uint8_t gains[] = {62, 56, 48, 40, 32, 24, 16, 8, 2};
                    range_probe_index = (range_probe_index + 1u) % sizeof(gains);
                    target_gain = gains[range_probe_index];
                } else if (s_rx_profile == RX_PROFILE_BLOCKER_EXP) {
                    target_gain = target_gain >= 44u ? 28u : 44u;
                } else if (s_rx_profile == RX_PROFILE_RECOVERY_EXP) {
                    target_gain = target_gain >= 58u ? 44u : 60u;
                } else if (s_rx_profile == RX_PROFILE_AUTO_EXP) {
                    /* Use hardware environment reads only as a bias; raw Q4
                     * remains the authoritative lock/clip signal. */
                    int snr = (s_noise_floor_valid && s_phy_rssi_valid) ?
                              s_last_phy_rssi_dbm - s_last_noise_floor_dbm : 99;
                    if (clip_permille >= 20 || (s_phy_rssi_valid && s_last_phy_rssi_dbm > -45)) {
                        target_gain = 34u;
                    } else if (snr < 10 || (s_phy_rssi_valid && s_last_phy_rssi_dbm < -75)) {
                        target_gain = 62u;
                    } else {
                        target_gain = target_gain >= 58u ? 46u : 58u;
                    }
                } else {
                    target_gain = target_gain >= 60u ? 52u : 62u;
                }
                target_gain = profile_gain_clamp(target_gain);
                goto apply_target;
            }
            break;
        }

        case AGC_STATE_LEARN: {
            /* Bounded acquisition: strong noise must not trap LEARN forever. */
            if (s_rx_profile == RX_PROFILE_RANGE_EXP && !recent_sync) {
                if (++learn_timeout_ticks >= 20) {
                    s_agc_state = AGC_STATE_SEARCH;
                    learn_timeout_ticks = search_probe_ticks = search_carrier_ticks = 0;
                    break;
                }
            } else learn_timeout_ticks = 0;
            bool iq_bad = s_rx_profile == RX_PROFILE_AUTO_EXP &&
                          (metrics.iq_skew_permille > 260 ||
                           metrics.iq_cross_permille > 260 ||
                           metrics.dc_i_x100 > 125 || metrics.dc_i_x100 < -125 ||
                           metrics.dc_q_x100 > 125 || metrics.dc_q_x100 < -125);
            bool too_hot = p_median >
                               (s_rx_profile == RX_PROFILE_RANGE_EXP ? 32 : 36) ||
                           clip_permille >= 24 ||
                           (iq_bad && p_median > 22);
            bool too_weak = (p_median < 14 || q_phase < 50) && clip_permille <= 8;

            if (too_hot) {
                if (++learn_adjust_counter >= 2) {
                    target_gain = profile_gain_clamp((int)target_gain - 2);
                    learn_adjust_counter = 0;
                    goto apply_target;
                }
            } else if (too_weak && target_gain < profile_gain_max()) {
                if (++learn_adjust_counter >= (int)profile_weak_persistence()) {
                    target_gain = profile_gain_clamp((int)target_gain + 2);
                    learn_adjust_counter = 0;
                    goto apply_target;
                }
            } else {
                learn_adjust_counter = 0;
                bool iq_lock_ok = s_rx_profile != RX_PROFILE_AUTO_EXP ||
                                  (metrics.iq_skew_permille < 380 &&
                                   metrics.iq_cross_permille < 380 &&
                                   metrics.dc_i_x100 < 175 && metrics.dc_i_x100 > -175 &&
                                   metrics.dc_q_x100 < 175 && metrics.dc_q_x100 > -175);
                if ((s_rx_profile != RX_PROFILE_RANGE_EXP || recent_sync) &&
                    q_phase >= 65 && p_median >= 14 && p_median <= 36 &&
                    clip_permille <= 16 && iq_lock_ok) {
                    s_agc_state = AGC_STATE_TRACK;
                    drift_counter = 0;
                    lost_counter = 0;
                }
            }
            break;
        }

        case AGC_STATE_TRACK: {
            if ((s_rx_profile == RX_PROFILE_RANGE_EXP &&
                 (!recent_sync || winding_permille >= 320)) ||
                (q_phase < 25 && p_median < 12)) {
                if (++lost_counter >= (s_rx_profile == RX_PROFILE_RECOVERY_EXP ? 4 : 10)) {
                    s_agc_state = AGC_STATE_SEARCH;
                    lost_counter = 0;
                    search_probe_ticks = 0;
                }
            } else {
                lost_counter = 0;
            }

            bool needs_gain_boost = (q_phase < 40 || p_median < 12) &&
                                    target_gain < profile_gain_max() && clip_permille <= 8;
            bool needs_gain_cut = p_median >
                                      (s_rx_profile == RX_PROFILE_RANGE_EXP ? 36 : 40) ||
                                  clip_permille >= 32;
            if (needs_gain_boost || needs_gain_cut) {
                if (++drift_counter >= (s_rx_profile == RX_PROFILE_RECOVERY_EXP ? 6 : 15)) {
                    s_agc_state = AGC_STATE_LEARN;
                    drift_counter = 0;
                    learn_adjust_counter = 0;
                }
            } else {
                drift_counter = 0;
            }
            break;
        }
        }

apply_target:
        target_gain = profile_gain_clamp(target_gain);
        s_shadow_gain = target_gain;
        if (s_agc_mode == ANALOG_AGC_ACTIVE && target_gain != s_current_gain) {
            apply_rx_gain_tracked(target_gain);
            settle_ticks = GAIN_SETTLE_TICKS;
            overload_counter = 0;
            learn_adjust_counter = 0;
            /* No printf here: minimize CPU/USB/bus activity during the PHY transition. */
        }

profile_post_gain:
        /* Experimental automatic RF bandwidth gearbox.
         * BW40 -> BW20 only after 200 ms of deep fade at high gain.
         * BW20 -> BW40 requires 1 s of strong coherent recovery. */
        if (s_rf_bw_mode == RF_BW_MODE_AUTO) {
            /* TRACK is a hard no-write zone. Filter switching is allowed only
             * while acquiring/relearning a carrier; once locked, preserve the
             * exact RF/PHY state so a bandwidth write cannot corrupt CVBS sync. */
            if (s_agc_state == AGC_STATE_TRACK) {
                bw_deep_fade_ticks = 0;
                bw_recovery_ticks = 0;
            } else if (s_current_bw40) {
                bool auto_range_weak = (s_current_gain >=
                                         (s_rx_profile == RX_PROFILE_RANGE_EXP ? 56u : 58u)) &&
                                       (p_median < 12 || q_phase < 45);
                if (s_rx_profile == RX_PROFILE_AUTO_EXP &&
                    s_noise_floor_valid && s_phy_rssi_valid) {
                    int snr = s_last_phy_rssi_dbm - s_last_noise_floor_dbm;
                    auto_range_weak = auto_range_weak || (snr < 9 && q_phase < 55);
                }
                if (auto_range_weak) {
                    if (++bw_deep_fade_ticks >= 4) {
                        apply_rf_bandwidth(false);
                        bw_deep_fade_ticks = 0;
                        bw_recovery_ticks = 0;
                        settle_ticks = 2;
                    }
                } else {
                    bw_deep_fade_ticks = 0;
                }
            } else {
                if (p_median >= 22 && q_phase >= 80) {
                    if (++bw_recovery_ticks >= 20) {
                        apply_rf_bandwidth(true);
                        bw_recovery_ticks = 0;
                        bw_deep_fade_ticks = 0;
                        settle_ticks = 2;
                    }
                } else {
                    bw_recovery_ticks = 0;
                }
            }
        } else {
            bw_deep_fade_ticks = 0;
            bw_recovery_ticks = 0;
        }

        if (s_afc_mode == AFC_MODE_AUTO) {
            /* AUTO AFC is acquisition-only. TRACK performs zero frequency or
             * gain re-assert writes; any remaining CFO is frozen until lock is
             * lost and the controller returns to SEARCH/LEARN. */
            if (s_agc_state != AGC_STATE_TRACK &&
                q_phase >= 75 && p_median >= 18 && settle_ticks == 0) {
                if (s_cfo_khz > 35 || s_cfo_khz < -35) {
                    if (++afc_ticks >= 20) {
                        int cur_offset = rf_get_frequency_offset_khz();
                        apply_frequency_offset_khz_tracked(cur_offset + s_cfo_khz);
                        afc_ticks = 0;
                        settle_ticks = 2;
                    }
                } else {
                    afc_ticks = 0;
                }
            } else {
                afc_ticks = 0;
            }
        } else if (s_afc_mode == AFC_MODE_OFF && rf_get_frequency_offset_khz() != 0) {
            apply_frequency_offset_khz_tracked(0);
        }

control_tail: {
        bool is_locked = (s_agc_state == AGC_STATE_TRACK) && (q_phase >= 55) &&
                         (s_rx_profile != RX_PROFILE_RANGE_EXP ||
                          (s_last_sync_quality >= 60 &&
                           !demod_static_heavy(winding_permille)));
        if (is_locked && !was_locked && !s_lab_quiet) {
            const fpv_channel_t *ch = rf_get_current_channel();
            AGC_PRINTF("[CARRIER] Locked on %s (%u MHz) in %s (P=%d Q=%d%% G=%u)\n",
                   ch->name, ch->freq_mhz, rf_get_band_name(rf_get_current_band()),
                   p_median, q_phase, s_current_gain);
        }
        was_locked = is_locked;

        if (PERIODIC_TELEMETRY) {
            if (++telemetry_ticks >= 20) {
                telemetry_ticks = 0;
                AGC_PRINTF("[AGC] state=%d G=%u P=%d Q=%d%% clip=%d.%d%% wind=%d.%d%% syncQ=%d std=%s\n",
                       s_agc_state, s_current_gain, p_median, q_phase,
                       clip_permille / 10, clip_permille % 10,
                       winding_permille / 10, winding_permille % 10,
                       s_last_sync_quality,
                       s_detected_video_std_valid ? video_standard_name(s_detected_video_std) : "UNKNOWN");
            }
        }
        }
    }
}

static void console_diag_task(void *arg)
{
    (void)arg;

    for (;;) {
        /* IDF 6.0's O_NONBLOCK VFS read consults the installed driver's
         * available-byte count even in no-driver mode. Poll the FIFO here;
         * this task is its sole reader. Bound each batch so paste cannot
         * monopolize the task. No host line-ending or DTR assumption. */
        for (unsigned received = 0; received < 64; ++received) {
            uint8_t byte;
            if (usb_serial_jtag_ll_read_rxfifo(&byte, 1) == 0) break;
            int c = byte;
            if (c != EOF && c > 0) {
                if (s_gain_sweep.active &&
                    c != 'g' && c != 'l' && c != 'L' && c != '\r' && c != '\n') {
                    printf("C5VRX_GAIN_SWEEP_BUSY command=0x%02x action=ignored\n", (unsigned)c);
                    continue;
                }
                if (s_gain_sweep.active && (c == '\r' || c == '\n')) continue;

                if (c == 'l' || c == 'L') {
                    int64_t now = esp_timer_get_time();
                    s_last_user_lag_mark_us = now;
                    ++s_hw_counters.user_lag_mark_count;
                    long long gain_age_ms = s_last_gain_write_us > 0 ?
                        (long long)((now - s_last_gain_write_us) / 1000) : -1;
                    long long transport_age_ms = s_last_transport_event_us > 0 ?
                        (long long)((now - s_last_transport_event_us) / 1000) : -1;
                    long long phy_age_ms = s_last_phy_write_us > 0 ?
                        (long long)((now - s_last_phy_write_us) / 1000) : -1;
                    printf("[LAG MARK] #%lu gain_age=%lldms phy_age=%lldms phy_kind=%u transport_age=%lldms flags=0x%02lx G=%u state=%u\n",
                           (unsigned long)s_hw_counters.user_lag_mark_count,
                           gain_age_ms, phy_age_ms, (unsigned)s_last_phy_write_kind, transport_age_ms,
                           (unsigned long)s_last_transport_flags,
                           s_current_gain, (unsigned)s_agc_state);
                } else if (c == 'b') {
                    lab_enter_quiet_baseline();
                } else if (c == 'r') {
                    lab_reset_correlation();
                    printf("C5VRX_LAB_RESET gain=%u bw=%u afc=%u\n",
                           s_current_gain, s_current_bw40 ? 40u : 20u, (unsigned)s_afc_mode);
                } else if (c == 'p') {
                    lab_print_row("SNAPSHOT", NULL);
                } else if (c == 'g') {
                    lab_start_gain_sweep();
                } else if (c == 'F') {
                    lab_run_fft_probe();
                } else if (c == 'W') {
                    lab_run_bandwidth_probe();
                } else if (c == 'X') {
                    cycle_rx_profile();
                } else if (c == 't') {
                    rf_dump_tracked_timers();
                } else if (c == 'q') {
                    s_lab_quiet = !s_lab_quiet;
                    printf("C5VRX_LAB_QUIET enabled=%u\n", s_lab_quiet ? 1u : 0u);
                } else if (c == '+' || c == 'k') {
                    leave_experimental_profile();
                    s_agc_mode = ANALOG_AGC_MANUAL;
                    if (s_current_gain < LAB_GAIN_MAX) {
                        s_current_gain = s_current_gain <= LAB_GAIN_MAX - LAB_GAIN_STEP ?
                                         (uint8_t)(s_current_gain + LAB_GAIN_STEP) : LAB_GAIN_MAX;
                        s_last_gain_write_us = esp_timer_get_time();
                        s_last_phy_write_us = s_last_gain_write_us;
                        s_last_phy_write_kind = PHY_WRITE_GAIN;
                        rf_set_rx_gain(true, s_current_gain);
                        ++s_gain_transition_count;
                    }
                    settings_save();
                    printf("[MANUAL GAIN] = %u (reg=0x%08lx)\n", s_current_gain, (unsigned long)rf_get_rx_gain_reg());
                } else if (c == '-' || c == 'j') {
                    leave_experimental_profile();
                    s_agc_mode = ANALOG_AGC_MANUAL;
                    if (s_current_gain > LAB_GAIN_MIN) {
                        s_current_gain = s_current_gain >= LAB_GAIN_MIN + LAB_GAIN_STEP ?
                                         (uint8_t)(s_current_gain - LAB_GAIN_STEP) : LAB_GAIN_MIN;
                        s_last_gain_write_us = esp_timer_get_time();
                        s_last_phy_write_us = s_last_gain_write_us;
                        s_last_phy_write_kind = PHY_WRITE_GAIN;
                        rf_set_rx_gain(true, s_current_gain);
                        ++s_gain_transition_count;
                    }
                    settings_save();
                    printf("[MANUAL GAIN] = %u (reg=0x%08lx)\n", s_current_gain, (unsigned long)rf_get_rx_gain_reg());
                } else if (c == 'a') {
                    leave_experimental_profile();
                    s_agc_mode = ANALOG_AGC_ACTIVE;
                    settings_save();
                    printf("[AGC MODE] -> ACTIVE (Self-Calibrating Adaptive Gain Controller ACTIVE)\n");
                } else if (c == 's') {
                    leave_experimental_profile();
                    s_agc_mode = ANALOG_AGC_SHADOW;
                    settings_save();
                    printf("[AGC MODE] -> SHADOW (Dry-run: RF gain frozen at %u, computing recommendations)\n", s_current_gain);
                } else if (c == 'm') {
                    leave_experimental_profile();
                    s_agc_mode = ANALOG_AGC_MANUAL;
                    settings_save();
                    printf("[AGC MODE] -> MANUAL (Fixed gain=%u)\n", s_current_gain);
                } else if (c == 'c') {
                    rf_cycle_channel_in_band();
                    const fpv_channel_t *ch = rf_get_current_channel();
                    s_cfo_khz = 0;
                    s_agc_state = AGC_STATE_SEARCH;
                    video_standard_detector_reset();
                    settings_save();
                    printf("[CHANNEL] Switched to %s (%u MHz) in %s\n",
                           ch->name, ch->freq_mhz, rf_get_band_name(rf_get_current_band()));
                } else if (c == 'C') {
                    rf_cycle_band();
                    const fpv_channel_t *ch = rf_get_current_channel();
                    s_cfo_khz = 0;
                    s_agc_state = AGC_STATE_SEARCH;
                    video_standard_detector_reset();
                    settings_save();
                    printf("[BAND] Switched to %s - Channel %s (%u MHz)\n",
                           rf_get_band_name(rf_get_current_band()), ch->name, ch->freq_mhz);
                } else if (c == 'f') {
                    if (s_afc_mode == AFC_MODE_AUTO) {
                        s_afc_mode = AFC_MODE_HOLD;
                        printf("[AFC] -> HOLD (Current offset %+d kHz frozen)\n", rf_get_frequency_offset_khz());
                    } else if (s_afc_mode == AFC_MODE_HOLD) {
                        s_afc_mode = AFC_MODE_OFF;
                        apply_frequency_offset_khz_tracked(0);
                        printf("[AFC] -> OFF (Offset reset to 0 kHz)\n");
                    } else {
                        s_afc_mode = AFC_MODE_AUTO;
                        printf("[AFC] -> AUTO EXPERIMENTAL (uncalibrated WBFM bias estimator)\n");
                    }
                    settings_save();
                } else if (c == ',' || c == '<') {
                    step_frequency_offset_khz_tracked(-50);
                    settings_save();
                    int off = rf_get_frequency_offset_khz();
                    int tot = (int)rf_get_current_channel()->freq_mhz * 1000 + off;
                    printf("[FINE TUNE] Offset = %+d kHz (Tuned: %d.%03d MHz)\n",
                           off, tot / 1000, (tot % 1000 >= 0 ? tot % 1000 : -(tot % 1000)));
                } else if (c == '.' || c == '>') {
                    step_frequency_offset_khz_tracked(+50);
                    settings_save();
                    int off = rf_get_frequency_offset_khz();
                    int tot = (int)rf_get_current_channel()->freq_mhz * 1000 + off;
                    printf("[FINE TUNE] Offset = %+d kHz (Tuned: %d.%03d MHz)\n",
                           off, tot / 1000, (tot % 1000 >= 0 ? tot % 1000 : -(tot % 1000)));
                } else if (c == '0') {
                    apply_frequency_offset_khz_tracked(0);
                    settings_save();
                    printf("[FINE TUNE] Offset reset to +0 kHz\n");
#if CONFIG_C5VRX_LINK_MODE
#if CONFIG_C5VRX_LINK_DEBUG
                } else if (c == 'v') {
                    link_dump();
                } else if (c == 'g') {
                    link_grab();
#endif
                } else if (c == 'S') {
                    link_stream_toggle();
                } else if (c == 'P') {
                    link_mode_cycle();
                } else if (c == 'N') {
                    link_scan_toggle();
                } else if (c == 'M') {
                    link_smoothing_toggle();
#endif
                } else if (c == 'e') {
                    PARL_IO.rx_clk_cfg.rx_clk_i_inv = !PARL_IO.rx_clk_cfg.rx_clk_i_inv;
                    printf("[EDGE] RX SAMPLE EDGE TOGGLED -> %s (rx_clk_i_inv=%d)\n",
                           PARL_IO.rx_clk_cfg.rx_clk_i_inv ? "NEG" : "POS",
                           (int)PARL_IO.rx_clk_cfg.rx_clk_i_inv);
                } else if (c == 'o' || c == 'v' || c == 'V' || c == 'O' ||
                           c == ' ' || c == 'n' || c == '\t' ||
                           c == '\r' || c == '\n' || c == 'x') {
                    /* The control task exclusively owns mode changes and rendering. */
                    if (xQueueSend(s_menu_commands, &c, 0) != pdTRUE) {
                        printf("[MENU] Command queue full\n");
                    }
                } else {
                    uint32_t rx_dscr = 0, tx_dscr = 0;
                    uint32_t rx_off = get_rx_dma_offset(&rx_dscr);
                    uint32_t tx_off = get_tx_dma_offset(&tx_dscr);
                    uint32_t dist = (rx_off >= tx_off) ? (rx_off - tx_off) : (sizeof(s_raw_ring) - tx_off + rx_off);
                    int rx_nodes = s_rx_dscr_count;
                    int tx_nodes = s_menu_active ? 0 : s_tx_dscr_count;
                    const fpv_channel_t *ch = rf_get_current_channel();
                    int off = rf_get_frequency_offset_khz();
                    int tot = (int)ch->freq_mhz * 1000 + off;

                    printf("\n=======================================================\n");
                    printf(" C5VRX-3 REALTIME RECEPTION & FREQUENCY DIAGNOSTICS\n");
                    printf(" Receiver Channel:           %s (%u MHz)\n", ch->name, ch->freq_mhz);
                    printf(" Tuned Frequency:            %d.%03d MHz (Offset: %+d kHz)\n",
                           tot / 1000, (tot % 1000 >= 0 ? tot % 1000 : -(tot % 1000)), off);
                    printf(" Carrier Frequency Offset:   %+d kHz (VTX %s)\n",
                           s_cfo_khz, (s_cfo_khz > 20) ? "high" : (s_cfo_khz < -20) ? "low" : "centered");
                    printf(" AFC Mode:                   %s\n",
                           (s_afc_mode == AFC_MODE_AUTO) ? "AUTO EXPERIMENTAL (uncalibrated estimator)" :
                           (s_afc_mode == AFC_MODE_HOLD) ? "HOLD (Offset Frozen)" : "OFF (0 kHz)");
                    printf(" RX Profile:                 %s%s\n",
                           rx_profile_name(),
                           s_rx_profile == RX_PROFILE_RANGE_EXP ? " [DEFAULT]" : " [EXPERIMENTAL]");
                    printf(" RF Bandwidth:               mode=%s active=%s\n",
                           rf_bw_mode_name(), s_current_bw40 ? "BW40" : "BW20");
                    printf(" PHY Environment:            NF=%s%d dBm RSSI=%s%d dBm FFT_Q4=%s best=%d\n",
                           s_noise_floor_valid ? "" : "NA/", s_last_noise_floor_dbm,
                           s_phy_rssi_valid ? "" : "NA/", s_last_phy_rssi_dbm,
                           !s_fft_q4_effect_known ? "UNKNOWN" :
                           s_fft_q4_effective ? "USEFUL" : "NO_EFFECT",
                           (int)s_fft_best_value);
                    printf(" Adaptive AGC Mode:          %s (State=%s)\n",
                           (s_agc_mode == ANALOG_AGC_ACTIVE) ? "ACTIVE" :
                           (s_agc_mode == ANALOG_AGC_SHADOW) ? "SHADOW (Safe Dry-Run)" : "MANUAL",
                           (s_agc_state == AGC_STATE_TRACK) ? "TRACK" :
                           (s_agc_state == AGC_STATE_LEARN) ? "LEARN" : "SEARCH");
                    printf(" Gain Settings:              G_actual=%u, G_shadow_rec=%u (reg=0x%08lx)\n",
                           s_current_gain, s_shadow_gain, (unsigned long)rf_get_rx_gain_reg());
                    printf(" FM Vector Metrics:          P_median=%d, Q_phase=%d%%, Clip=%d.%d%%, Origin=%d.%d%%\n",
                           s_last_p_median, s_last_q_phase,
                           s_last_clip_permille / 10, s_last_clip_permille % 10,
                           s_last_origin_permille / 10, s_last_origin_permille % 10);
                    printf(" IQ Frontend Metrics:        DC I=%+.2f Q=%+.2f, skew=%d.%d%% cross=%d.%d%%\n",
                           (double)s_last_dc_i_x100 / 100.0, (double)s_last_dc_q_x100 / 100.0,
                           s_last_iq_skew_permille / 10, s_last_iq_skew_permille % 10,
                           s_last_iq_cross_permille / 10, s_last_iq_cross_permille % 10);
                    printf(" Demod Quality:              endpoint winding=%d.%d%% strong=%d.%d%% syncQ=%d width=%u\n",
                           s_last_winding_permille / 10, s_last_winding_permille % 10,
                           s_last_strong_winding_permille / 10, s_last_strong_winding_permille % 10,
                           s_last_sync_quality, (unsigned)s_last_sync_width_20m);
                    printf(" Gain Transitions:           %lu (control window=%u IQ samples / %.1f us)\n",
                           (unsigned long)s_gain_transition_count, CONTROL_SAMPLE_BYTES,
                           (double)CONTROL_SAMPLE_BYTES * 1000000.0 / (double)IQ_RATE_HZ);
                    printf(" GDMA Ring:                  dist=%lu (rx_off=%lu, tx_off=%lu)\n",
                           (unsigned long)dist, (unsigned long)rx_off, (unsigned long)tx_off);
                    printf(" Zero-EOF Status:            RX patched=%d nodes, TX patched=%d nodes\n",
                           rx_nodes, tx_nodes);
                    printf(" Transport Faults:           PARLIO tx_empty=%lu rx_ovf=%lu tx_eof=%lu | GDMA in=%lu out=%lu | BS eof_ovl=%lu\n",
                           (unsigned long)s_hw_counters.parl_tx_rempty_count,
                           (unsigned long)s_hw_counters.parl_rx_wovf_count,
                           (unsigned long)s_hw_counters.parl_tx_eof_count,
                           (unsigned long)s_hw_counters.gdma_in_fault_count,
                           (unsigned long)s_hw_counters.gdma_out_fault_count,
                           (unsigned long)s_hw_counters.bs_eof_overload_count);
                    int64_t transport_age_ms = s_last_transport_event_us > 0 ?
                        (esp_timer_get_time() - s_last_transport_event_us) / 1000 : -1;
                    printf(" Lag Correlation:            events=%lu near_gain_200ms=%lu near_phy_200ms=%lu gain_Qdrop=%lu marks=%lu last_flags=0x%02lx age=%lldms checks=%lu\n",
                           (unsigned long)s_hw_counters.lag_event_count,
                           (unsigned long)s_hw_counters.near_gain_event_count,
                           (unsigned long)s_hw_counters.near_phy_event_count,
                           (unsigned long)s_hw_counters.gain_quality_drop_count,
                           (unsigned long)s_hw_counters.user_lag_mark_count,
                           (unsigned long)s_last_transport_flags,
                           (long long)transport_age_ms,
                           (unsigned long)s_hw_counters.checks);
                    unsigned available = s_lag_event_head < LAG_EVENT_LOG_SIZE ?
                                         s_lag_event_head : LAG_EVENT_LOG_SIZE;
                    for (unsigned n = 0; n < available; ++n) {
                        uint32_t seq = s_lag_event_head - n;
                        const lag_event_t *event = &s_lag_events[(seq - 1u) % LAG_EVENT_LOG_SIZE];
                        printf("  EVT#%lu flags=0x%02lx t=%lldus rx=%u tx=%u G%u state=%u\n",
                               (unsigned long)event->seq,
                               (unsigned long)event->flags,
                               (long long)event->time_us,
                               event->rx_off, event->tx_off,
                               event->gain, event->agc_state);
                    }
                    printf(" RX Sample Edge:             %s (rx_clk_i_inv=%d)\n",
                           PARL_IO.rx_clk_cfg.rx_clk_i_inv ? "NEG" : "POS",
                           (int)PARL_IO.rx_clk_cfg.rx_clk_i_inv);
                    printf(" Video Standard:             mode=%s output=%s detected=%s period=%u samples (PAL=%u NTSC=%u)\n",
                           s_video_std_mode == VIDEO_STD_MODE_AUTO ? "AUTO" :
                           s_video_std_mode == VIDEO_STD_MODE_PAL ? "PAL" : "NTSC",
                           video_standard_name(s_video_std),
                           s_detected_video_std_valid ? video_standard_name(s_detected_video_std) : "UNKNOWN",
                           s_last_line_period_20m,
                           s_video_std_pal_score, s_video_std_ntsc_score);
                    printf(" Menu Status:                %s\n",
                           MENU_RUNTIME_ENABLED ?
                           (s_menu_active ? "OPEN" : "CLOSED") :
                           "TEMPORARILY DISABLED (live video only)");
                    printf(" Lab Status:                 quiet=%u gain_sweep=%u fft_known=%u fft_useful=%u best=%d\n",
                           s_lab_quiet ? 1u : 0u, s_gain_sweep.active ? 1u : 0u,
                           s_fft_q4_effect_known ? 1u : 0u,
                           s_fft_q4_effective ? 1u : 0u, (int)s_fft_best_value);
                    printf(" Keys:\n");
                    printf("  'a'/'s'/'m': AGC mode (active / shadow / manual)\n");
                    printf("  'b':         Enter quiet MANUAL/BW40/AFC-off baseline + reset counters\n");
                    printf("  'g':         Start/abort G2..G62 production-state gain sweep\n");
                    printf("  'F'/'W':     FFT-scale Q4 probe / fixed-gain BW40-vs-BW20 probe\n");
                    printf("  'X':         Cycle RX profile (Balanced/Range/Blocker/Recovery/Auto/HW AGC)\n");
                    printf("  'p'/'r':     Machine-readable PHY/Q4 snapshot / reset lag counters\n");
                    printf("  't'/'q':     Vendor timer inventory / quiet unsolicited lock message\n");
                    printf("  'l':         Mark a visible lag/freeze for correlation\n");
                    printf("  '+' / '-':   Manual gain step (+/-2)\n");
                    printf("  'c':         Cycle FPV channel (A1..A8, R1..R8, B1..B8, F1..F8)\n");
                    printf("  'f':         AFC mode (auto-centering / hold / off)\n");
                    printf("  ',' / '.':   Fine-tune offset (-50 / +50 kHz)\n");
                    printf("  '0':         Reset offset to 0 kHz\n");
                    printf("  'e':         Toggle RX sample edge (POS/NEG)\n");
                    printf("  'v'/'o'/'O': Menu controls\n");
                    printf("  'd':         Print this diagnostic summary\n");
                    printf("=======================================================\n\n");
                }
            }
        }
        lab_gain_sweep_tick();
        vTaskDelay(pdMS_TO_TICKS(10));
    }
}


/* ----- Main entry point ----- */

esp_err_t video_start(void)
{
    /* Keep output unbuffered on the no-driver USB VFS. Input is drained directly
     * by console_diag_task; USB is never involved in DMA sample pacing. */
    setvbuf(stdin, NULL, _IONBF, 0);
    setvbuf(stdout, NULL, _IONBF, 0);
    int flags = fcntl(fileno(stdin), F_GETFL, 0);
    fcntl(fileno(stdin), F_SETFL, flags | O_NONBLOCK);
    flags = fcntl(fileno(stdout), F_GETFL, 0);
    fcntl(fileno(stdout), F_SETFL, flags | O_NONBLOCK);
    usb_serial_jtag_vfs_use_nonblocking();

    /* Initialize BOOT button on GPIO 28 */
    init_boot_button();

    /* Menu control is serialized with BOOT handling in the AGC task. */
    s_menu_commands = xQueueCreate(16, sizeof(int));
    if (!s_menu_commands) return ESP_ERR_NO_MEM;

    settings_load();

    /* Zero the ring before starting. Flush to DMA-visible SRAM. */
    memset(s_raw_ring, 0, sizeof(s_raw_ring));
    sync_dma_c2m(s_raw_ring, sizeof(s_raw_ring));

    esp_err_t err;

    if ((err = prepare_rx()) != ESP_OK) return err;
#if !CONFIG_C5VRX_LINK_MODE
    if ((err = prepare_tx()) != ESP_OK) return err;

    start_flight_demodulator();
#endif

    /* Start RX cyclic ring. GDMA begins writing at s_raw_ring[0]. */
    if ((err = start_rx()) != ESP_OK) return err;

    /* Put PARLIO RX into pure continuous hardware mode:
     * 1. Disable all GDMA RX channel interrupts so the CPU is never interrupted
     *    (~9,775 ISRs/sec eliminated!).
     * 2. Set rx_eof_gen_sel = 1 (external enable, non-existent in soft mode)
     *    so PARLIO RX never generates an EOF stall event.
     * This matches PARLIO TX's unbroken hardware loop, eliminating pointer drift! */
    AHB_DMA.in_intr[0].ena.val = 0;
    AHB_DMA.in_intr[1].ena.val = 0;
    AHB_DMA.in_intr[2].ena.val = 0;
    PARL_IO.rx_genrl_cfg.rx_eof_gen_sel = 1;

    /* Request half-ring producer/consumer separation before starting TX.
     * The integer-microsecond delay and driver latency need hardware validation. */
    esp_rom_delay_us(8192ULL * 1000000ULL / IQ_RATE_HZ);

#if !CONFIG_C5VRX_LINK_MODE
    if ((err = start_tx()) != ESP_OK) return err;
#endif

    /* Discover AHB_DMA channels assigned to PARL_IO (peripheral ID 9) */
    for (int i = 0; i < 3; i++) {
        if (AHB_DMA.channel[i].in.in_peri_sel.peri_in_sel_chn == 9) {
            s_rx_dma_ch = i;
        }
        if (AHB_DMA.channel[i].out.out_peri_sel.peri_out_sel_chn == 9) {
            s_tx_dma_ch = i;
        }
    }

    /* Put PARLIO TX into pure continuous hardware mode:
     * Disable all GDMA TX channel interrupts and PARL_IO core interrupts.
     * Prevents PARLIO_LL_EVENT_TX_FIFO_EMPTY and EOF interrupts from stealing CPU cycles! */
    AHB_DMA.out_intr[0].ena.val = 0;
    AHB_DMA.out_intr[1].ena.val = 0;
    AHB_DMA.out_intr[2].ena.val = 0;
    PARL_IO.int_ena.val = 0;

    /* Clear suc_eof on ALL GDMA descriptors for both RX and TX to eliminate
     * hardware wrap EOF bubbles completely! The buffer becomes a truly infinite ring. */
    int rx_nodes = patch_descriptors_clear_eof(s_rx_dma_ch, true);
    int tx_nodes = patch_descriptors_clear_eof(s_tx_dma_ch, false);

    /* Issue #28: clear stale startup/driver status once. Subsequent sticky
     * faults are observed by poll_transport_faults() without enabling IRQs. */
    PARL_IO.int_clr.val = UINT32_MAX;
    if (s_rx_dma_ch >= 0) AHB_DMA.in_intr[s_rx_dma_ch].clr.val = UINT32_MAX;
    if (s_tx_dma_ch >= 0) AHB_DMA.out_intr[s_tx_dma_ch].clr.val = UINT32_MAX;
    BITSCRAMBLER.state[BITSCRAMBLER_DIR_TX].val = 1u << 31;

#if CONFIG_C5VRX_LINK_MODE
    /* The BitScrambler is free (no PARLIO TX): loopback demodulation of ring snapshots. */
    if ((err = link_init()) != ESP_OK) return err;

    /* Exact VTX frequency and the wide analog filter: hardware captures showed
     * the narrow BW20 filter and a 2 MHz offset crush the demodulated range. */
    if (rf_set_channel((size_t)CONFIG_C5VRX_LINK_CHANNEL) == ESP_OK) {
        const fpv_channel_t *ch = rf_get_current_channel();
        printf("[LINK] tuned to %s (%u MHz)\n", ch->name, ch->freq_mhz);
    }
    s_rf_bw_mode = RF_BW_MODE_BW40;
    apply_rf_bandwidth(true);
#endif

    /* Start interactive console for on-demand diagnostics (zero periodic CPU/bus traffic) */
    xTaskCreate(console_diag_task, "console_diag", 4096, NULL, 1, NULL);

    /* Start dedicated Analog Video AGC engine (P_median in [20, 30], fast attack) */
    xTaskCreate(analog_agc_task, "analog_agc", 8192, NULL, 3, NULL);


    /* Print startup stamp (visible on serial monitor at boot). */
    ESP_EARLY_LOGW(TAG,
        "\n=======================================================\n"
        " C5VRX-3  Seamless 16K Phase5 receiver (Zero-EOF Circular GDMA)\n"
        " Clock:   PARLIO_CLK_SRC_DEFAULT 40MHz (SPLL internal)\n"
        " Telemetry: Live GDMA ring pointer tracking (rx_ch=%d, tx_ch=%d)\n"
        " Buffer:  16,384 bytes cyclic ring (Zero-EOF patched: RX=%d TX=%d)\n"
        " RX:      40 MS/s POS edge, 16,384 bytes pure HW cyclic GDMA\n"
        " Demod:   Phase5 50ns / P%u / G%u / current-minus-previous\n"
        " TX:      40 MHz [D,D] / eof=downstream / tail=0\n"
        " Lock:    GDMA ISRs disabled, RX EOF disabled, suc_eof=0 cleared\n"
        " CPU:     done (hardware runs in unbroken infinite loop)\n"
        "=======================================================\n",
        s_rx_dma_ch, s_tx_dma_ch, rx_nodes, tx_nodes, DAC_IDLE_CODE, 2u);

    return ESP_OK;
}
