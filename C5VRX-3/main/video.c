/**
 * video.c - Realtime MODEM_DIAG -> PARLIO RX -> 16K ring -> Phase5 TX -> DAC.
 *
 * Implements the complete production datapath for C5VRX-3:
 *
 *   MODEM_DIAG full Q4/I4 @ 40 MS/s
 *     -> PARLIO RX POS edge @ 40 MHz
 *     -> 16 KiB cyclic raw DMA ring (HP SRAM)
 *     -> PARLIO TX @ 40 MHz + Phase5 TX BitScrambler (fm.bsasm)
 *     -> [D,D] 6-bit CVBS @ 20 MS/s unique / 40 MHz DAC clock
 *     -> 6-bit resistor DAC
 *
 * Reference: Seamless Golden 16K (build-golden-notel) -- proven best live build.
 *
 * Fixed production constants (NOT configurable at runtime):
 *   IQ rate:        40 MHz
 *   DAC rate:       40 MHz physical ([D,D] = 20 MS/s unique CVBS)
 *   Ring:           16384 bytes (HP SRAM, DMA-aligned)
 *   Pedestal:       20   (hardcoded in FM LUT)
 *   Gain:           2    (hardcoded in FM LUT)
 *   Polarity:       current-minus-previous (hardcoded in FM LUT)
 *   RX sample edge: POS
 *   TX shift edge:  NEG
 *   BS EOF:         downstream (PARLIO TX loop never generates downstream EOF)
 *   BS tail:        0 bytes
 *
 * After video_start() the CPU has nothing to do. No periodic tasks or timers.
 */

#include "video.h"
#include "rf.h"

#include <stdint.h>
#include <string.h>

#include "driver/bitscrambler.h"
#include "driver/gpio.h"
#include "driver/parlio_bitscrambler.h"
#include "driver/parlio_rx.h"
#include "driver/parlio_tx.h"
#include "esp_attr.h"
#include "esp_cache.h"
#include "esp_log.h"
#include "esp_rom_sys.h"
#include "esp_timer.h"
#include "freertos/FreeRTOS.h"
#include "freertos/task.h"
#include "soc/parl_io_struct.h"
#include "soc/bitscrambler_struct.h"

/* Hardware diagnostic counters in IRAM to measure transport hiccups without printf spam */
typedef struct {
    uint32_t parl_rx_wovf_count;
    uint32_t parl_tx_rempty_count;
    uint32_t parl_tx_eof_count;
    uint32_t bs_fifo_empty_count;
    uint32_t bs_eof_overload_count;
    uint32_t checks;
} hw_transport_counters_t;

static volatile hw_transport_counters_t s_hw_counters;

/* fm.bsasm program symbol generated by target_bitscrambler_add_src(). */
BITSCRAMBLER_PROGRAM(s_fm_program, "fm");

/* ----- Fixed production constants ----- */
#define IQ_RATE_HZ       40000000u   /* MODEM_DIAG / PARLIO RX clock */
#define DAC_RATE_HZ      40000000u   /* PARLIO TX clock ([D,D] = 20 MS/s unique) */
#define RAW_RING_BYTES   16384u      /* 16 KiB cyclic ring -- Seamless Golden 16K */
#define DAC_IDLE_CODE    20u         /* Pedestal 20 (sync tip level) */

/* TX GPIO mapping: 6-bit resistor DAC.
 * Order: DAC bit 0 (LSB) .. DAC bit 5 (MSB) on data_gpio_nums[0..5].
 * Bits 6..7 unused (set to -1).
 * Verified against C5VRX-2 realtime.c (standard 8-bit PARLIO TX, non-parlio4). */
static const int s_dac_gpio[8] = {23, 24, 11, 12, 8, 9, -1, -1};

_Static_assert(IQ_RATE_HZ == 40000000u, "IQ rate must be 40 MHz");
_Static_assert(DAC_RATE_HZ == 40000000u, "DAC rate must be 40 MHz");
_Static_assert(RAW_RING_BYTES == 16384u, "Ring must be exactly 16 KiB");

static const char *TAG = "c5vrx3_video";

/* DMA-aligned ring buffer in HP SRAM.
 * RX GDMA writes at 40 MB/s; TX GDMA reads at 40 MB/s.
 * TX starts one block (4096 bytes = 102.4 µs) behind RX; they share
 * PLL_F240M/6, so separation cannot drift during normal operation. */
static DMA_ATTR __attribute__((aligned(64))) uint8_t s_raw_ring[RAW_RING_BYTES];

static parlio_rx_unit_handle_t      s_rx;
static parlio_rx_delimiter_handle_t s_rx_delimiter;
static parlio_tx_unit_handle_t      s_tx;

/* ----- PARLIO RX setup ----- */

static esp_err_t prepare_rx(void)
{
    /* Proven PARLIO RX config from Seamless Golden 16K reference. */
    const parlio_rx_unit_config_t cfg = {
        .trans_queue_depth = 1u,
        .max_recv_size     = sizeof(s_raw_ring),
        .dma_burst_size    = 32u,
        .data_width        = 8u,
        .clk_src           = PARLIO_CLK_SRC_DEFAULT,
        .ext_clk_freq_hz   = 0u,
        .exp_clk_freq_hz   = IQ_RATE_HZ,
        .clk_in_gpio_num   = -1,
        .clk_out_gpio_num  = -1,
        .valid_gpio_num    = -1,
        /* GPIO order must match s_iq_pins[] in rf.c:
         * Q[9:6] on GPIO 1,0,25,7 then I[9:6] on GPIO 10,5,3,4. */
        .data_gpio_nums    = {
            GPIO_NUM_1, GPIO_NUM_0, GPIO_NUM_25, GPIO_NUM_7,
            GPIO_NUM_10, GPIO_NUM_5, GPIO_NUM_3, GPIO_NUM_4,
        },
        .flags = {
            .free_clk    = true,   /* RX clock is derived from PHY, not gated */
            .clk_gate_en = false,
            .allow_pd    = false,
        },
    };
    esp_err_t err = parlio_new_rx_unit(&cfg, &s_rx);
    if (err != ESP_OK) return err;

    /* Soft delimiter in infinite (partial_rx_en) mode.
     * POS sample edge -- proven correct for MODEM_DIAG timing.
     * eof_data_len marks recurring boundaries; cyclic GDMA keeps running. */
    const parlio_rx_soft_delimiter_config_t delim_cfg = {
        .sample_edge  = PARLIO_SAMPLE_EDGE_POS,    /* FIXED: POS only */
        .bit_pack_order = PARLIO_BIT_PACK_ORDER_LSB,
        .eof_data_len = sizeof(s_raw_ring),
        .timeout_ticks = 0u,
    };
    err = parlio_new_rx_soft_delimiter(&delim_cfg, &s_rx_delimiter);
    if (err != ESP_OK) return err;

    return parlio_rx_unit_enable(s_rx, false);
}

/* ----- PARLIO TX setup ----- */

static esp_err_t prepare_tx(void)
{
    /* Proven PARLIO TX config from Seamless Golden 16K reference.
     * 8-bit data width, 40 MHz output, NEG shift edge, LSB packing.
     * BitScrambler decorated on the TX unit (not RX -- C5 has one BS). */
    const parlio_tx_unit_config_t cfg = {
        .clk_src              = PARLIO_CLK_SRC_DEFAULT,
        .clk_in_gpio_num      = -1,
        .input_clk_src_freq_hz = 0u,
        .output_clk_freq_hz   = DAC_RATE_HZ,
        .data_width           = 8u,
        .data_gpio_nums       = {
            s_dac_gpio[0], s_dac_gpio[1], s_dac_gpio[2], s_dac_gpio[3],
            s_dac_gpio[4], s_dac_gpio[5], s_dac_gpio[6], s_dac_gpio[7],
        },
        .clk_out_gpio_num  = -1,
        .valid_gpio_num    = -1,
        .valid_start_delay = 0,
        .valid_stop_delay  = 0,
        .trans_queue_depth = 1u,
        .max_transfer_size = sizeof(s_raw_ring),
        .dma_burst_size    = 32u,
        .shift_edge        = PARLIO_SHIFT_EDGE_NEG,   /* FIXED: NEG (RX is POS) */
        .bit_pack_order    = PARLIO_BIT_PACK_ORDER_LSB,
    };
    esp_err_t err = parlio_new_tx_unit(&cfg, &s_tx);
    if (err != ESP_OK) return err;

    /* Decorate TX with BitScrambler (TX-only; C5 has one shared BS core). */
    err = parlio_tx_unit_decorate_bitscrambler(s_tx);
    if (err != ESP_OK) return err;

    return parlio_tx_unit_enable(s_tx);
}

/* ----- Start RX cyclic ring ----- */

static esp_err_t start_rx(void)
{
    esp_err_t err = parlio_rx_soft_delimiter_start_stop(s_rx, s_rx_delimiter, true);
    if (err != ESP_OK) return err;
    const parlio_receive_config_t cfg = {
        .delimiter = s_rx_delimiter,
        .flags = {
            .partial_rx_en   = true,
            .indirect_mount  = false,
        },
    };
    return parlio_rx_unit_receive(s_rx, s_raw_ring, sizeof(s_raw_ring), &cfg);
}

/* ----- Start TX loop ----- */

static esp_err_t start_tx(void)
{
    /* Phase5 LUT is embedded in fm.bsasm -- no runtime bitscrambler_load_lut().
     * Hardware oracle v9 proved embedded LUT is byte-exact at 20 MS/s;
     * a separately preloaded LUT is NOT retained by the active PARLIO TX run. */
    const parlio_transmit_config_t cfg = {
        .idle_value          = DAC_IDLE_CODE,
        .bitscrambler_program = s_fm_program,
        .flags.loop_transmission = true,  /* Infinite -- never generates downstream EOF */
    };
    /* TX reads sizeof(s_raw_ring) * 8 bits, then loops.
     * loop_transmission=true means PARLIO TX never stops; the BitScrambler
     * with eof_on=downstream therefore runs uninterrupted forever. */
    return parlio_tx_unit_transmit(s_tx, s_raw_ring,
                                   sizeof(s_raw_ring) * 8u, &cfg);
}

static void hw_diag_task(void *arg)
{
    (void)arg;
    int diag_tick = 0;
    for (;;) {
        vTaskDelay(pdMS_TO_TICKS(100));
        s_hw_counters.checks++;
        if (PARL_IO.int_raw.rx_fifo_wovf_int_raw) {
            s_hw_counters.parl_rx_wovf_count++;
            PARL_IO.int_clr.rx_fifo_wovf_int_clr = 1;
        }
        if (PARL_IO.int_raw.tx_fifo_rempty_int_raw) {
            s_hw_counters.parl_tx_rempty_count++;
            PARL_IO.int_clr.tx_fifo_rempty_int_clr = 1;
        }
        if (PARL_IO.int_raw.tx_eof_int_raw) {
            s_hw_counters.parl_tx_eof_count++;
            PARL_IO.int_clr.tx_eof_int_clr = 1;
        }
        if (BITSCRAMBLER.state[1].fifo_empty) {
            s_hw_counters.bs_fifo_empty_count++;
        }
        if (BITSCRAMBLER.state[1].eof_overload) {
            s_hw_counters.bs_eof_overload_count++;
            BITSCRAMBLER.state[1].eof_trace_clr = 1;
        }

        if (++diag_tick >= 30) { /* Every 3.0s */
            diag_tick = 0;
            esp_rom_printf("[DIAG 3s] RX_ovf=%lu TX_rempty=%lu TX_eof=%lu BS_empty=%lu BS_ovl=%lu (polls=%lu)\n",
                           (unsigned long)s_hw_counters.parl_rx_wovf_count,
                           (unsigned long)s_hw_counters.parl_tx_rempty_count,
                           (unsigned long)s_hw_counters.parl_tx_eof_count,
                           (unsigned long)s_hw_counters.bs_fifo_empty_count,
                           (unsigned long)s_hw_counters.bs_eof_overload_count,
                           (unsigned long)s_hw_counters.checks);
            rf_dump_tracked_timers();
        }
    }
}

static void console_diag_task(void *arg)
{
    (void)arg;
    for (;;) {
        int c = getchar();
        if (c != EOF && c > 0) {
            printf("\n=======================================================\n");
            printf(" C5VRX-3 HW DIAGNOSTICS (after %lu polls)\n", (unsigned long)s_hw_counters.checks);
            printf(" PARLIO RX FIFO overflow:    %lu\n", (unsigned long)s_hw_counters.parl_rx_wovf_count);
            printf(" PARLIO TX FIFO empty (udf): %lu\n", (unsigned long)s_hw_counters.parl_tx_rempty_count);
            printf(" PARLIO TX EOF:              %lu\n", (unsigned long)s_hw_counters.parl_tx_eof_count);
            printf(" BitScrambler TX empty:      %lu\n", (unsigned long)s_hw_counters.bs_fifo_empty_count);
            printf(" BitScrambler EOF overload:  %lu\n", (unsigned long)s_hw_counters.bs_eof_overload_count);
            printf("=======================================================\n");
            esp_timer_dump(stdout);
            printf("-------------------------------------------------------\n\n");
        }
        vTaskDelay(pdMS_TO_TICKS(100));
    }
}

/* ----- Main entry point ----- */

esp_err_t video_start(void)
{
    /* Zero the ring before starting. Flush to DMA-visible SRAM. */
    memset(s_raw_ring, 0, sizeof(s_raw_ring));
    (void)esp_cache_msync(s_raw_ring, sizeof(s_raw_ring),
                          ESP_CACHE_MSYNC_FLAG_DIR_C2M);

    esp_err_t err;

    if ((err = prepare_rx()) != ESP_OK) return err;
    if ((err = prepare_tx()) != ESP_OK) return err;

    /* Start RX cyclic ring. GDMA begins writing at s_raw_ring[0]. */
    if ((err = start_rx()) != ESP_OK) return err;

    /* Establish producer/consumer separation before starting TX.
     *
     * Method: wall-clock delay of one 4096-byte block at 40 MB/s = 102.4 µs.
     * RX GDMA and TX GDMA both derive their 40 MHz from PLL_F240M/6, so once
     * started, the separation cannot drift in normal operation.
     *
     * Delay = 4096 bytes / 40,000,000 bytes/s = 102.4 µs */
    esp_rom_delay_us(4096u * 1000000u / IQ_RATE_HZ);

    if ((err = start_tx()) != ESP_OK) return err;

    /* Start background transport diagnostics and interactive console */
    xTaskCreate(hw_diag_task, "hw_diag", 2048, NULL, 1, NULL);
    xTaskCreate(console_diag_task, "console_diag", 3072, NULL, 1, NULL);

    /* Print startup stamp before muting (visible on serial monitor at boot). */
    ESP_EARLY_LOGW(TAG,
        "\n=======================================================\n"
        " C5VRX-3  Seamless16K Phase5 receiver\n"
        " RX:      40 MS/s POS edge, 16 KiB cyclic GDMA\n"
        " Demod:   Phase5 50ns / P%u / G%u / current-minus-previous\n"
        " TX:      40 MHz [D,D] / eof=downstream / tail=0\n"
        " CPU:     done (no periodic tasks)\n"
        "=======================================================\n",
        DAC_IDLE_CODE, 2u);

    /* Allow background tasks/timers to run for 2 seconds, then dump all active timers! */
    vTaskDelay(pdMS_TO_TICKS(2000));
    ESP_EARLY_LOGW(TAG, "\n--- ACTIVE ESP_TIMERS (after 2s) ---");
    esp_timer_dump(stdout);
    ESP_EARLY_LOGW(TAG, "------------------------------------");
    ESP_EARLY_LOGW(TAG, "HW Transport Diagnostics (initial 2s):");
    ESP_EARLY_LOGW(TAG, "  RX FIFO ovf:      %lu", (unsigned long)s_hw_counters.parl_rx_wovf_count);
    ESP_EARLY_LOGW(TAG, "  TX FIFO rempty:   %lu", (unsigned long)s_hw_counters.parl_tx_rempty_count);
    ESP_EARLY_LOGW(TAG, "  TX EOF:           %lu", (unsigned long)s_hw_counters.parl_tx_eof_count);
    ESP_EARLY_LOGW(TAG, "  BS FIFO empty:    %lu", (unsigned long)s_hw_counters.bs_fifo_empty_count);
    ESP_EARLY_LOGW(TAG, "  BS EOF overload:  %lu", (unsigned long)s_hw_counters.bs_eof_overload_count);
    ESP_EARLY_LOGW(TAG, "------------------------------------\n");

    /* Mute all logging. After this point the CPU has nothing to do.
     * USB, logging, and any periodic IDF tasks must not touch the DMA ring. */
    esp_log_level_set("*", ESP_LOG_NONE);

    return ESP_OK;
}
