Warning: truncated output (original token count: 68951)
Total output lines: 6285

/**
 * video.c - Realtime MODEM_DIAG -> PARLIO RX -> 32K ring -> Phase5 TX -> DAC.
 *
 * Implements the complete production datapath for C5VRX-3:
 *
 *   MODEM_DIAG full Q4/I4 @ 40 MS/s
 *     -> PARLIO RX POS edge @ 40 MHz
 *     -> 32 KiB cyclic raw DMA ring (HP SRAM)
 *     -> PARLIO TX + selectable Golden Phase5 / Trajectory v2 BitScrambler
 *     -> [D,D] 6-bit CVBS @ 20 MS/s unique / 40 MHz DAC clock
 *     -> 6-bit resistor DAC
 *
 * Reference: Seamless Golden 16K (build-golden-notel) -- proven best live build.
 *
 * Fixed production constants (NOT configurable at runtime):
 *   IQ rate:        40 MHz
 *   DAC rate:       40 MHz physical ([D,D] = 20 MS/s unique CVBS)
 *   Ring:           32768 bytes (HP SRAM, DMA-aligned)
 *   Pedestal:       20   (hardcoded in FM LUT)
 *   Gain:           2    (hardcoded in FM LUT)
 *   Polarity:       current-minus-previous (hardcoded in FM LUT)
 *   RX sample edge: POS
 *   TX shift edge:  NEG
 *   BS EOF:         downstream (PARLIO TX loop never generates downstream EOF)
 *   BS tail:        0 bytes
 *
 * DMA owns sample pacing; tasks handle AGC, buttons and console commands.
 */

#include "video.h"
#ifdef C5VRX4_EXPERIMENT
#include "c5vrx4.h"
#include "cvbs_monitor.h"
#include "cvbs_level_hw.h"
#endif
#include "rf.h"
#include "phy_rx_lab.h"
#include "rx_control_epoch.h"
#include "menu_font.h"
#include "menu_raster.h"
#include "range_control.h"
#include "demod_quality.h"
#include "fusion_receiver.h"
#include "fusion_temporal.h"
#include "fusion_optimizer.h"
#include "arc_controller.h"
#include "arc_v3_controller.h"
#include "arc_v5_autotune.h"
#include "direct_gain.h"
#include "direct_gain_v2.h"
#include "direct_gain_v3.h"
#include "analog_video_detect.h"
#include "phase8_gain_lut.h"
#include "fm_hc_lut.h"
#include "phase8_envelope.h"
#include "afc_state.h"
#include "afc_v2.h"
#include "afc_v2_ctrl.h"
#include "rx_auto_lab.h"
#include "trajectory_v2_lut.h"
#include "hal/parlio_ll.h"
#include "hal/usb_serial_jtag_ll.h"
#include "bs_relative_worker_probe.h"
#include "bs_relative_middle_probe.h"

#include <stdint.h>
#include <stdlib.h>
#include <inttypes.h>
#include <string.h>
#include <fcntl.h>
#include <unistd.h>

#include "driver/usb_serial_jtag_vfs.h"
#include "driver/bitscrambler.h"
#include "driver/gpio.h"
#include "driver/parlio_rx.h"
#include "driver/parlio_tx.h"
#include "esp_attr.h"
#include "esp_cache.h"
#include "esp_log.h"
#include "esp_heap_caps.h"
#include "esp_system.h"
#include "nvs.h"
#include "esp_rom_sys.h"
#include "esp_timer.h"
#include "freertos/FreeRTOS.h"
#include "freertos/queue.h"
#include "freertos/task.h"
#include "soc/parl_io_struct.h"
#include "soc/bitscrambler_struct.h"
#include "soc/ahb_dma_struct.h"
#include "soc/pcr_struct.h"
#include "modem/modem_syscon_reg.h"
#include "hal/dma_types.h"
#include "esp_clock_output.h"

/* Hardware diagnostic counters in IRAM to measure transport hiccups without printf spam */
typedef struct {
    uint32_t parl_rx_wovf_count;
    uint32_t parl_tx_rempty_count;
    uint32_t parl_tx_eof_count;
    uint32_t gdma_in_fault_count;
    uint32_t gdma_out_fault_count;
    uint32_t bs_fifo_empty_count;
    uint32_t bs_eof_overload_count;
    uint32_t lag_event_count;
    uint32_t near_gain_event_count;
    uint32_t near_phy_event_count;
    uint32_t gain_quality_drop_count;
    uint32_t user_lag_mark_count;
    uint32_t checks;
} hw_transport_counters_t;

enum {
    LAG_EVT_PARLIO_TX_REMPTY = 1u << 0,
    LAG_EVT_PARLIO_RX_WOVF   = 1u << 1,
    LAG_EVT_PARLIO_TX_EOF    = 1u << 2,
    LAG_EVT_GDMA_IN_FAULT    = 1u << 3,
    LAG_EVT_GDMA_OUT_FAULT   = 1u << 4,
    LAG_EVT_BS_EOF_OVERLOAD  = 1u << 5,
};

enum {
    PHY_WRITE_NONE   = 0,
    PHY_WRITE_GAIN   = 1,
    PHY_WRITE_BW     = 2,
    PHY_WRITE_OFFSET = 3,
    PHY_WRITE_FFT    = 4,
};

#define LAG_EVENT_LOG_SIZE 12u
#define GDMA_IN_FAULT_MASK  0xfcu /* ERR_EOF, DSCR_ERR/EMPTY, FIFO OVF/UDF, AHB response */
#define GDMA_OUT_FAULT_MASK 0x7cu /* DSCR_ERR, TOTAL_EOF, FIFO OVF/UDF, AHB response */

typedef struct {
    int64_t time_us;
    uint32_t seq;
    uint32_t flags;
    uint16_t rx_off;
    uint16_t tx_off;
    uint8_t gain;
    uint8_t agc_state;
} lag_event_t;

static volatile hw_transport_counters_t s_hw_counters;
static lag_event_t s_lag_events[LAG_EVENT_LOG_SIZE];
static volatile uint32_t s_lag_event_head;
static volatile int64_t s_last_gain_write_us;
static volatile int64_t s_last_phy_write_us;
static volatile uint8_t s_last_phy_write_kind;
static volatile int64_t s_last_transport_event_us;
static volatile uint32_t s_last_transport_flags;
static volatile uint32_t s_last_gain_drop_transition;
static volatile int64_t s_last_user_lag_mark_us;

/* fm.bsasm program symbol generated by target_bitscrambler_add_src(). */
BITSCRAMBLER_PROGRAM(s_fm_program, "fm");
BITSCRAMBLER_PROGRAM(s_fm_relative_golden_program, "fm_relative_golden");
BITSCRAMBLER_PROGRAM(s_fm_phase5_360_program, "fm_phase5_360");
BITSCRAMBLER_PROGRAM(s_fm_phase8_hr_live_program, "fm_phase8_hr_live");
BITSCRAMBLER_PROGRAM(s_fm_hc_program, "fm_hc");
BITSCRAMBLER_PROGRAM(s_fm_fsm_capture_program, "fm_phase5_fsm_capture");
BITSCRAMBLER_PROGRAM(s_fm4_program, "fm4");
#ifdef C5VRX4_EXPERIMENT
BITSCRAMBLER_PROGRAM(s_c5vrx4_legacy_static_program, "c5vrx4_phase8_static_legacy");
BITSCRAMBLER_PROGRAM(s_c5vrx4_legacy_history_program, "c5vrx4_phase8_history_legacy");
BITSCRAMBLER_PROGRAM(s_c5vrx4_static_program, "c5vrx4_phase8_static");
BITSCRAMBLER_PROGRAM(s_c5vrx4_history_program, "c5vrx4_phase8_history");
BITSCRAMBLER_PROGRAM(s_c5vrx4_cvbs150_static_program, "c5vrx4_phase8_static_cvbs150");
BITSCRAMBLER_PROGRAM(s_c5vrx4_cvbs150_history_program, "c5vrx4_phase8_history_cvbs150");

/* M-selected output transfer (generate_phase8.py): STD150 default,
 * LEGACY_FULL or CVBS150; STATIC/HISTORY decode is independent of it. */
static const void *c5vrx4_selected_program(void)
{
    bool history = c5vrx4_history_enabled();
    switch (c5vrx4_cvbs_mode()) {
    case C5VRX4_CVBS_LEGACY:
        return history ? s_c5vrx4_legacy_history_program : s_c5vrx4_legacy_static_program;
    case C5VRX4_CVBS_150:
        return history ? s_c5vrx4_cvbs150_history_program : s_c5vrx4_cvbs150_static_program;
    default:
        return history ? s_c5vrx4_history_program : s_c5vrx4_static_program;
    }
}
#endif

/* ----- Fixed production constants ----- */
#define IQ_RATE_HZ       40000000u   /* MODEM_DIAG / PARLIO RX clock */
#define DAC_RATE_HZ      40000000u   /* default 6-bit PARLIO TX clock */
#define DAC4_RATE_HZ     80000000u   /* experimental 4-bit PARLIO TX clock */
#define RAW_RING_BYTES   32768u      /* 32 KiB cyclic ring; Golden Phase5 datapath */
#define DAC_IDLE_CODE    20u         /* Black/blanking pedestal; sync is 0 */
#define BOOT_BTN_GPIO    GPIO_NUM_28 /* Seeed Studio XIAO ESP32-C5 BOOT Button */
#define MENU_RUNTIME_ENABLED 1       /* Native CVBS menu enabled after geometry rework */
#define CONTROL_SAMPLE_BYTES 4092u  /* one complete, already-finished GDMA descriptor */
#define FUSION_FAST_SAMPLE_BYTES 512u /* distributed shadow window; never paces live IQ */
#define FUSION_FAST_PERIOD_MS 6u      /* ~8 observations per 50 ms actuator period */
#define GAIN_SETTLE_TICKS 10        /* 500 ms decision hold after a physical gain write */
#define GAIN_SEARCH_PROBE_TICKS 20  /* 1.0 s between no-carrier sensitivity probes */
#define PERIODIC_TELEMETRY 0        /* keep live control path silent; diagnostics are on-demand */
#define LAB_GAIN_MIN       2u        /* production controller lower bound */
#define LAB_GAIN_MAX       62u       /* production controller upper bound */
#define LAB_GAIN_STEP      2u        /* characterize the states production actually uses */
#define LAB_GAIN_SETTLE_MS 700u      /* measure after the existing 500 ms gain hold */
#define LAB_GAIN_DWELL_MS  1000u     /* one second per state for scope/video correlation */
#define LAB_FFT_SETTLE_MS  550u      /* FFT probe: wait beyond one control/settle interval */
#define LAB_FFT_DWELL_MS   750u      /* short bounded dwell; lab-only, never production */
#define LAB_BW_SETTLE_MS   800u      /* allow analog filter change before measurement */
#define LAB_PREQ4_SETTLE_MS 850u      /* raw-Q4 settle after TX/noise-state change */
#define RX_AUTO_SAMPLE_COUNT       5u
#define RX_AUTO_SAMPLE_SPACING_MS 60u
#define RX_AUTO_GAIN_SETTLE_MS    600u
#define RX_AUTO_BW_SETTLE_MS      800u
#define RX_AUTO_OFFSET_SETTLE_MS  650u
#define RX_AUTO_TOP_COUNT         3u
#define RX_AUTO_PROOF_ROUNDS      5u

typedef enum {
    VIDEO_STD_MODE_AUTO = 0,
    VIDEO_STD_MODE_NTSC = 1,
    VIDEO_STD_MODE_PAL  = 2,
} video_standard_mode_t;

static volatile video_standard_mode_t s_video_std_mode = VIDEO_STD_MODE_AUTO;
static volatile video_standard_t s_video_std = VIDEO_STD_NTSC;
static volatile video_standard_t s_detected_video_std = VIDEO_STD_NTSC;
static volatile bool s_detected_video_std_valid;
static volatile uint8_t s_video_std_pal_score;
static volatile uint8_t s_video_std_ntsc_score;
static volatile uint16_t s_last_line_period_20m;
static volatile uint16_t s_last_sync_width_20m;
static volatile int s_last_sync_quality;
static QueueHandle_t s_menu_commands;
static bitscrambler_handle_t s_flight_bs;

/* Cache synchronization helpers for DMA buffers and descriptors on ESP32-C5.
 * Aligns address down and size up to 64-byte cache line boundaries so esp_cache_msync
 * never fails with ESP_ERR_INVALID_ARG on unaligned descriptors or buffers. */
static inline void sync_dma_c2m(const void *addr, size_t size)
{
    if (!addr || size == 0) return;
    uint32_t start = (uint32_t)addr & ~(64u - 1u);
    uint32_t end = ((uint32_t)addr + size + 63u) & ~(64u - 1u);
    (void)esp_cache_msync((void *)start, end - start,
                          ESP_CACHE_MSYNC_FLAG_DIR_C2M | ESP_CACHE_MSYNC_FLAG_UNALIGNED);
}

static inline void sync_dma_m2c(const void *addr, size_t size)
{
    if (!addr || size == 0) return;
    uint32_t start = (uint32_t)addr & ~(64u - 1u);
    uint32_t end = ((uint32_t)addr + size + 63u) & ~(64u - 1u);
    (void)esp_cache_msync((void *)start, end - start,
                          ESP_CACHE_MSYNC_FLAG_DIR_M2C | ESP_CACHE_MSYNC_FLAG_UNALIGNED);
}

/* Timing and descriptors are immutable while running; only text pixels change.
 * This raster is never linked to the RF ring. */
static DMA_ATTR __attribute__((aligned(64))) menu_raster_t s_menu_raster;
/* The two-field PAL/NTSC scatter chain is below 20 KiB. Descriptors are needed
 * only while the standalone menu owns TX, so allocate the bounded maximum from
 * internal AHB-DMA descriptor memory and return it on exit. */
static dma_descriptor_t *s_menu_nodes;
static unsigned s_menu_node_capacity;
/* AGC sampling and channel scan are serialized in analog_agc_task, so they
 * share one descriptor-sized CPU snapshot instead of reserving 8 KiB. */
static uint8_t s_control_sample_buf[CONTROL_SAMPLE_BYTES];
static unsigned s_menu_node_count;
static volatile bool s_menu_active;
static volatile bool s_menu_boot_btn_enabled = true;
static volatile int s_menu_cursor;
static int s_menu_timeout_ticks;

typedef enum {
    RF_BW_MODE_BW40 = 0,
    RF_BW_MODE_BW20 = 1,
    RF_BW_MODE_AUTO = 2,
} rf_bw_mode_t;

typedef enum {
    VIDEO_OUTPUT_6BIT_40 = 0,
    VIDEO_OUTPUT_4BIT_80 = 1,
} video_output_mode_t;

typedef enum {
    DEMOD_MODE_GOLDEN_PHASE5 = 0,
    DEMOD_MODE_TRAJECTORY_V2 = 1,
    DEMOD_MODE_COUNT,
} demod_mode_t;

typedef enum {
    RX_PROFILE_BALANCED = 0,
    RX_PROFILE_RANGE_EXP,
    RX_PROFILE_BLOCKER_EXP,
    RX_PROFILE_RECOVERY_EXP,
    RX_PROFILE_AUTO_EXP,
    RX_PROFILE_ARC,
    RX_PROFILE_FUSION_EXP,
    RX_PROFILE_RANGE_V2_EXP,
    RX_PROFILE_ARC_V3_EXP,
    RX_PROFILE_ARC_V5_AUTOTUNE_EXP,
    RX_PROFILE_DIRECT_GAIN,
    RX_PROFILE_DIRECT_GAIN_V1,
    RX_PROFILE_COUNT,
} rx_profile_t;

static volatile rf_bw_mode_t s_rf_bw_mode = RF_BW_MODE_AUTO;
static volatile bool s_current_bw40 = true;
static volatile video_output_mode_t s_output_mode = VIDEO_OUTPUT_6BIT_40;
static video_output_mode_t s_tx_unit_mode = VIDEO_OUTPUT_6BIT_40;
static volatile demod_mode_t s_demod_mode = DEMOD_MODE_GOLDEN_PHASE5;
static volatile rx_profile_t s_rx_profile = RX_PROFILE_DIRECT_GAIN;
static direct_gain_controller_t s_direct_gain_controller;
static direct_gain_v2_t s_direct_gain_v2;
#if CONFIG_C5VRX_DIRECT_GAIN_V3_EXPERIMENT
static direct_gain_v3_t s_direct_gain_v3;
static volatile int s_v3_p50, s_v3_p90, s_v3_p95, s_v3_origin_pm;
/* Receiver DC at maximum gain (quiet windows), milli-steps of lane 0. */
static volatile int s_v3_dc_i_mstep, s_v3_dc_q_mstep;
static volatile uint32_t s_v3_bw_switches;
static volatile int s_v3_clip_pm, s_v3_coherence;
static TaskHandle_t s_v3_observer_task_handle;
#if CONFIG_C5VRX_PHASE8_HR_LIVE_TEST
/* History-conditioned demodulator (fm_hc.bsasm), chosen per boot from NVS
 * c5vrx/hc_demod = 1 ('P' toggles and reboots). Default Phase8 FULL. */
static bool s_hc_demod;
#endif
static TaskHandle_t s_v3_sentinel_task_handle;
static esp_timer_handle_t s_v3_sentinel_timer;
static volatile uint32_t s_v3_fast_overload_state;
static dg3_observation_t s_v3_fast_overload_observation;
static rx_control_epoch_t s_v3_fast_overload_epoch;
#endif
static volatile uint32_t s_gain_transition_count = 0;
static volatile uint32_t s_direct_gain_v2_write_seq;
static volatile direct_gain_state_t s_last_direct_gain_state = DIRECT_GAIN_SEEK;
static volatile uint8_t s_last_direct_gain_target;
static volatile int s_last_direct_gain_delta;
static volatile uint32_t s_last_direct_gain_total_writes;
static volatile uint32_t s_last_direct_gain_hold_cycles;
static volatile arc_v3_state_t s_last_arc_v3_state = ARC_V3_ACQUIRE;
static volatile arc_v3_q4_state_t s_last_arc_v3_q4_state = ARC_V3_Q4_STARVED;
static volatile bool s_last_arc_v3_filtered_valid;
static volatile int s_last_arc_v3_filtered_p;
static volatile int s_last_arc_v3_filtered_q;
static volatile int s_last_arc_v3_filtered_clip;
static volatile int s_last_arc_v3_filtered_origin;
static volatile unsigned s_last_arc_v3_up_guard;
static volatile uint32_t s_profile_generation;
static volatile bool s_profile_fft_forced;
static volatile bool s_fft_q4_effect_known;
static volatile bool s_fft_q4_effective;
static volatile int8_t s_fft_best_value;
static volatile int s_last_noise_floor_dbm = -127;
static volatile int s_last_phy_rssi_dbm = -127;
static volatile bool s_noise_floor_valid;
static volatile bool s_phy_rssi_valid;

/* TX GPIO mapping: 6-bit resistor DAC.
 * Order: DAC bit 0 (LSB) .. DAC bit 5 (MSB) on data_gpio_nums[0..5].
 * Bits 6..7 unused (set to -1).
 * Verified against C5VRX-2 realtime.c (standard 8-bit PARLIO TX, non-parlio4). */
static const int s_dac_gpio[8] = {23, 24, 11, 12, 8, 9, -1, -1};
/* 4-bit mode drives the four MSB resistor branches: weights 4/8/16/32. */
static const int s_dac4_gpio[4] = {11, 12, 8, 9};

_Static_assert(IQ_RATE_HZ == 40000000u, "IQ rate must be 40 MHz");
_Static_assert(DAC_RATE_HZ == 40000000u, "DAC rate must be 40 MHz");
_Static_assert(RAW_RING_BYTES == 32768u, "Ring must be exactly 32768 bytes");
_Static_assert(CONTROL_SAMPLE_BYTES <= 4092u, "Control window must fit one GDMA descriptor");
_Static_assert(FUSION_FAST_SAMPLE_BYTES <= 4092u, "Fusion shadow window must fit one GDMA descriptor");

static const char *TAG = "c5vrx3_video";

/* DMA-aligned ring buffer in HP SRAM.
 * RX GDMA writes at 40 MB/s; TX GDMA reads at 40 MB/s.
 * TX starts one block (4096 bytes = 102.4 µs) behind RX; they share
 * PLL_F240M/6, so separation cannot drift during normal operation. */
static DMA_ATTR __attribute__((aligned(64))) uint8_t s_raw_ring[RAW_RING_BYTES];

static parlio_rx_unit_handle_t      s_rx;
static parlio_rx_delimiter_handle_t s_rx_delimiter;
static parlio_tx_unit_handle_t      s_tx;

/* ----- PARLIO RX setup ----- */

static esp_err_t prepare_rx(void)
{
    /* Proven PARLIO RX config with clean internal SPLL clock */
    const parlio_rx_unit_config_t cfg = {
        .trans_queue_depth = 1u,
        .max_recv_size     = sizeof(s_raw_ring),
        .dma_burst_size    = 32u,
        .data_width        = 8u,
        .clk_src           = PARLIO_CLK_SRC_DEFAULT,
        .ext_clk_freq_hz   = 0u,
        .exp_clk_freq_hz   = IQ_RATE_HZ,
        .clk_in_gpio_num   = -1,
        .clk_out_gpio_num  = -1,
        .valid_gpio_num    = -1,
        /* GPIO order must match s_iq_pins[] in rf.c:
         * Q[9:6] on GPIO 1,0,25,7 then I[9:6] on GPIO 10,5,3,4. */
        .data_gpio_nums    = {
            GPIO_NUM_1, GPIO_NUM_0, GPIO_NUM_25, GPIO_NUM_7,
            GPIO_NUM_10, GPIO_NUM_5, GPIO_NUM_3, GPIO_NUM_4,
        },
        .flags = {
            .free_clk    = true,   /* RX clock is derived from PHY, not gated */
            .clk_gate_en = false,
            .allow_pd    = false,
        },
    };
    esp_err_t err = parlio_new_rx_unit(&cfg, &s_rx);
    if (err != ESP_OK) return err;

    /* Soft delimiter in infinite (partial_rx_en) mode.
     * POS sample edge -- proven correct for internal clock. */
    const parlio_rx_soft_delimiter_config_t delim_cfg = {
        .sample_edge  = PARLIO_SAMPLE_EDGE_POS,
        .bit_pack_order = PARLIO_BIT_PACK_ORDER_LSB,
        .eof_data_len = sizeof(s_raw_ring),
        .timeout_ticks = 0u,
    };
    err = parlio_new_rx_soft_delimiter(&delim_cfg, &s_rx_delimiter);
    if (err != ESP_OK) return err;

    return parlio_rx_unit_enable(s_rx, false);
}

/* ----- PARLIO TX setup ----- */

static esp_err_t create_tx_unit(video_output_mode_t mode)
{
    const bool four_bit = mode == VIDEO_OUTPUT_4BIT_80;
    parlio_tx_unit_config_t cfg = {
        .clk_src               = PARLIO_CLK_SRC_DEFAULT,
        .clk_in_gpio_num       = -1,
        .input_clk_src_freq_hz = 0u,
        .output_clk_freq_hz    = four_bit ? DAC4_RATE_HZ : DAC_RATE_HZ,
        .data_width            = four_bit ? 4u : 8u,
        .data_gpio_nums        = {-1, -1, -1, -1, -1, -1, -1, -1},
        .clk_out_gpio_num      = -1,
        .valid_gpio_num        = -1,
        .valid_start_delay     = 0,
        .valid_stop_delay      = 0,
        .trans_queue_depth     = 1u,
        .max_transfer_size     = sizeof(s_raw_ring),
        .dma_burst_size        = 32u,
        .shift_edge            = PARLIO_SHIFT_EDGE_NEG,
        .bit_pack_order        = PARLIO_BIT_PACK_ORDER_LSB,
    };

    if (four_bit) {
        for (unsigned i = 0; i < 4u; ++i) cfg.data_gpio_nums[i] = s_dac4_gpio[i];
    } else {
        for (unsigned i = 0; i < 8u; ++i) cfg.data_gpio_nums[i] = s_dac_gpio[i];
    }

    esp_err_t err = parlio_new_tx_unit(&cfg, &s_tx);
    if (err != ESP_OK) return err;

    /* Keep the two unused LSB resistor branches low in 4-bit mode so the
     * existing six-resistor DAC can be used without rewiring. */
    if (four_bit) {
        gpio_set_direction((gpio_num_t)s_dac_gpio[0], GPIO_MODE_OUTPUT);
        gpio_set_direction((gpio_num_t)s_dac_gpio[1], GPIO_MODE_OUTPUT);
        gpio_set_level((gpio_num_t)s_dac_gpio[0], 0);
        gpio_set_level((gpio_num_t)s_dac_gpio[1], 0);
    }

    s_tx_unit_mode = mode;
    return ESP_OK;
}

static esp_err_t replace_tx_unit(video_output_mode_t mode)
{
    esp_err_t err = parlio_del_tx_unit(s_tx);
    if (err != ESP_OK) return err;
    s_tx = NULL;
    return create_tx_unit(mode);
}

static esp_err_t prepare_tx(void)
{
    esp_err_t err = create_tx_unit(s_output_mode);
    if (err != ESP_OK) return err;

    const bitscrambler_config_t bs_cfg = {
        .dir = BITSCRAMBLER_DIR_TX,
        .attach_to = SOC_BITSCRAMBLER_ATTACH_PARL_IO,
    };
    err = bitscrambler_new(&bs_cfg, &s_flight_bs);
    if (err != ESP_OK) return err;

    return parlio_tx_unit_enable(s_tx);
}

/* ----- Start RX cyclic ring ----- */

static esp_err_t start_rx(void)
{
    esp_err_t err = parlio_rx_soft_delimiter_start_stop(s_rx, s_rx_delimiter, true);
    if (err != ESP_OK) return err;
    const parlio_receive_config_t cfg = {
        .delimiter = s_rx_delimiter,
        .flags = {
            .partial_rx_en   = true,
            .indirect_mount  = false,
        },
    };
    return parlio_rx_unit_receive(s_rx, s_raw_ring, sizeof(s_raw_ring), &cfg);
}

/* ----- Start TX loop ----- */

static esp_err_t start_tx(void)
{
    /* Phase5 LUT is embedded in fm.bsasm -- no runtime bitscrambler_load_lut().
     * Hardware oracle v9 proved embedded LUT is byte-exact at 20 MS/s;
     * a separately preloaded LUT is NOT retained by the active PARLIO TX run. */
    const parlio_transmit_config_t cfg = {
        .idle_value          = s_output_mode == VIDEO_OUTPUT_4BIT_80 ? (DAC_IDLE_CODE >> 2) : DAC_IDLE_CODE,
        .bitscrambler_program = NULL, /* s_flight_bs is controlled explicitly */
        .flags.loop_transmission = true,  /* Infinite -- never generates downstream EOF */
    };
    /* TX reads sizeof(s_raw_ring) * 8 bits, then loops.
     * loop_transmission=true means PARLIO TX never stops; the BitScrambler
     * with eof_on=downstream therefore runs uninterrupted forever. */
    return parlio_tx_unit_transmit(s_tx, s_raw_ring,
                                   sizeof(s_raw_ring) * 8u, &cfg);
}

static int s_rx_dma_ch = -1;
static int s_tx_dma_ch = -1;

static inline uint32_t get_rx_dma_offset(uint32_t *out_dscr_addr)
{
    if (s_rx_dma_ch < 0 || s_rx_dma_ch >= 3) return 0;
    uint32_t dscr_addr = AHB_DMA.channel[s_rx_dma_ch].in.in_dscr_bf0.val;
    if (out_dscr_addr) *out_dscr_addr = dscr_addr;
    if (dscr_addr >= 0x40800000u && dscr_addr < 0x40860000u) {
        dma_descriptor_t *dscr = (dma_descriptor_t *)(uintptr_t)dscr_addr;
        uint8_t *buf = (uint8_t *)dscr->buffer;
        if (buf >= s_raw_ring && buf < s_raw_ring + sizeof(s_raw_ring)) {
            return (uint32_t)(buf - s_raw_ring);
        }
    }
    return 0;
}

static inline uint32_t get_tx_dma_offset(uint32_t *out_dscr_addr)
{
    if (s_tx_dma_ch < 0 || s_tx_dma_ch >= 3) return 0;
    uint32_t dscr_addr = AHB_DMA.channel[s_tx_dma_ch].out.out_dscr_bf0.val;
    if (out_dscr_addr) *out_dscr_addr = dscr_addr;
    if (dscr_addr >= 0x40800000u && dscr_addr < 0x40860000u) {
        dma_descriptor_t *dscr = (dma_descriptor_t *)(uintptr_t)dscr_addr;
        uint8_t *buf = (uint8_t *)dscr->buffer;
        if (buf >= s_raw_ring && buf < s_raw_ring + sizeof(s_raw_ring)) {
            return (uint32_t)(buf - s_raw_ring);
        }
    }
    return 0;
}

#define MAX_RING_DESCRIPTORS 16

typedef struct {
    dma_descriptor_t *dscr;
    uint8_t *buffer;
    uint32_t length;
} ring_dscr_node_t;

static ring_dscr_node_t s_rx_dscr_nodes[MAX_RING_DESCRIPTORS];
static int s_rx_dscr_count = 0;

static ring_dscr_node_t s_tx_dscr_nodes[MAX_RING_DESCRIPTORS];
static int s_tx_dscr_count = 0;

static inline int find_dscr_index(const ring_dscr_node_t *nodes, int count, uint32_t addr)
{
    for (int i = 0; i < count; i++) {
        if ((uintptr_t)nodes[i].dscr == addr) return i;
    }
    return -1;
}

static int patch_descriptors_clear_eof(int dma_ch, bool is_rx)
{
    if (dma_ch < 0 || dma_ch >= 3) return 0;
    uint32_t first_addr = is_rx ? AHB_DMA.channel[dma_ch].in.in_dscr_bf0.val
                                : AHB_DMA.channel[dma_ch].out.out_dscr_bf0.val;
    if (first_addr < 0x40800000u || first_addr >= 0x40860000u) return 0;

    dma_descriptor_t *curr = (dma_descriptor_t *)(uintptr_t)first_addr;
    int count = 0;
    if (is_rx) s_rx_dscr_count = 0;
    else s_tx_dscr_count = 0;

    while (curr && count < MAX_RING_DESCRIPTORS) {
        curr->dw0.suc_eof = 0;
        sync_dma_c2m(curr, sizeof(dma_descriptor_t));

        if (is_rx) {
            s_rx_dscr_nodes[count].dscr = curr;
            s_rx_dscr_nodes[count].buffer = (uint8_t *)curr->buffer;
            s_rx_dscr_nodes[count].length = curr->dw0.size ? curr->dw0.size : 4092u;
        } else {
            s_tx_dscr_nodes[count].dscr = curr;
            s_tx_dscr_nodes[count].buffer = (uint8_t *)curr->buffer;
            s_tx_dscr_nodes[count].length = curr->dw0.size ? curr->dw0.size : 4092u;
        }

        curr = curr->next;
        count++;
        if ((uintptr_t)curr == first_addr) break;
    }
    if (is_rx) s_rx_dscr_count = count;
    else s_tx_dscr_count = count;

    __asm__ __volatile__("fence rw, rw" ::: "memory");
    return count;
}

/* Capture validity, not merely a pointer to the previous DMA descriptor.
 * Never accept a copy that could have been lapped while this task was preempted. */
static bool copy_completed_rx_window(uint8_t *dst, size_t bytes, size_t *ring_offset)
{
    if (s_rx_dma_ch < 0 || s_rx_dma_ch >= 3 || s_rx_dscr_count < 3) return false;
    int64_t start = esp_timer_get_time();
    uint32_t before = AHB_DMA.channel[s_rx_dma_ch].in.in_dscr_bf0.val;
    int active = find_dscr_index(s_rx_dscr_nodes, s_rx_dscr_count, before);
    if (active < 0) return false;
    int idx = (active - 1 + s_rx_dscr_count) % s_rx_dscr_count;
    uint8_t *src = s_rx_dscr_nodes[idx].buffer;
    if (!src || s_rx_dscr_nodes[idx].length < bytes || src < s_raw_ring ||
        src + bytes > s_raw_ring + sizeof(s_raw_ring)) return false;
    sync_dma_m2c(src, bytes);
    memcpy(dst, src, bytes);
    int after = find_dscr_index(s_rx_dscr_nodes, s_rx_dscr_count,
        AHB_DMA.channel[s_rx_dma_ch].in.in_dscr_bf0.val);
    /* Last descriptor can be shorter than 4092 bytes. Sum the actual nodes
     * DMA must cross before it can reuse this buffer, starting with zero
     * remaining time in the descriptor active at the first read. */
    uint64_t safe_bytes = 0;
    for (int k = 0; k < s_rx_dscr_count; ++k)
        if (k != active && k != idx) safe_bytes += s_rx_dscr_nodes[k].length;
    uint64_t safe_us = safe_bytes * 1000000ULL / IQ_RATE_HZ;
    int advance = after < 0 ? s_rx_dscr_count :
                  (after - active + s_rx_dscr_count) % s_rx_dscr_count;
    bool ok = after >= 0 && after != idx && advance < s_rx_dscr_count - 1 &&
              (uint64_t)(esp_timer_get_time() - start) < safe_us;
    if (ok && ring_offset) *ring_offset = (size_t)(src - s_raw_ring);
    return ok;
}

/* Pick a descriptor that RX has already completed, rather than sampling a
 * fixed address that GDMA may be overwriting at the same instant. The control
 * loop now consumes one complete 4092-byte descriptor per 50 ms evaluation. */
static uint8_t *get_completed_rx_sample_window(size_t bytes)
{
    if (s_rx_dma_ch < 0 || s_rx_dma_ch >= 3 || s_rx_dscr_count < 2) {
        return s_raw_ring;
    }

    uint32_t current_addr = AHB_DMA.channel[s_rx_dma_ch].in.in_dscr_bf0.val;
    int current_idx = find_dscr_index(s_rx_dscr_nodes, s_rx_dscr_count, current_addr);
    if (current_idx < 0) {
        return s_raw_ring;
    }

    for (int back = 1; back < s_rx_dscr_count; ++back) {
        int idx = (current_idx - back + s_rx_dscr_count) % s_rx_dscr_count;
        uint8_t *buf = s_rx_dscr_nodes[idx].buffer;
        uint32_t len = s_rx_dscr_nodes[idx].length;
        if (buf && len >= bytes &&
            buf >= s_raw_ring && (buf + bytes) <= (s_raw_ring + sizeof(s_raw_ring))) {
            return buf;
        }
    }
    return s_raw_ring;
}


/* Exact Phase5 state decode mirrored from the embedded fm.bsasm LUT.  The
 * detector is observation-only: the realtime BitScrambler remains the sole
 * live demodulator. */
static const uint8_t s_phase5_state_lut[256] = {
     4,  6,  7,  7,  7,  8,  8,  8, 24, 24, 24, 25, 25, 25, 26, 28,
     2,  4,  5,  6,  6,  7,  7,  7, 25, 25, 25, 26, 26, 27, 28, 30,
     1,  3,  4,  5,  5,  6,  6,  6, 26, 26, 26, 27, 27, 28, 29, 31,
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    12, 10,  9,  9,  9,  8,  8,  8, 24, 24, 24, 23, 23, 23, 22, 20,
};

/* Bit i is 1 when the production fm.bsasm delta LUT maps that
 * (previous_phase5,current_phase5) pair to DAC code <= 8.  This compact mask
 * lets the control task recognize real H-sync tips without duplicating the
 * 1024-entry output LUT or using floating point. */
static const uint8_t s_phase5_sync_mask[128] = {
    0x00, 0x00, 0x80, 0x3f, 0x00, 0x00, 0x00, 0xff, 0x00, 0x00, 0x00, 0xfe, 0x03, 0x00, 0x00, 0xfc,
    0x07, 0x00, 0x00, 0xf8, 0x0f, 0x00, 0x00, 0xf0, 0x1f, 0x00, 0x00, 0xe0, 0x3f, 0x00, 0x00, 0xc0,
    0x3f, 0x00, 0x00, 0x80, 0xff, 0x00, 0x00, 0x00, 0xfe, 0x00, 0x00, 0x00, 0xfc, 0x01, 0x00, 0x00,
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    0x00, 0x00, 0xf8, 0x07, 0x00, 0x00, 0xf0, 0x0f, 0x00, 0x00, 0xe0, 0x1f, 0x00, 0x00, 0xc0, 0x1f,
};

static inline bool phase5_pair_is_sync(uint8_t previous, uint8_t current)
{
    unsigned index = ((unsigned)previous << 5u) | current;
    return (s_phase5_sync_mask[index >> 3u] & (1u << (index & 7u))) != 0u;
}

static inline unsigned trajectory_v2_stage1_address(uint8_t previous_phase5,
                                                    uint8_t middle_raw,
                                                    uint8_t current_raw)
{
    /* Must mirror fm_traj.bsasm exactly:
     *   A0..A7 = current raw Q4/I4
     *   A8     = middle raw-I sign
     *   A9     = previous actual Phase5 MSB. */
    return (unsigned)current_raw |
           ((((unsigned)middle_raw >> 7u) & 1u) << 8u) |
           ((((unsigned)previous_phase5 >> 4u) & 1u) << 9u);
}

static inline unsigned trajectory_v2_stage2_address(uint8_t previous_phase5,
                                                    uint8_t token)
{
    return (unsigned)previous_phase5 | (((unsigned)token & 31u) << 5u);
}

static inline uint8_t trajectory_v2_code(uint8_t previous_phase5,
                                         uint8_t middle_raw,
                                         uint8_t current_raw)
{
    unsigned stage1 =
        trajectory_v2_stage1_address(previous_phase5, middle_raw, current_raw);
    uint8_t token = c5vrx_trajectory_v2_token[stage1];
    return c5vrx_trajectory_v2_dac[
        trajectory_v2_stage2_address(previous_phase5, token)];
}

static inline fusion_shadow_metrics_t active_demod_shadow(fusion_shadow_metrics_t shadow)
{
    /* Compressed-LUT ambiguity is only a live failure mechanism when TRAJ V2
     * is actually selected. Keep GOLDEN A/B behavior free of this extra
     * penalty; generic raw-IQ/PLL-lite evidence remains active in both modes. */
    if (s_demod_mode != DEMOD_MODE_TRAJECTORY_V2)
        shadow.trajectory_uncertainty_permille = 0;
    return shadow;
}

static uint32_t s_receive_generation;

static void video_standard_detector_reset(void)
{
    ++s_receive_generation;
    s_video_std_pal_score = 0;
    s_video_std_ntsc_score = 0;
    s_detected_video_std_valid = false;
    s_last_line_period_20m = 0;
    s_last_sync_width_20m = 0;
    s_last_sync_quality = 0;
}

static void video_standard_vote(video_standard_t standard, uint16_t period)
{
    s_last_line_period_20m = period;
    if (standard == VIDEO_STD_PAL) {
        if (s_video_std_pal_score < 8u) ++s_video_std_pal_score;
        if (s_video_std_ntsc_score) --s_video_std_ntsc_score;
    } else {
        if (s_video_std_ntsc_score < 8u) ++s_video_std_ntsc_score;
        if (s_video_std_pal_score) --s_video_std_pal_score;
    }

    if (s_video_std_pal_score >= 3u &&
        s_video_std_pal_score >= s_video_std_ntsc_score + 2u) {
        s_detected_video_std = VIDEO_STD_PAL;
        s_detected_video_std_valid = true;
    } else if (s_video_std_ntsc_score >= 3u &&
               s_video_std_ntsc_score >= s_video_std_pal_score + 2u) {
        s_detected_video_std = VIDEO_STD_NTSC;
        s_detected_video_std_valid = true;
    }
}

/* Frozen stride-3 Phase8/winding estimate: ~63 unique samples per H-sync,
 * ~847.4/853.3 per NTSC/PAL line. Exact live alignment/history is not tagged.
 * Standard voting retains its historical period-in-20M-units interface. */
static c5v4_cvbs_stats_t s_level_stats;
static int video_semantic_observe(const uint8_t *raw, size_t bytes, size_t ring_offset)
{
    (void)ring_offset;
    c5v4_cvbs_stats_t stats;
    c5v4_cvbs_analyze(raw, bytes, c5vrx4_history_enabled(),
                      c5vrx4_cvbs_mode(), &stats);
    s_level_stats = stats;
    unsigned period = stats.period_raw;
    int quality = stats.levels_valid && stats.repeated ? 90 : 0;
    s_last_sync_width_20m = 0; /* No fabricated Phase5-width measurement. */
    if (quality) {
        if (period >= 2532u && period <= 2550u)
            video_standard_vote(VIDEO_STD_NTSC, (uint16_t)((period + 1u) / 2u));
        else if (period >= 2553u && period <= 2571u)
            video_standard_vote(VIDEO_STD_PAL, (uint16_t)((period + 1u) / 2u));
        else quality = 0;
    }
    s_last_sync_quality = quality;
    return quality;
}

typedef struct {
    int p_median;
    int q_phase;
    int n_clip;
    int n_origin;
    int clip_permille;
    int origin_permille;
    int n_coherent;
    int sum_cross;
    int sum_dot;
    int sum_i;
    int sum_q;
    int sum_i2;
    int sum_q2;
    int sum_iq;
    int dc_i_x100;
    int dc_q_x100;
    int iq_skew_permille;
    int iq_cross_permille;
    int winding_events;
    int winding_triplets;
    int winding_permille;
    int strong_winding_events;
    int strong_winding_triplets;
    int strong_winding_permille;
    uint32_t trajectory_uncertainty_sum;
    uint32_t trajectory_states;
    fusion_shadow_metrics_t fusion_shadow;
} control_metrics_t;

static control_metrics_t analyze_control_window(const uint8_t *sample, size_t bytes,
                                                size_t ring_offset)
{
    control_metrics_t m = {0};
    uint16_t hist[129] = {0};
    const size_t production_first = (ring_offset & 1u) ? 0u : 1u;
    int8_t prev_i = 0, prev_q = 0;
    uint8_t prev_phase = 0, prev2_phase = 0;
    uint8_t prev_byte = 0;
    int prev_power = 0, prev2_power = 0;
    fusion_shadow_t fusion_shadow;
    fusion_shadow_reset(&fusion_shadow);

    for (size_t i = 0; i < bytes; ++i) {
        uint8_t byte = sample[i];
        int8_t q = (int8_t)((byte & 0x0fu) << 4) >> 4;
        int8_t in_val = (int8_t)(byte & 0xf0u) >> 4;

        if (in_val == -8 || in_val == 7 || q == -8 || q == 7) ++m.n_clip;
        int i2 = (int)in_val * in_val;
        int q2 = (int)q * q;
        m.sum_i += in_val;
        m.sum_q += q;
        m.sum_i2 += i2;
        m.sum_q2 += q2;
        m.sum_iq += (int)in_val * q;

        int p = i2 + q2;
        const int raw_power = p;
        const uint8_t phase = s_phase5_state_lut[byte];
        fusion_shadow_push(&fusion_shadow, phase, raw_power);
        if (p <= 4) ++m.n_origin;
        if (p > 128) p = 128;
        ++hist[p];

        if (i > 0) {
            int dot = (int)in_val * (int)prev_i + (int)q * (int)prev_q;
            int cross = (int)q * (int)prev_i - (int)in_val * (int)prev_q;
            int abs_cross = cross < 0 ? -cross : cross;
            if (p >= 8 && dot > 0 && abs_cross <= dot) {
                ++m.n_coherent;
                m.sum_cross += cross;
                m.sum_dot += dot;
            }
        }

        /* fm.bsasm consumes one parity at 20 MS/s. Count exactly those
         * endpoint intervals, while using the skipped 40 MS/s middle sample
         * only as a shadow oracle. */
        bool production_endpoint =
            i >= production_first + 2u &&
            ((i - production_first) & 1u) == 0u;
        if (production_endpoint) {
            bool winding = demod_phase5_endpoint_loses_winding(prev2_phase,
                                                               prev_phase,
                                                               phase);
            ++m.winding_triplets;
            if (winding) ++m.winding_events;
            if (prev2_power >= DEMOD_STRONG_POWER_MIN &&
                prev_power >= DEMOD_STRONG_POWER_MIN &&
                raw_power >= DEMOD_STRONG_POWER_MIN) {
                ++m.strong_winding_triplets;
                if (winding) ++m.strong_winding_events;
            }

            unsigned traj_addr =
                trajectory_v2_stage1_address(prev2_phase, prev_byte, byte);
            m.trajectory_uncertainty_sum +=
                255u - c5vrx_trajectory_v2_confidence[traj_addr];
            ++m.trajectory_states;
        }

        prev2_phase = prev_phase;
        prev_phase = phase;
        prev2_power = prev_power;
        prev_power = raw_power;
        prev_byte = byte;
        prev_i = in_val;
        prev_q = q;
    }

    unsigned cumulative = 0;
    for (unsigned p = 0; p <= 128u; ++p) {
        cumulative += hist[p];
        if (cumulative >= (bytes + 1u) / 2u) {
            m.p_median = (int)p;
            break;
        }
    }
    m.q_phase = bytes > 1u ? (m.n_coherent * 100) / (int)(bytes - 1u) : 0;
    m.clip_permille = bytes ? (m.n_clip * 1000) / (int)bytes : 0;
    m.origin_permille = bytes ? (m.n_origin * 1000) / (int)bytes : 1000;
    m.winding_permille = m.winding_triplets ?
        (m.winding_events * 1000) / m.winding_triplets : 0;
    m.strong_winding_permille = m.strong_winding_triplets ?
        (m.strong_winding_events * 1000) / m.strong_winding_triplets : 0;
    m.dc_i_x100 = bytes ? (m.sum_i * 100) / (int)bytes : 0;
    m.dc_q_x100 = bytes ? (m.sum_q * 100) / (int)bytes : 0;

    /* These two dimensionless metrics are intentionally cheap. A perfect
     * centered/circular I/Q cloud tends toward zero skew and zero I/Q cross
     * correlation. They let us quantify DC/IQ calibration quality without
     * putting any new calibration routine in the realtime path. */
    int iq_power = m.sum_i2 + m.sum_q2;
    if (iq_power > 0) {
        int skew = m.sum_i2 - m.sum_q2;
        if (skew < 0) skew = -skew;
        int cross = m.sum_iq;
        if (cross < 0) cross = -cross;
        m.iq_skew_permille = (skew * 1000) / iq_power;
        m.iq_cross_permille = (cross * 2000) / iq_power;
    }
    m.fusion_shadow = fusion_shadow_finish(&fusion_shadow);
    if (m.trajectory_states) {
        m.fusion_shadow.trajectory_uncertainty_permille =
            (int)((m.trajectory_uncertainty_sum * 1000u) /
                  (m.trajectory_states * 255u));
    }
    return m;
}

/* Fast observer publishes temporal state with a tiny sequence lock. It only
 * reads completed DMA data; the 40 MS/s hardware path never waits on it. */
static volatile uint32_t s_fusion_temporal_seq;
static fusion_temporal_metrics_t s_fusion_temporal_shared;
typedef struct {
    direct_gain_v2_observation_t observation;
    uint32_t profile_generation;
    uint8_t gain;
} direct_gain_v2_slow_snapshot_t;
static volatile uint32_t s_direct_gain_v2_slow_seq;
static direct_gain_v2_slow_snapshot_t s_direct_gain_v2_slow_shared;

static void direct_gain_v2_slow_publish(const direct_gain_v2_slow_snapshot_t *s)
{
    ++s_direct_gain_v2_slow_seq;
    __sync_synchronize();
    s_direct_gain_v2_slow_shared = *s;
    __sync_synchronize();
    ++s_direct_gain_v2_slow_seq;
}

static bool direct_gain_v2_slow_read(direct_gain_v2_slow_snapshot_t *out,
                                     uint32_t *sequence)
{
    for (unsigned retry = 0; retry < 4u; ++retry) {
        uint32_t before = s_direct_gain_v2_slow_se…48951 tokens truncated…   unsigned copy_us = (unsigned)(esp_timer_get_time() - begin);
        int after = find_dscr_index(s_rx_dscr_nodes, s_rx_dscr_count,
                            AHB_DMA.channel[s_rx_dma_ch].in.in_dscr_bf0.val);
        rx_control_epoch_t now = {s_profile_generation, phy_rx_lab_generation(), s_gain_transition_count};
        if (after != active || copy_us > 50 || !rx_control_epoch_equal(before, now) ||
            s_menu_active || phy_rx_lab_busy()) {
            printf("C5V4_CVBS discarded=context_or_dma copy_us=%u\n", copy_us);
        } else {
            c5v4_cvbs_stats_t stats;
            int64_t processing = esp_timer_get_time();
            c5v4_cvbs_analyze(raw, CONTROL_SAMPLE_BYTES, c5vrx4_history_enabled(),
                              c5vrx4_cvbs_mode(), &stats);
            unsigned work_us = (unsigned)(esp_timer_get_time() - processing);
            printf("C5V4_CVBS snapshot=%u semantic_estimate=1 valid=%d mode=%s "
                   "period_raw=%u pulses=%u repeated=%u sync_bins=%d blank_bins=%d span_bins=%d "
                   "sync_mad=%d blank_mad=%d nominal_sync_mv=%d nominal_blank_mv=%d "
                   "nominal_depth_mv=%d proposal_q10=%u origin_pm=%u ambiguous_pm=%u "
                   "clip_pm=%u mean_i_mcell=%d mean_q_mcell=%d lane=%u copy_us=%u work_us=%u "
                   "actuator=none\n", capture, stats.levels_valid,
                   c5vrx4_cvbs_mode_name(),
                   stats.period_raw, stats.pulses, stats.repeated, stats.sync_bins,
                   stats.blank_bins, stats.span_bins, stats.sync_mad_bins, stats.blank_mad_bins,
                   stats.sync_mv, stats.blank_mv, stats.sync_depth_mv, stats.suggested_scale_q10,
                   stats.origin_pm, stats.ambiguous_pm, stats.clip_pm,
                   stats.mean_i_mcell, stats.mean_q_mcell, capture_lane, copy_us, work_us);
        }
        vTaskDelay(pdMS_TO_TICKS(50));
    }
    free(raw);
done:
    __sync_lock_release(&s_cvbs_capture_running);
    vTaskDelete(NULL);
}
#endif

static void console_diag_task(void *arg)
{
    (void)arg;

    for (;;) {
        /* IDF 6.0's O_NONBLOCK VFS read consults the installed driver's
         * available-byte count even in no-driver mode. Poll the FIFO here;
         * this task is its sole reader. Bound each batch so paste cannot
         * monopolize the task. No host line-ending or DTR assumption. */
        for (unsigned received = 0; received < 64; ++received) {
            uint8_t byte;
            if (usb_serial_jtag_ll_read_rxfifo(&byte, 1) == 0) break;
            int c = byte;
            if (c != EOF && c > 0) {
#ifdef C5VRX4_EXPERIMENT
                if (c == 'T') c5v4_level_hw_print();
                if (c == 'J') {
                    if (__sync_bool_compare_and_swap(&s_cvbs_capture_running, 0u, 1u) &&
                        xTaskCreate(cvbs_capture_task, "cvbs_capture", 12288, NULL, 1, NULL) != pdPASS) {
                        __sync_lock_release(&s_cvbs_capture_running);
                        printf("C5V4_CVBS refused=task_memory\n");
                    }
                    continue;
                }
                if (c5vrx4_console(c)) continue;
#endif
                if (s_gain_sweep.active &&
                    c != 'g' && c != 'l' && c != 'L' && c != '\r' && c != '\n') {
                    printf("C5VRX_GAIN_SWEEP_BUSY command=0x%02x action=ignored\n", (unsigned)c);
                    continue;
                }
                if (s_gain_sweep.active && (c == '\r' || c == '\n')) continue;
                if (phy_rx_lab_profile_active() && c < 128 &&
                    !strchr("[]HpLl}q\r\n", c)) phy_rx_lab_stock();
                if (rf_native_agc_active() && c < 128 &&
                    strchr("gFBWAGRUSK+-kjasmDIYX", c)) {
                    printf("C5VRX_NATIVE_AGC_OWNS_GAIN command=%c action=ignored "
                           "hint=N_returns_to_firmware_gain\n", c);
                    continue;
                }

                if (c == 'l' || c == 'L') {
                    int64_t now = esp_timer_get_time();
                    phy_rx_lab_mark();
                    s_last_user_lag_mark_us = now;
                    ++s_hw_counters.user_lag_mark_count;
                    long long gain_age_ms = s_last_gain_write_us > 0 ?
                        (long long)((now - s_last_gain_write_us) / 1000) : -1;
                    long long transport_age_ms = s_last_transport_event_us > 0 ?
                        (long long)((now - s_last_transport_event_us) / 1000) : -1;
                    long long phy_age_ms = s_last_phy_write_us > 0 ?
                        (long long)((now - s_last_phy_write_us) / 1000) : -1;
                    printf("[LAG MARK] #%lu gain_age=%lldms phy_age=%lldms phy_kind=%u transport_age=%lldms flags=0x%02lx G=%u state=%u\n",
                           (unsigned long)s_hw_counters.user_lag_mark_count,
                           gain_age_ms, phy_age_ms, (unsigned)s_last_phy_write_kind, transport_age_ms,
                           (unsigned long)s_last_transport_flags,
                           s_current_gain, (unsigned)s_agc_state);
                } else if (c == 'b') {
                    lab_enter_quiet_baseline();
                } else if (c == 'r') {
                    lab_reset_correlation();
                    printf("C5VRX_LAB_RESET gain=%u bw=%u afc=%u\n",
                           s_current_gain, s_current_bw40 ? 40u : 20u, (unsigned)s_afc_mode);
                } else if (c == 'p') {
                    lab_print_row("SNAPSHOT", NULL);
#if CONFIG_C5VRX_BS_RELATIVE_WORKER_PROBE
                    bs_relative_worker_probe_report();
#endif
#if CONFIG_C5VRX_BS_RELATIVE_MIDDLE_PROBE
                    bs_relative_middle_probe_report();
#endif
                } else if (c == 'E') {
                    p8env_capture_report();
                } else if (c == 'N') {
                    lab_toggle_native_agc_boot();
                } else if (c == 'T') {
                    rf_dump_agc_regs();
                } else if (c == 'Q') {
                    lab_dump_raw_probe();
                } else if (c == 'g') {
                    lab_start_gain_sweep();
                } else if (c == 'F') {
                    lab_run_fft_probe();
                } else if (c == 'W') {
                    lab_run_bandwidth_probe(false);
                } else if (c == 'B') {
                    lab_run_bandwidth_probe(true);
                } else if (c == 'A') {
                    lab_run_frequency_probe();
                } else if (c == 'H') {
                    lab_print_arc_oracle();
                    phy_rx_lab_dump(false);
                } else if (c == '}') {
                    phy_rx_lab_toggle_monitor();
                } else if (c == '{') {
                    if (!rf_native_agc_active() && !s_gain_sweep.active && !s_menu_active) {
                        lab_enter_quiet_baseline();
                        phy_rx_lab_dump(true);
                    } else {
                        printf("PHYLAB analog_snapshot_refused=busy_or_native_owner\n");
                    }
                } else if (c == '[') {
                    if (!rf_native_agc_active() && !s_gain_sweep.active && !s_menu_active) {
                        /* Enter baseline once; later profiles restore their own
                         * saved fields without changing the RF reference. */
                        if (!phy_rx_lab_profile_active()) lab_enter_quiet_baseline();
                        phy_rx_lab_next_profile();
                    } else {
                        printf("PHYLAB profile_refused=busy_or_native_owner\n");
                    }
                } else if (c == ']') {
                    phy_rx_lab_stock();
                } else if (c == 'G') {
                    lab_run_far_gain_probe();
                } else if (c == 'U') {
                    lab_run_rx_auto();
                } else if (c == 'S') {
                    lab_run_tx_self_noise_probe();
                } else if (c == 'K') {
                    lab_request_fresh_phy_calibration();
                } else if (c == '(' || c == ')') {
                    lab_run_native_hold(c == '(' ? 1u : 100u);
                } else if (c == ':') {
                    lab_run_11p_probe();
                } else if (c == 'R') {
                    lab_run_rssi_gain_probe();
#if CONFIG_C5VRX_PHASE8_HR_LIVE_TEST
                } else if (c == 'P') {
                    nvs_handle_t h;
                    esp_err_t err = nvs_open("c5vrx", NVS_READWRITE, &h);
                    if (err == ESP_OK) {
                        err = nvs_set_u8(h, "hc_demod", s_hc_demod ? 0u : 1u);
                        if (err == ESP_OK) err = nvs_commit(h);
                        nvs_close(h);
                    }
                    printf("[DEMOD] -> %s on reboot err=%s\n",
                           s_hc_demod ? "PHASE8 FULL" : "HC (history-conditioned)",
                           esp_err_to_name(err));
                    if (err == ESP_OK) {
                        fflush(stdout);
                        vTaskDelay(pdMS_TO_TICKS(150));
                        esp_restart();
                    }
#endif
                } else if (c == 'D') {
                    apply_rx_profile(RX_PROFILE_DIRECT_GAIN);
                    settings_save();
#if CONFIG_C5VRX_DIRECT_GAIN_V3_EXPERIMENT
                    printf("[RX PROFILE] -> DIRECT GAIN V3 TEST (predictive Q4 observer)\n");
#else
                    printf("[RX PROFILE] -> DIRECT GAIN V2 (physical tuple fast observer)\n");
#endif
                } else if (c == 'I') {
                    apply_rx_profile(RX_PROFILE_DIRECT_GAIN_V1);
                    settings_save();
                    printf("[RX PROFILE] -> DIRECT GAIN V1 (50 ms controller)\n");
                } else if (c == 'Y') {
                    apply_rx_profile(RX_PROFILE_ARC_V3_EXP);
                    settings_save();
                    printf("[RX PROFILE] -> ARC V3 EXP (gain-first raw-Q4 controller)\n");
                } else if (c == 'X') {
                    cycle_rx_profile();
                } else if (c == 't') {
                    rf_dump_tracked_timers();
                } else if (c == 'q') {
                    s_lab_quiet = !s_lab_quiet;
                    printf("C5VRX_LAB_QUIET enabled=%u\n", s_lab_quiet ? 1u : 0u);
                } else if (c == '+' || c == 'k') {
                    leave_experimental_profile();
                    s_agc_mode = ANALOG_AGC_MANUAL;
                    uint8_t manual_max = rf_get_arc_gain_table()->max_index;
                    if (s_current_gain < manual_max) {
                        s_current_gain = s_current_gain <= manual_max - LAB_GAIN_STEP ?
                                         (uint8_t)(s_current_gain + LAB_GAIN_STEP) : manual_max;
                        s_last_gain_write_us = esp_timer_get_time();
                        s_last_phy_write_us = s_last_gain_write_us;
                        s_last_phy_write_kind = PHY_WRITE_GAIN;
                        rf_set_rx_gain(true, s_current_gain);
                        ++s_gain_transition_count;
                    }
                    settings_save();
                    printf("[MANUAL GAIN] = %u (reg=0x%08lx)\n", s_current_gain, (unsigned long)rf_get_rx_gain_reg());
                } else if (c == '-' || c == 'j') {
                    leave_experimental_profile();
                    s_agc_mode = ANALOG_AGC_MANUAL;
                    if (s_current_gain > LAB_GAIN_MIN) {
                        s_current_gain = s_current_gain >= LAB_GAIN_MIN + LAB_GAIN_STEP ?
                                         (uint8_t)(s_current_gain - LAB_GAIN_STEP) : LAB_GAIN_MIN;
                        s_last_gain_write_us = esp_timer_get_time();
                        s_last_phy_write_us = s_last_gain_write_us;
                        s_last_phy_write_kind = PHY_WRITE_GAIN;
                        rf_set_rx_gain(true, s_current_gain);
                        ++s_gain_transition_count;
                    }
                    settings_save();
                    printf("[MANUAL GAIN] = %u (reg=0x%08lx)\n", s_current_gain, (unsigned long)rf_get_rx_gain_reg());
                } else if (c == 'a') {
                    leave_experimental_profile();
                    s_agc_mode = ANALOG_AGC_ACTIVE;
                    settings_save();
                    printf("[AGC MODE] -> ACTIVE (Self-Calibrating Adaptive Gain Controller ACTIVE)\n");
                } else if (c == 's') {
                    leave_experimental_profile();
                    s_agc_mode = ANALOG_AGC_SHADOW;
                    settings_save();
                    printf("[AGC MODE] -> SHADOW (Dry-run: RF gain frozen at %u, computing recommendations)\n", s_current_gain);
                } else if (c == 'm') {
                    leave_experimental_profile();
                    s_agc_mode = ANALOG_AGC_MANUAL;
                    settings_save();
                    printf("[AGC MODE] -> MANUAL (Fixed gain=%u)\n", s_current_gain);
                } else if (c == 'c') {
                    rf_cycle_channel_in_band();
                    const fpv_channel_t *ch = rf_get_current_channel();
                    s_cfo_khz = 0;
                    s_agc_state = AGC_STATE_SEARCH;
                    ++s_profile_generation;
                    video_standard_detector_reset();
                    settings_save();
                    printf("[CHANNEL] Switched to %s (%u MHz) in %s\n",
                           ch->name, ch->freq_mhz, rf_get_band_name(rf_get_current_band()));
                } else if (c == 'C') {
                    rf_cycle_band();
                    const fpv_channel_t *ch = rf_get_current_channel();
                    s_cfo_khz = 0;
                    s_agc_state = AGC_STATE_SEARCH;
                    ++s_profile_generation;
                    video_standard_detector_reset();
                    settings_save();
                    printf("[BAND] Switched to %s - Channel %s (%u MHz)\n",
                           rf_get_band_name(rf_get_current_band()), ch->name, ch->freq_mhz);
                } else if (c == 'f') {
                    if (s_afc_mode == AFC_MODE_AUTO) {
                        s_afc_mode = AFC_MODE_HOLD;
                        printf("[AFC] -> HOLD (Current offset %+d kHz frozen)\n", rf_get_frequency_offset_khz());
                    } else if (s_afc_mode == AFC_MODE_HOLD) {
                        s_afc_mode = AFC_MODE_OFF;
                        apply_frequency_offset_khz_tracked(0);
                        printf("[AFC] -> OFF (Offset reset to 0 kHz)\n");
                    } else {
                        s_afc_mode = AFC_MODE_AUTO;
                        printf("[AFC] -> AUTO EXPERIMENTAL (uncalibrated WBFM bias estimator)\n");
                    }
                    settings_save();
                } else if (c == ',' || c == '<') {
                    step_frequency_offset_khz_tracked(-50);
                    settings_save();
                    int off = rf_get_frequency_offset_khz();
                    int tot = (int)rf_get_current_channel()->freq_mhz * 1000 + off;
                    printf("[FINE TUNE] Offset = %+d kHz (Tuned: %d.%03d MHz)\n",
                           off, tot / 1000, (tot % 1000 >= 0 ? tot % 1000 : -(tot % 1000)));
                } else if (c == '.' || c == '>') {
                    step_frequency_offset_khz_tracked(+50);
                    settings_save();
                    int off = rf_get_frequency_offset_khz();
                    int tot = (int)rf_get_current_channel()->freq_mhz * 1000 + off;
                    printf("[FINE TUNE] Offset = %+d kHz (Tuned: %d.%03d MHz)\n",
                           off, tot / 1000, (tot % 1000 >= 0 ? tot % 1000 : -(tot % 1000)));
                } else if (c == '0') {
                    apply_frequency_offset_khz_tracked(0);
                    settings_save();
                    printf("[FINE TUNE] Offset reset to +0 kHz\n");
                } else if (c == 'e') {
                    PARL_IO.rx_clk_cfg.rx_clk_i_inv = !PARL_IO.rx_clk_cfg.rx_clk_i_inv;
                    printf("[EDGE] RX SAMPLE EDGE TOGGLED -> %s (rx_clk_i_inv=%d)\n",
                           PARL_IO.rx_clk_cfg.rx_clk_i_inv ? "NEG" : "POS",
                           (int)PARL_IO.rx_clk_cfg.rx_clk_i_inv);
                } else if (c == 'o' || c == 'v' || c == 'V' || c == 'O' ||
                           c == ' ' || c == 'n' || c == '\t' ||
                           c == '\r' || c == '\n' || c == 'x') {
                    /* The control task exclusively owns mode changes and rendering. */
                    if (xQueueSend(s_menu_commands, &c, 0) != pdTRUE) {
                        printf("[MENU] Command queue full\n");
                    }
                } else {
                    uint32_t rx_dscr = 0, tx_dscr = 0;
                    uint32_t rx_off = get_rx_dma_offset(&rx_dscr);
                    uint32_t tx_off = get_tx_dma_offset(&tx_dscr);
                    uint32_t dist = (rx_off >= tx_off) ? (rx_off - tx_off) : (sizeof(s_raw_ring) - tx_off + rx_off);
                    int rx_nodes = s_rx_dscr_count;
                    int tx_nodes = s_menu_active ? 0 : s_tx_dscr_count;
                    const fpv_channel_t *ch = rf_get_current_channel();
                    int off = rf_get_frequency_offset_khz();
                    int tot = (int)ch->freq_mhz * 1000 + off;

                    printf("\n=======================================================\n");
                    printf(" C5VRX-3 REALTIME RECEPTION & FREQUENCY DIAGNOSTICS\n");
                    printf(" Receiver Channel:           %s (%u MHz)\n", ch->name, ch->freq_mhz);
                    printf(" Tuned Frequency:            %d.%03d MHz (Offset: %+d kHz)\n",
                           tot / 1000, (tot % 1000 >= 0 ? tot % 1000 : -(tot % 1000)), off);
                    printf(" Carrier Frequency Offset:   %+d kHz (VTX %s)\n",
                           s_cfo_khz, (s_cfo_khz > 20) ? "high" : (s_cfo_khz < -20) ? "low" : "centered");
                    printf(" AFC Mode:                   %s\n",
                           (s_afc_mode == AFC_MODE_AUTO) ? "AUTO EXPERIMENTAL (uncalibrated estimator)" :
                           (s_afc_mode == AFC_MODE_HOLD) ? "HOLD (Offset Frozen)" : "OFF (0 kHz)");
                    printf(" RX Profile:                 %s%s\n",
                           rx_profile_name(),
                           s_rx_profile == RX_PROFILE_DIRECT_GAIN ? " [DEFAULT]" : " [A/B]");
                    printf(" RF Bandwidth:               mode=%s active=%s\n",
                           rf_bw_mode_name(), s_current_bw40 ? "BW40" : "BW20");
                    printf(" PHY Environment:            NF=%s%d dBm RSSI=%s%d dBm FFT_Q4=%s best=%d\n",
                           s_noise_floor_valid ? "" : "NA/", s_last_noise_floor_dbm,
                           s_phy_rssi_valid ? "" : "NA/", s_last_phy_rssi_dbm,
                           !s_fft_q4_effect_known ? "UNKNOWN" :
                           s_fft_q4_effective ? "USEFUL" : "NO_EFFECT",
                           (int)s_fft_best_value);
                    printf(" Adaptive AGC Mode:          %s (State=%s)\n",
                           (s_agc_mode == ANALOG_AGC_ACTIVE) ? "ACTIVE" :
                           (s_agc_mode == ANALOG_AGC_SHADOW) ? "SHADOW (Safe Dry-Run)" : "MANUAL",
                           (s_agc_state == AGC_STATE_TRACK) ? "TRACK" :
                           (s_agc_state == AGC_STATE_LEARN) ? "LEARN" : "SEARCH");
                    printf(" Gain Settings:              G_actual=%u, G_shadow_rec=%u (reg=0x%08lx)\n",
                           s_current_gain, s_shadow_gain, (unsigned long)rf_get_rx_gain_reg());
                    if (s_rx_profile == RX_PROFILE_DIRECT_GAIN) {
#if CONFIG_C5VRX_DIRECT_GAIN_V3_EXPERIMENT
                        printf(" Direct Gain V3 State:       %s (target=G%u, delta=%+d, floor=G%u)\n",
#else
                        printf(" Direct Gain V2 State:       %s (target=G%u, delta=%+d, floor=G%u)\n",
#endif
                               direct_gain_state_name(s_last_direct_gain_state),
                               (unsigned)s_last_direct_gain_target,
                               s_last_direct_gain_delta,
                               (unsigned)DIRECT_GAIN_V2_FLOOR);
#if CONFIG_C5VRX_DIRECT_GAIN_V3_EXPERIMENT
                        printf(" Direct Gain V3 Telemetry:   writes=%" PRIu32 ", hold_samples=%" PRIu32
                               " verified=%" PRIu32 " learned=%" PRIu32
                               " settle_us=%u/%u/%u\n",
                               s_last_direct_gain_total_writes,
                               s_last_direct_gain_hold_cycles,
                               s_direct_gain_v3.verified, s_direct_gain_v3.learned,
                               s_direct_gain_v3.settle_us[DG3_FINE],
                               s_direct_gain_v3.settle_us[DG3_BB],
                               s_direct_gain_v3.settle_us[DG3_RF]);
#else
                        printf(" Direct Gain V2 Telemetry:   writes=%" PRIu32 ", lock_samples=%" PRIu32 "\n",
                               s_last_direct_gain_total_writes,
                               s_last_direct_gain_hold_cycles);
#endif
                    }
                    if (s_rx_profile == RX_PROFILE_ARC_V3_EXP) {
                        printf(" ARC V3 State:               %s (Q4=%s)\n",
                               arc_v3_state_name(s_last_arc_v3_state),
                               arc_v3_q4_state_name(s_last_arc_v3_q4_state));
                        if (s_last_arc_v3_filtered_valid) {
                            printf(" ARC V3 Filter:              P=%d Q=%d%% Clip=%d.%d%% Origin=%d.%d%% guard=%u\n",
                                   s_last_arc_v3_filtered_p,
                                   s_last_arc_v3_filtered_q,
                                   s_last_arc_v3_filtered_clip / 10,
                                   s_last_arc_v3_filtered_clip % 10,
                                   s_last_arc_v3_filtered_origin / 10,
                                   s_last_arc_v3_filtered_origin % 10,
                                   s_last_arc_v3_up_guard);
                        }
                    }
                    printf(" FM Vector Metrics:          P_median=%d, Q_phase=%d%%, Clip=%d.%d%%, Origin=%d.%d%%\n",
                           s_last_p_median, s_last_q_phase,
                           s_last_clip_permille / 10, s_last_clip_permille % 10,
                           s_last_origin_permille / 10, s_last_origin_permille % 10);
                    printf(" IQ Fusion:                  ctx=%s quality=%d confidence=%d risk=%d lowIQ=%dpm lag2=%dpm lag4=%dpm consensus=%dpm slope=%d.%02d\n",
                           fusion_context_name((fusion_context_t)s_last_fusion_context),
                           s_last_fusion_quality, s_last_fusion_confidence, s_last_fusion_risk,
                           s_last_fusion_low_confidence_pm, s_last_fusion_lag2_pm,
                           s_last_fusion_lag4_pm, s_last_fusion_consensus_pm,
                           s_last_fusion_slope_x100 / 100,
                           fusion_abs(s_last_fusion_slope_x100 % 100));
                    printf(" Fusion Temporal:            fade=%d recovery=%d stability=%d fast_samples=%lu period=%ums window=%u\n",
                           s_last_fusion_fade, s_last_fusion_recovery,
                           s_last_fusion_stability,
                           (unsigned long)s_last_fusion_fast_samples,
                           FUSION_FAST_PERIOD_MS, FUSION_FAST_SAMPLE_BYTES);
                    printf(" IQ Frontend Metrics:        DC I=%+.2f Q=%+.2f, skew=%d.%d%% cross=%d.%d%%\n",
                           (double)s_last_dc_i_x100 / 100.0, (double)s_last_dc_q_x100 / 100.0,
                           s_last_iq_skew_permille / 10, s_last_iq_skew_permille % 10,
                           s_last_iq_cross_permille / 10, s_last_iq_cross_permille % 10);
                    printf(" Demod Quality:              endpoint winding=%d.%d%% strong=%d.%d%% syncQ=%d width=%u\n",
                           s_last_winding_permille / 10, s_last_winding_permille % 10,
                           s_last_strong_winding_permille / 10, s_last_strong_winding_permille % 10,
                           s_last_sync_quality, (unsigned)s_last_sync_width_20m);
                    printf(" Gain Transitions:           %lu (control window=%u IQ samples / %.1f us)\n",
                           (unsigned long)s_gain_transition_count, CONTROL_SAMPLE_BYTES,
                           (double)CONTROL_SAMPLE_BYTES * 1000000.0 / (double)IQ_RATE_HZ);
                    printf(" GDMA Ring:                  dist=%lu (rx_off=%lu, tx_off=%lu)\n",
                           (unsigned long)dist, (unsigned long)rx_off, (unsigned long)tx_off);
                    printf(" Zero-EOF Status:            RX patched=%d nodes, TX patched=%d nodes\n",
                           rx_nodes, tx_nodes);
                    printf(" Transport Faults:           PARLIO tx_empty=%lu rx_ovf=%lu tx_eof=%lu | GDMA in=%lu out=%lu | BS eof_ovl=%lu\n",
                           (unsigned long)s_hw_counters.parl_tx_rempty_count,
                           (unsigned long)s_hw_counters.parl_rx_wovf_count,
                           (unsigned long)s_hw_counters.parl_tx_eof_count,
                           (unsigned long)s_hw_counters.gdma_in_fault_count,
                           (unsigned long)s_hw_counters.gdma_out_fault_count,
                           (unsigned long)s_hw_counters.bs_eof_overload_count);
                    int64_t transport_age_ms = s_last_transport_event_us > 0 ?
                        (esp_timer_get_time() - s_last_transport_event_us) / 1000 : -1;
                    printf(" Lag Correlation:            events=%lu near_gain_200ms=%lu near_phy_200ms=%lu gain_Qdrop=%lu marks=%lu last_flags=0x%02lx age=%lldms checks=%lu\n",
                           (unsigned long)s_hw_counters.lag_event_count,
                           (unsigned long)s_hw_counters.near_gain_event_count,
                           (unsigned long)s_hw_counters.near_phy_event_count,
                           (unsigned long)s_hw_counters.gain_quality_drop_count,
                           (unsigned long)s_hw_counters.user_lag_mark_count,
                           (unsigned long)s_last_transport_flags,
                           (long long)transport_age_ms,
                           (unsigned long)s_hw_counters.checks);
                    unsigned available = s_lag_event_head < LAG_EVENT_LOG_SIZE ?
                                         s_lag_event_head : LAG_EVENT_LOG_SIZE;
                    for (unsigned n = 0; n < available; ++n) {
                        uint32_t seq = s_lag_event_head - n;
                        const lag_event_t *event = &s_lag_events[(seq - 1u) % LAG_EVENT_LOG_SIZE];
                        printf("  EVT#%lu flags=0x%02lx t=%lldus rx=%u tx=%u G%u state=%u\n",
                               (unsigned long)event->seq,
                               (unsigned long)event->flags,
                               (long long)event->time_us,
                               event->rx_off, event->tx_off,
                               event->gain, event->agc_state);
                    }
                    printf(" RX Sample Edge:             %s (rx_clk_i_inv=%d)\n",
                           PARL_IO.rx_clk_cfg.rx_clk_i_inv ? "NEG" : "POS",
                           (int)PARL_IO.rx_clk_cfg.rx_clk_i_inv);
                    printf(" Video Standard:             mode=%s output=%s detected=%s period=%u samples (PAL=%u NTSC=%u)\n",
                           s_video_std_mode == VIDEO_STD_MODE_AUTO ? "AUTO" :
                           s_video_std_mode == VIDEO_STD_MODE_PAL ? "PAL" : "NTSC",
                           video_standard_name(s_video_std),
                           s_detected_video_std_valid ? video_standard_name(s_detected_video_std) : "UNKNOWN",
                           s_last_line_period_20m,
                           s_video_std_pal_score, s_video_std_ntsc_score);
                    printf(" Menu Status:                %s\n",
                           MENU_RUNTIME_ENABLED ?
                           (s_menu_active ? "OPEN" : "CLOSED") :
                           "TEMPORARILY DISABLED (live video only)");
                    printf(" Lab Status:                 quiet=%u gain_sweep=%u preq4=%u tx_quiet=%u fft_known=%u fft_useful=%u best=%d\n",
                           s_lab_quiet ? 1u : 0u, s_gain_sweep.active ? 1u : 0u,
                           s_pre_q4_probe_active ? 1u : 0u, s_lab_tx_quiet ? 1u : 0u,
                           s_fft_q4_effect_known ? 1u : 0u,
                           s_fft_q4_effective ? 1u : 0u, (int)s_fft_best_value);
                    printf(" Keys:\n");
                    printf("  'a'/'s'/'m': AGC mode (active / shadow / manual)\n");
                    printf("  'b':         Enter quiet MANUAL/BW40/AFC-off baseline + reset counters\n");
                    printf("  'g':         Start/abort G2..G62 production-state gain sweep\n");
                    printf("  'F'/'W':     FFT-scale Q4 probe / fixed-gain BW40-vs-BW20 probe\n");
                    printf("  'A'/'H':     AFC centering sweep / read-only ARC PHY oracle\n");
                    printf("  'G':         PRE-Q4 highest-RF-stage vendor gain sweep (survival..table max)\n");
                    printf("  'U':         ARC V3 RX AUTO LAB (gain -> BW -> center -> repeated A/B proof)\n");
                    printf("  'S':         PRE-Q4 self-noise A/B (live TX vs DAC/PARLIO electrically quiet)\n");
                    printf("  'R':         Run RSSI & Inverse-Q4 Oracle Probe (G15..G81 sweep)\n");
#if CONFIG_C5VRX_DIRECT_GAIN_V3_EXPERIMENT
                    printf("  'D'/'I'/'Y': Direct Gain V3 test / Direct Gain V1 / ARC V3\n");
#else
                    printf("  'D'/'I'/'Y': Direct Gain V2 / Direct Gain V1 / ARC V3\n");
#endif
                    printf("  'K':         Erase stored PHY calibration and reboot for a fresh vendor calibration\n");
                    printf("  'X':         Cycle RX profile (V2/V1/ARC V3)\n");
                    printf("  'B':         Public vendor BW40/BW20 + retune A/B, restore on exit\n");
                    printf("  'H'/'{':   PHY MMIO / quiet baseline + analog I2C snapshot\n");
                    printf("  '}':         Toggle 50ms PHY monitor (L dumps bounded events)\n");
                    printf("  '('/')':     Native BB hold A/B / 100 reversible cycles (native only)\n");
                    printf("  ':':         Reversible phy_11p_set(1,0) A/B (three fresh Q4 rows)\n");
                    printf("  '['/']':     Next isolated 10s PHY lab profile / restore stock\n");
                    printf("  'p'/'r':     Machine-readable PHY/Q4 snapshot / reset lag counters\n");
                    printf("  't'/'q':     Vendor timer inventory / quiet unsolicited lock message\n");
                    printf("  'l':         Mark a visible lag/freeze for correlation\n");
                    printf("  '+' / '-':   Manual gain step (+/-2)\n");
                    printf("  'c':         Cycle FPV channel (A1..A8, R1..R8, B1..B8, F1..F8)\n");
                    printf("  'f':         AFC mode (auto-centering / hold / off)\n");
                    printf("  ',' / '.':   Fine-tune offset (-50 / +50 kHz)\n");
                    printf("  '0':         Reset offset to 0 kHz\n");
                    printf("  'e':         Toggle RX sample edge (POS/NEG)\n");
                    printf("  'v'/'o'/'O': Menu controls\n");
                    printf("  'd':         Print this diagnostic summary\n");
                    printf("=======================================================\n\n");
                }
            }
        }
        lab_gain_sweep_tick();
        vTaskDelay(pdMS_TO_TICKS(10));
    }
}


/* ----- Main entry point ----- */

esp_err_t video_start(void)
{
    /* Keep output unbuffered on the no-driver USB VFS. Input is drained directly
     * by console_diag_task; USB is never involved in DMA sample pacing. */
    setvbuf(stdin, NULL, _IONBF, 0);
    setvbuf(stdout, NULL, _IONBF, 0);
    int flags = fcntl(fileno(stdin), F_GETFL, 0);
    fcntl(fileno(stdin), F_SETFL, flags | O_NONBLOCK);
    flags = fcntl(fileno(stdout), F_GETFL, 0);
    fcntl(fileno(stdout), F_SETFL, flags | O_NONBLOCK);
    usb_serial_jtag_vfs_use_nonblocking();

    /* Initialize BOOT button on GPIO 28 */
    init_boot_button();

    /* Menu control is serialized with BOOT handling in the AGC task. */
    s_menu_commands = xQueueCreate(16, sizeof(int));
    if (!s_menu_commands) return ESP_ERR_NO_MEM;

    settings_load();
#if defined(C5VRX4_EXPERIMENT) || CONFIG_C5VRX_PHASE8_HR_LIVE_TEST
    s_output_mode = VIDEO_OUTPUT_6BIT_40;
#endif
    apply_rx_profile(s_rx_profile);
    if (rf_native_agc_active()) {
        rf_native_agc_state_t native;
        rf_get_native_agc_state(&native);
        ESP_LOGW(TAG, "NATIVE HW AGC (opt-in): vendor AGC never disabled, "
                 "firmware gain writes blocked (gain_reg=0x%08lx agc_reg=0x%08lx). "
                 "'E' = P8ENV row, 'N' = reboot to Direct Gain V5",
                 (unsigned long)native.gain_status_reg,
                 (unsigned long)native.agc_ctrl_reg);
    }

#ifdef C5VRX4_EXPERIMENT
    /* Select the forced lane before capture starts; the fixed comparison
     * never switches geometry inside a live line or at a DMA boundary. */
    rf_set_iq_lanes(0u);
#endif
    /* Zero the ring before starting. Flush to DMA-visible SRAM. */
    memset(s_raw_ring, 0, sizeof(s_raw_ring));
    sync_dma_c2m(s_raw_ring, sizeof(s_raw_ring));

    esp_err_t err;

    if ((err = prepare_rx()) != ESP_OK) return err;
    if ((err = prepare_tx()) != ESP_OK) return err;

#if CONFIG_C5VRX_PHASE8_HR_LIVE_TEST
    {
        nvs_handle_t h;
        uint8_t hc = 0;
        if (nvs_open("c5vrx", NVS_READONLY, &h) == ESP_OK) {
            (void)nvs_get_u8(h, "hc_demod", &hc);
            nvs_close(h);
        }
        s_hc_demod = hc == 1u;
        ESP_LOGW(TAG, "Live demodulator: %s ('P' toggles, reboot)",
                 s_hc_demod ? "HC (history-conditioned, fm_hc)" : "PHASE8 FULL");
    }
#endif
    start_flight_demodulator();

    /* Start RX cyclic ring. GDMA begins writing at s_raw_ring[0]. */
    if ((err = start_rx()) != ESP_OK) return err;

    /* Put PARLIO RX into pure continuous hardware mode:
     * 1. Disable all GDMA RX channel interrupts so the CPU is never interrupted
     *    (~9,775 ISRs/sec eliminated!).
     * 2. Set rx_eof_gen_sel = 1 (external enable, non-existent in soft mode)
     *    so PARLIO RX never generates an EOF stall event.
     * This matches PARLIO TX's unbroken hardware loop, eliminating pointer drift! */
    AHB_DMA.in_intr[0].ena.val = 0;
    AHB_DMA.in_intr[1].ena.val = 0;
    AHB_DMA.in_intr[2].ena.val = 0;
    PARL_IO.rx_genrl_cfg.rx_eof_gen_sel = 1;

    /* Request half-ring producer/consumer separation before starting TX.
     * The integer-microsecond delay and driver latency need hardware validation. */
    esp_rom_delay_us((RAW_RING_BYTES / 2ULL) * 1000000ULL / IQ_RATE_HZ);

    if ((err = start_tx()) != ESP_OK) return err;

    /* Discover AHB_DMA channels assigned to PARL_IO (peripheral ID 9) */
    for (int i = 0; i < 3; i++) {
        if (AHB_DMA.channel[i].in.in_peri_sel.peri_in_sel_chn == 9) {
            s_rx_dma_ch = i;
        }
        if (AHB_DMA.channel[i].out.out_peri_sel.peri_out_sel_chn == 9) {
            s_tx_dma_ch = i;
        }
    }

    /* Put PARLIO TX into pure continuous hardware mode:
     * Disable all GDMA TX channel interrupts and PARL_IO core interrupts.
     * Prevents PARLIO_LL_EVENT_TX_FIFO_EMPTY and EOF interrupts from stealing CPU cycles! */
    AHB_DMA.out_intr[0].ena.val = 0;
    AHB_DMA.out_intr[1].ena.val = 0;
    AHB_DMA.out_intr[2].ena.val = 0;
    PARL_IO.int_ena.val = 0;

    /* Clear suc_eof on ALL GDMA descriptors for both RX and TX to eliminate
     * hardware wrap EOF bubbles completely! The buffer becomes a truly infinite ring. */
    int rx_nodes = patch_descriptors_clear_eof(s_rx_dma_ch, true);
    int tx_nodes = patch_descriptors_clear_eof(s_tx_dma_ch, false);

    /* Issue #28: clear stale startup/driver status once. Subsequent sticky
     * faults are observed by poll_transport_faults() without enabling IRQs. */
    PARL_IO.int_clr.val = UINT32_MAX;
    if (s_rx_dma_ch >= 0) AHB_DMA.in_intr[s_rx_dma_ch].clr.val = UINT32_MAX;
    if (s_tx_dma_ch >= 0) AHB_DMA.out_intr[s_tx_dma_ch].clr.val = UINT32_MAX;
    BITSCRAMBLER.state[BITSCRAMBLER_DIR_TX].val = 1u << 31;

    /* Distributed shadow observer: read-only, no PHY writes and no DMA pacing. */
    xTaskCreate(fusion_observer_task, "fusion_obs", 4096, NULL, 2, NULL);
#if CONFIG_C5VRX_DIRECT_GAIN_V3_EXPERIMENT
    ESP_ERROR_CHECK(xTaskCreate(direct_gain_v3_observer_task, "gain_v3_obs",
                                4096, NULL, 3,
                                &s_v3_observer_task_handle) == pdPASS ?
                    ESP_OK : ESP_ERR_NO_MEM);
    ESP_ERROR_CHECK(xTaskCreate(direct_gain_v3_sentinel_task, "gain_v3_fast",
                                3072, NULL, 4,
                                &s_v3_sentinel_task_handle) == pdPASS ?
                    ESP_OK : ESP_ERR_NO_MEM);
    const esp_timer_create_args_t v3_timer_args = {
        .callback = direct_gain_v3_sentinel_timer_cb,
        .arg = NULL,
        .dispatch_method = ESP_TIMER_TASK,
        .name = "dg3_fast",
    };
    ESP_ERROR_CHECK(esp_timer_create(&v3_timer_args,
                                     &s_v3_sentinel_timer));
    ESP_ERROR_CHECK(esp_timer_start_periodic(s_v3_sentinel_timer, 200));
#endif

    /* Start interactive console for on-demand diagnostics (zero periodic CPU/bus traffic) */
    /* 6 KiB: the P8ENV printf takes ~90 arguments (3 KiB overflowed). */
    xTaskCreate(console_diag_task, "console_diag", 6144, NULL, 1, NULL);

    /* Start dedicated Analog Video AGC engine (slow physical actuator). */
    /* The slow task now also calls the stride-3 diagnostic (bounded ~6 KiB
     * workspace on its call stack). Keep it outside the sample-paced path. */
    if (xTaskCreate(analog_agc_task, "analog_agc", 16384, NULL, 3, NULL) != pdPASS)
        return ESP_ERR_NO_MEM;


    /* Print startup stamp (visible on serial monitor at boot). */
#ifdef C5VRX4_EXPERIMENT
    ESP_EARLY_LOGW(TAG, "C5VRX-4 UNWRAP/75: IQ40M -> %s -> DAC13.333M "
                   "[D,D,D]@40M gain_owner=%s; descriptors RX=%d TX=%d; "
                   "experimental, no range claim",
                   c5vrx4_history_enabled() ? "Unwrap8 HISTORY" : "Unwrap8 STATIC",
                   rf_native_agc_active() ? "NATIVE" : rx_profile_name(),
                   rx_nodes, tx_nodes);
#else
    ESP_EARLY_LOGW(TAG,
        "\n=======================================================\n"
        " C5VRX-3  Seamless 32K Phase5 receiver (Zero-EOF Circular GDMA)\n"
        " Clock:   PARLIO_CLK_SRC_DEFAULT 40MHz (SPLL internal)\n"
        " Telemetry: Live GDMA ring pointer tracking (rx_ch=%d, tx_ch=%d)\n"
        " Buffer:  32,768 bytes cyclic ring (Zero-EOF patched: RX=%d TX=%d)\n"
        " RX:      40 MS/s POS edge, 32,768 bytes pure HW cyclic GDMA\n"
        " Demod:   Phase5 50ns / P%u / G%u / current-minus-previous\n"
        " TX:      40 MHz [D,D] / eof=downstream / tail=0\n"
        " Lock:    GDMA ISRs disabled, RX EOF disabled, suc_eof=0 cleared\n"
        " CPU:     done (hardware runs in unbroken infinite loop)\n"
        "=======================================================\n",
        s_rx_dma_ch, s_tx_dma_ch, rx_nodes, tx_nodes, DAC_IDLE_CODE, 2u);
#endif

    return ESP_OK;
}
